VERSION ""

NS_ :

BS_:

BU_: EBS EMS

BO_ 3221225472 VECTOR__INDEPENDENT_SIG_MSG: 0 Vector__XXX
 SG_ EngStartEnableDevice1Config : 0|4@1+ (1,0) [0|15] "" Vector__XXX
 SG_ EngStartEnableDevice2 : 0|2@1+ (1,0) [0|3] "" Vector__XXX
 SG_ EngStartEnableDevice1 : 0|2@1+ (1,0) [0|3] "" Vector__XXX
 SG_ PoweredVehicleWeight : 0|16@1+ (10,0) [0|642550] "kg" Vector__XXX
 SG_ GrossCombinationVehicleWeight : 0|16@1+ (10,0) [0|642550] "kg" Vector__XXX
 SG_ MxCntnuousRetarderTorqueLimitRq : 0|8@1+ (1,-125) [-125|125] "%" Vector__XXX
 SG_ MnCntnuousRetarderTorqueLimitRq : 0|8@1+ (1,-125) [-125|125] "%" Vector__XXX
 SG_ MxCntinuousRetarderSpeedLimitRq : 0|8@1+ (32,0) [0|8000] "RPM" Vector__XXX
 SG_ MnCntinuousRetarderSpeedLimitRq : 0|8@1+ (32,0) [0|8000] "RPM" Vector__XXX
 SG_ EngTorqueLimitRqMaxContinuous : 0|8@1+ (1,-125) [-125|125] "%" Vector__XXX
 SG_ EngTorqueLimitRqMinContinuous : 0|8@1+ (1,-125) [-125|125] "%" Vector__XXX
 SG_ EngSpeedLimitRqMaxContinuous : 0|8@1+ (32,0) [0|8000] "RPM" Vector__XXX
 SG_ EngSpeedLimitRqMinContinuous : 0|8@1+ (32,0) [0|8000] "RPM" Vector__XXX
 SG_ EngAverageCombustionTime : 0|16@1+ (0.01,0) [0|642.55] "ms" Vector__XXX
 SG_ EngDesiredCombustionTime : 0|16@1+ (0.01,0) [0|642.55] "ms" Vector__XXX
 SG_ EngCyl20CombustionTime : 0|16@1+ (0.01,0) [0|642.55] "ms" Vector__XXX
 SG_ EngCyl19CombustionTime : 0|16@1+ (0.01,0) [0|642.55] "ms" Vector__XXX
 SG_ EngCyl18CombustionTime : 0|16@1+ (0.01,0) [0|642.55] "ms" Vector__XXX
 SG_ EngCyl17CombustionTime : 0|16@1+ (0.01,0) [0|642.55] "ms" Vector__XXX
 SG_ EngCyl16CombustionTime : 0|16@1+ (0.01,0) [0|642.55] "ms" Vector__XXX
 SG_ EngCyl15CombustionTime : 0|16@1+ (0.01,0) [0|642.55] "ms" Vector__XXX
 SG_ EngCyl14CombustionTime : 0|16@1+ (0.01,0) [0|642.55] "ms" Vector__XXX
 SG_ EngCyl13CombustionTime : 0|16@1+ (0.01,0) [0|642.55] "ms" Vector__XXX
 SG_ EngCyl12CombustionTime : 0|16@1+ (0.01,0) [0|642.55] "ms" Vector__XXX
 SG_ EngCyl11CombustionTime : 0|16@1+ (0.01,0) [0|642.55] "ms" Vector__XXX
 SG_ EngCyl10CombustionTime : 0|16@1+ (0.01,0) [0|642.55] "ms" Vector__XXX
 SG_ EngCyl9CombustionTime : 0|16@1+ (0.01,0) [0|642.55] "ms" Vector__XXX
 SG_ EngCyl8CombustionTime : 0|16@1+ (0.01,0) [0|642.55] "ms" Vector__XXX
 SG_ EngCyl7CombustionTime : 0|16@1+ (0.01,0) [0|642.55] "ms" Vector__XXX
 SG_ EngCyl6CombustionTime : 0|16@1+ (0.01,0) [0|642.55] "ms" Vector__XXX
 SG_ EngCyl5CombustionTime : 0|16@1+ (0.01,0) [0|642.55] "ms" Vector__XXX
 SG_ EngCyl4CombustionTime : 0|16@1+ (0.01,0) [0|642.55] "ms" Vector__XXX
 SG_ EngCyl3CombustionTime : 0|16@1+ (0.01,0) [0|642.55] "ms" Vector__XXX
 SG_ EngCyl2CombustionTime : 0|16@1+ (0.01,0) [0|642.55] "ms" Vector__XXX
 SG_ EngCyl1CombustionTime : 0|16@1+ (0.01,0) [0|642.55] "ms" Vector__XXX
 SG_ TotalCountOfConfigChangesMade : 0|16@1+ (1,0) [0|64255] "counts" Vector__XXX
 SG_ TransOilLevelRq : 0|2@1+ (1,0) [0|3] "" Vector__XXX
 SG_ FifthWheelReleaseCtrl : 0|2@1+ (1,0) [0|3] "" Vector__XXX
 SG_ FfthWhlRlaseCtrlSecurityLockout : 0|2@1+ (1,0) [0|3] "" Vector__XXX
 SG_ TransferCaseSelectorSwitch : 0|3@1+ (1,0) [0|7] "" Vector__XXX
 SG_ SelectedMaxVehicleSpeedLimit : 0|8@1+ (1,0) [0|250] "" Vector__XXX
 SG_ RqCabZoneHeating : 0|2@1+ (1,0) [0|3] "" Vector__XXX
 SG_ RqEngZoneHeating : 0|2@1+ (1,0) [0|3] "" Vector__XXX
 SG_ AuxHeaterModeRq : 0|4@1+ (1,0) [0|15] "" Vector__XXX
 SG_ EngAutomaticStartEnableSwitch : 0|2@1+ (1,0) [0|3] "" Vector__XXX
 SG_ AtmaticGearShiftingEnableSwitch : 0|2@1+ (1,0) [0|3] "" Vector__XXX
 SG_ VhclLmtngSpdGvernorEnableSwitch : 0|2@1+ (1,0) [0|3] "" Vector__XXX
 SG_ VhclLmtngSpdGvrnrIncrmentSwitch : 0|2@1+ (1,0) [0|3] "" Vector__XXX
 SG_ VhclLmtngSpdGvrnrDcrementSwitch : 0|2@1+ (1,0) [0|3] "" Vector__XXX
 SG_ SeatBeltSwitch : 0|2@1+ (1,0) [0|3] "" Vector__XXX
 SG_ OperatorSeatDirectionSwitch : 0|2@1+ (1,0) [0|3] "" Vector__XXX
 SG_ BatteryMainSwitchHoldRq : 0|2@1+ (1,0) [0|3] "" Vector__XXX
 SG_ AuxHeaterCoolantPumpRq : 0|2@1+ (1,0) [0|3] "" Vector__XXX
 SG_ CabInteriorTempCmd : 0|16@1+ (0.03125,-273) [-273|1735] "°C" Vector__XXX
 SG_ RqedPercentFanSpeed : 0|8@1+ (0.4,0) [0|100] "%" Vector__XXX
 SG_ IlluminationBrightnessPercent : 0|8@1+ (0.4,0) [0|100] "%" Vector__XXX
 SG_ UnitNumber : 0|8@1+ (1,0) [0|255] "" Vector__XXX
 SG_ SerialNumber : 0|8@1+ (1,0) [0|255] "" Vector__XXX
 SG_ Model : 0|8@1+ (1,0) [0|255] "" Vector__XXX
 SG_ Make : 0|8@1+ (1,0) [0|255] "" Vector__XXX
 SG_ CruiseCtrlLowSetLimitSpeed : 0|8@1+ (1,0) [0|250] "km/h" Vector__XXX
 SG_ CruiseCtrlHighSetLimitSpeed : 0|8@1+ (1,0) [0|250] "km/h" Vector__XXX
 SG_ AuxHeaterMaxOutputPower : 0|16@1+ (2,0) [0|128510] "W" Vector__XXX
 SG_ TripServiceBrakeApps : 0|32@1+ (1,0) [0|4227858431] "" Vector__XXX
 SG_ TripServiceBrakeDistance : 0|32@1+ (0.125,0) [0|526385151.9] "km" Vector__XXX
 SG_ TripCompressionBrakeDistance : 0|32@1+ (0.125,0) [0|526385151.9] "km" Vector__XXX
 SG_ TotalCompressionBrakeDistance : 0|32@1+ (0.125,0) [0|526385151.9] "km" Vector__XXX
 SG_ CbA_CRfrgrntCmprssorOutletPress : 0|8@1+ (16,0) [0|4000] "kPa" Vector__XXX
 SG_ Battery2Temp : 0|8@1+ (1,-40) [-40|210] "°C" Vector__XXX
 SG_ Battery1Temp : 0|8@1+ (1,-40) [-40|210] "°C" Vector__XXX
 SG_ BatteryMainSwitchHoldState : 0|2@1+ (1,0) [0|3] "" Vector__XXX
 SG_ Joystick3XAxisDetentPosStatus : 0|2@1+ (1,0) [0|3] "" Vector__XXX
 SG_ Joystick3Button9PressedStatus : 0|2@1+ (1,0) [0|3] "" Vector__XXX
 SG_ Joystick3Button10PressedStatus : 0|2@1+ (1,0) [0|3] "" Vector__XXX
 SG_ Joystick3Button11PressedStatus : 0|2@1+ (1,0) [0|3] "" Vector__XXX
 SG_ Joystick3Button12PressedStatus : 0|2@1+ (1,0) [0|3] "" Vector__XXX
 SG_ Joystick3YAxisDetentPosStatus : 0|2@1+ (1,0) [0|3] "" Vector__XXX
 SG_ Joystick3YAxisPos : 0|10@1+ (0.1,0) [0|102] "%" Vector__XXX
 SG_ Jystck3YAxsLvrFrwrdPstvPsStatus : 0|2@1+ (1,0) [0|3] "" Vector__XXX
 SG_ Jystck3YAxsLvrBckNgtvePosStatus : 0|2@1+ (1,0) [0|3] "" Vector__XXX
 SG_ Joystick3YAxisNeutralPosStatus : 0|2@1+ (1,0) [0|3] "" Vector__XXX
 SG_ Joystick3XAxisPos : 0|10@1+ (0.1,0) [0|102] "%" Vector__XXX
 SG_ Jystck3XAxsLvrRghtPstvPosStatus : 0|2@1+ (1,0) [0|3] "" Vector__XXX
 SG_ Jystck3XAxsLvrLftNgtvePosStatus : 0|2@1+ (1,0) [0|3] "" Vector__XXX
 SG_ Joystick3XAxisNeutralPosStatus : 0|2@1+ (1,0) [0|3] "" Vector__XXX
 SG_ Joystick3Button5PressedStatus : 0|2@1+ (1,0) [0|3] "" Vector__XXX
 SG_ Joystick3Button6PressedStatus : 0|2@1+ (1,0) [0|3] "" Vector__XXX
 SG_ Joystick3Button7PressedStatus : 0|2@1+ (1,0) [0|3] "" Vector__XXX
 SG_ Joystick3Button8PressedStatus : 0|2@1+ (1,0) [0|3] "" Vector__XXX
 SG_ Joystick3Button1PressedStatus : 0|2@1+ (1,0) [0|3] "" Vector__XXX
 SG_ Joystick3Button2PressedStatus : 0|2@1+ (1,0) [0|3] "" Vector__XXX
 SG_ Joystick3Button3PressedStatus : 0|2@1+ (1,0) [0|3] "" Vector__XXX
 SG_ Joystick3Button4PressedStatus : 0|2@1+ (1,0) [0|3] "" Vector__XXX
 SG_ Joystick2XAxisDetentPosStatus : 0|2@1+ (1,0) [0|3] "" Vector__XXX
 SG_ Joystick2YAxisDetentPosStatus : 0|2@1+ (1,0) [0|3] "" Vector__XXX
 SG_ Joystick2YAxisPos : 0|10@1+ (0.1,0) [0|102] "%" Vector__XXX
 SG_ Jystck2YAxsLvrFrwrdPstvPsStatus : 0|2@1+ (1,0) [0|3] "" Vector__XXX
 SG_ Jystck2YAxsLvrBckNgtvePosStatus : 0|2@1+ (1,0) [0|3] "" Vector__XXX
 SG_ Joystick2YAxisNeutralPosStatus : 0|2@1+ (1,0) [0|3] "" Vector__XXX
 SG_ Joystick2XAxisPos : 0|10@1+ (0.1,0) [0|102] "%" Vector__XXX
 SG_ Jystck2XAxsLvrRghtPstvPosStatus : 0|2@1+ (1,0) [0|3] "" Vector__XXX
 SG_ Jystck2XAxsLvrLftNgtvePosStatus : 0|2@1+ (1,0) [0|3] "" Vector__XXX
 SG_ Joystick2XAxisNeutralPosStatus : 0|2@1+ (1,0) [0|3] "" Vector__XXX
 SG_ Joystick2Button9PressedStatus : 0|2@1+ (1,0) [0|3] "" Vector__XXX
 SG_ Joystick2Button10PressedStatus : 0|2@1+ (1,0) [0|3] "" Vector__XXX
 SG_ Joystick2Button11PressedStatus : 0|2@1+ (1,0) [0|3] "" Vector__XXX
 SG_ Joystick2Button12PressedStatus : 0|2@1+ (1,0) [0|3] "" Vector__XXX
 SG_ Joystick2Button5PressedStatus : 0|2@1+ (1,0) [0|3] "" Vector__XXX
 SG_ Joystick2Button6PressedStatus : 0|2@1+ (1,0) [0|3] "" Vector__XXX
 SG_ Joystick2Button7PressedStatus : 0|2@1+ (1,0) [0|3] "" Vector__XXX
 SG_ Joystick2Button8PressedStatus : 0|2@1+ (1,0) [0|3] "" Vector__XXX
 SG_ Joystick2Button1PressedStatus : 0|2@1+ (1,0) [0|3] "" Vector__XXX
 SG_ Joystick2Button2PressedStatus : 0|2@1+ (1,0) [0|3] "" Vector__XXX
 SG_ Joystick2Button3PressedStatus : 0|2@1+ (1,0) [0|3] "" Vector__XXX
 SG_ Joystick2Button4PressedStatus : 0|2@1+ (1,0) [0|3] "" Vector__XXX
 SG_ Joystick1XAxisDetentPosStatus : 0|2@1+ (1,0) [0|3] "" Vector__XXX
 SG_ Joystick1YAxisDetentPosStatus : 0|2@1+ (1,0) [0|3] "" Vector__XXX
 SG_ Joystick1YAxisPos : 0|10@1+ (0.1,0) [0|102] "%" Vector__XXX
 SG_ Jystck1YAxsLvrFrwrdPstvPsStatus : 0|2@1+ (1,0) [0|3] "" Vector__XXX
 SG_ Jystck1YAxsLvrBckNgtvePosStatus : 0|2@1+ (1,0) [0|3] "" Vector__XXX
 SG_ Joystick1YAxisNeutralPosStatus : 0|2@1+ (1,0) [0|3] "" Vector__XXX
 SG_ Joystick1XAxisPos : 0|10@1+ (0.1,0) [0|102] "%" Vector__XXX
 SG_ Joystick1Button9PressedStatus : 0|2@1+ (1,0) [0|3] "" Vector__XXX
 SG_ Joystick1Button10PressedStatus : 0|2@1+ (1,0) [0|3] "" Vector__XXX
 SG_ Joystick1Button11PressedStatus : 0|2@1+ (1,0) [0|3] "" Vector__XXX
 SG_ Joystick1Button12PressedStatus : 0|2@1+ (1,0) [0|3] "" Vector__XXX
 SG_ Joystick1Button5PressedStatus : 0|2@1+ (1,0) [0|3] "" Vector__XXX
 SG_ Joystick1Button6PressedStatus : 0|2@1+ (1,0) [0|3] "" Vector__XXX
 SG_ Joystick1Button7PressedStatus : 0|2@1+ (1,0) [0|3] "" Vector__XXX
 SG_ Joystick1Button8PressedStatus : 0|2@1+ (1,0) [0|3] "" Vector__XXX
 SG_ Joystick1Button1PressedStatus : 0|2@1+ (1,0) [0|3] "" Vector__XXX
 SG_ Joystick1Button2PressedStatus : 0|2@1+ (1,0) [0|3] "" Vector__XXX
 SG_ Joystick1Button3PressedStatus : 0|2@1+ (1,0) [0|3] "" Vector__XXX
 SG_ Joystick1Button4PressedStatus : 0|2@1+ (1,0) [0|3] "" Vector__XXX
 SG_ Jystck1XAxsLvrRghtPstvPosStatus : 0|2@1+ (1,0) [0|3] "" Vector__XXX
 SG_ Jystck1XAxsLvrLftNgtvePosStatus : 0|2@1+ (1,0) [0|3] "" Vector__XXX
 SG_ Joystick1XAxisNeutralPosStatus : 0|2@1+ (1,0) [0|3] "" Vector__XXX
 SG_ ParkingBrakeRedWarningSignal : 0|2@1+ (1,0) [0|3] "" Vector__XXX
 SG_ ParkBrakeReleaseInhibitStatus : 0|2@1+ (1,0) [0|3] "" Vector__XXX
 SG_ ParkingBrakeActuator : 0|2@1+ (1,0) [0|3] "" Vector__XXX
 SG_ BrakeSecondPress : 0|8@1+ (4,0) [0|1000] "kPa" Vector__XXX
 SG_ BrakePrimaryPress : 0|8@1+ (4,0) [0|1000] "kPa" Vector__XXX
 SG_ BrakeAppPress : 0|8@1+ (4,0) [0|1000] "kPa" Vector__XXX
 SG_ AuxPumpPress : 0|8@1+ (16,0) [0|4000] "kPa" Vector__XXX
 SG_ DTC1 : 0|32@1+ (1,0) [0|4294967295] "" Vector__XXX
 SG_ DataDictionaryMethod : 0|21@1+ (1,0) [0|2097151] "" Vector__XXX
 SG_ DataDictionaryManufacturerCode : 0|11@1+ (1,0) [0|2047] "" Vector__XXX
 SG_ EngExhstGsOxygnSnsrClsdLpOprtnBn : 0|4@1+ (1,0) [0|15] "" Vector__XXX
 SG_ ShorttermFuelTrimBank2 : 0|16@1+ (0.1,-100) [-100|100] "%" Vector__XXX
 SG_ LongtermFuelTrimBank2 : 0|16@1+ (0.1,-100) [-100|100] "%" Vector__XXX
 SG_ EngExhstGsOxygnSnsrClsdLpOprtnBn : 0|4@1+ (1,0) [0|15] "" Vector__XXX
 SG_ ShorttermFuelTrimBank1 : 0|16@1+ (0.1,-100) [-100|100] "%" Vector__XXX
 SG_ LongtermFuelTrimBank1 : 0|16@1+ (0.1,-100) [-100|100] "%" Vector__XXX
 SG_ EngSpdSnsor1TimingPatternStatus : 0|2@1+ (1,0) [0|3] "" Vector__XXX
 SG_ EngSpdSnsor2TimingPatternStatus : 0|2@1+ (1,0) [0|3] "" Vector__XXX
 SG_ EngSpdSnsor3TimingPatternStatus : 0|2@1+ (1,0) [0|3] "" Vector__XXX
 SG_ EngSpeed3 : 0|16@1+ (0.5,0) [0|32127.5] "rpm" Vector__XXX
 SG_ EngSpeed2 : 0|16@1+ (0.5,0) [0|32127.5] "rpm" Vector__XXX
 SG_ EngSpeed1 : 0|16@1+ (0.5,0) [0|32127.5] "rpm" Vector__XXX
 SG_ DsrdEngCoolantThermostatOpening : 0|8@1+ (0.4,0) [0|100] "%" Vector__XXX
 SG_ DesiredEngCoolantPumpOutletTemp : 0|8@1+ (1,-40) [-40|210] "deg" Vector__XXX
 SG_ EngCoolantThermostatMode : 0|2@1+ (1,0) [0|3] "" Vector__XXX
 SG_ AuxI_OChannel19 : 0|8@1+ (1,0) [0|250] "" Vector__XXX
 SG_ AuxI_OChannel20 : 0|8@1+ (1,0) [0|250] "" Vector__XXX
 SG_ AuxI_OChannel21 : 0|8@1+ (1,0) [0|250] "" Vector__XXX
 SG_ AuxI_OChannel22 : 0|8@1+ (1,0) [0|250] "" Vector__XXX
 SG_ AuxI_OChannel15 : 0|8@1+ (1,0) [0|250] "" Vector__XXX
 SG_ AuxI_OChannel16 : 0|8@1+ (1,0) [0|250] "" Vector__XXX
 SG_ AuxI_OChannel17 : 0|8@1+ (1,0) [0|250] "" Vector__XXX
 SG_ AuxI_OChannel18 : 0|8@1+ (1,0) [0|250] "" Vector__XXX
 SG_ AuxI_OChannel11 : 0|8@1+ (1,0) [0|250] "" Vector__XXX
 SG_ AuxI_OChannel12 : 0|8@1+ (1,0) [0|250] "" Vector__XXX
 SG_ AuxI_OChannel13 : 0|8@1+ (1,0) [0|250] "" Vector__XXX
 SG_ AuxI_OChannel14 : 0|8@1+ (1,0) [0|250] "" Vector__XXX
 SG_ AuxI_OChannel7 : 0|8@1+ (1,0) [0|250] "" Vector__XXX
 SG_ AuxI_OChannel8 : 0|8@1+ (1,0) [0|250] "" Vector__XXX
 SG_ AuxI_OChannel9 : 0|8@1+ (1,0) [0|250] "" Vector__XXX
 SG_ AuxI_OChannel10 : 0|8@1+ (1,0) [0|250] "" Vector__XXX
 SG_ AuxI_OChannel3 : 0|16@1+ (1,0) [0|64255] "counts" Vector__XXX
 SG_ AuxI_OChannel4 : 0|16@1+ (1,0) [0|64255] "counts" Vector__XXX
 SG_ AuxI_OChannel5 : 0|16@1+ (1,0) [0|64255] "counts" Vector__XXX
 SG_ AuxI_OChannel6 : 0|16@1+ (1,0) [0|64255] "counts" Vector__XXX
 SG_ Aftrtreatment1AirEnableActuator : 0|2@1+ (1,0) [0|3] "" Vector__XXX
 SG_ Aftertreatment1PurgeAirActuator : 0|2@1+ (1,0) [0|3] "" Vector__XXX
 SG_ Aftrtrtmnt1AtmzationAirActuator : 0|2@1+ (1,0) [0|3] "" Vector__XXX
 SG_ Aftertreatment1AirSystemRelay : 0|2@1+ (1,0) [0|3] "" Vector__XXX
 SG_ Aftrtrtment1AirPressActuatorPos : 0|8@1+ (0.4,0) [0|100] "%" Vector__XXX
 SG_ Aftertreatment1AirPressCtrl : 0|16@1+ (0.0025,0) [0|160.6375] "%" Vector__XXX
 SG_ Aftertreatment1PurgeAirPress : 0|16@1+ (0.1,0) [0|6425.5] "kPa" Vector__XXX
 SG_ Aftertreatment1SupplyAirPress : 0|16@1+ (0.1,0) [0|6425.5] "kPa" Vector__XXX
 SG_ Aftertreatment1SecondAirPress : 0|16@1+ (0.1,0) [0|6425.5] "kPa" Vector__XXX
 SG_ Aftrtreatment1SecondAirMassFlow : 0|16@1+ (0.2,0) [0|12851] "kg/hr" Vector__XXX
 SG_ Aftertreatment1SecondAirTemp : 0|16@1+ (0.03125,-273) [-273|1735] "°C" Vector__XXX
 SG_ Aftrtratment1SecondAirDiffPress : 0|16@1+ (0.0078125,-250) [-250|251.99] "kPa" Vector__XXX
 SG_ Aftrtratment1FuelEnableActuator : 0|2@1+ (1,0) [0|3] "" Vector__XXX
 SG_ Aftrtratment1RegenerationStatus : 0|2@1+ (1,0) [0|3] "" Vector__XXX
 SG_ Aftertreatment1Ignt : 0|2@1+ (1,0) [0|3] "" Vector__XXX
 SG_ Aftrtreatment1FuelDrainActuator : 0|2@1+ (1,0) [0|3] "" Vector__XXX
 SG_ Aftertreatment1FuelPressCtrl : 0|16@1+ (0.0025,0) [0|160.6375] "%" Vector__XXX
 SG_ Aftertreatment1FuelRate : 0|16@1+ (0.05,0) [0|3212.75] "L/hr" Vector__XXX
 SG_ Aftertreatment1FuelPress1 : 0|16@1+ (0.1,0) [0|6425.5] "kPa" Vector__XXX
 SG_ Aftertreatment1FuelPress2 : 0|16@1+ (0.1,0) [0|6425.5] "kPa" Vector__XXX
 SG_ ParticulateTrapOutletPress1 : 0|16@1+ (0.1,0) [0|6425.5] "kPa" Vector__XXX
 SG_ ParticulateTrapIntakePress1 : 0|16@1+ (0.1,0) [0|6425.5] "kPa" Vector__XXX
 SG_ Aftrtrtmnt1TtlNmbrOfActvRgnrtnMn : 0|32@1+ (1,0) [0|4294967295] "counts" Vector__XXX
 SG_ Aftrtrtmnt1TtlNmbrOfActvRgnrtnIn : 0|32@1+ (1,0) [0|4294967295] "counts" Vector__XXX
 SG_ Aftrtrtmnt1TtlNmbrOfPssvRgnrtns : 0|32@1+ (1,0) [0|4294967295] "counts" Vector__XXX
 SG_ Aftrtrtmnt1TtlPssvRgnrationTime : 0|32@1+ (1,0) [0|4211081215] "s" Vector__XXX
 SG_ Aftrtrtmnt1TtlNmbrOfActvRgnrtns : 0|32@1+ (1,0) [0|4294967295] "counts" Vector__XXX
 SG_ Aftrtreatment1TotalDisabledTime : 0|32@1+ (1,0) [0|4211081215] "s" Vector__XXX
 SG_ Aftrtrtmnt1TtalRegenerationTime : 0|32@1+ (1,0) [0|4211081215] "s" Vector__XXX
 SG_ Aftertreatment1TotalFuelUsed : 0|32@1+ (0.5,0) [0|2105540607.5] "L" Vector__XXX
 SG_ Aftrtrtmnt1IntkOxygnSnsrPrlmnryF : 0|5@1+ (1,0) [0|31] "" Vector__XXX
 SG_ Aftrtrtmnt1IntkNOxSnsrPrlmnryFMI : 0|5@1+ (1,0) [0|31] "" Vector__XXX
 SG_ Aftrtrtmnt1IntkGsSnsrHeaterCtrl : 0|2@1+ (1,0) [0|3] "" Vector__XXX
 SG_ Aftrtrtmnt1IntkGsSnsrHtrPrlmnryF : 0|5@1+ (1,0) [0|31] "" Vector__XXX
 SG_ Aftrtrtmnt1IntkWdRngO2RdngStble : 0|2@1+ (1,0) [0|3] "" Vector__XXX
 SG_ Aftrtrtmnt1IntkNOxReadingStable : 0|2@1+ (1,0) [0|3] "" Vector__XXX
 SG_ Aftrtrtmnt1IntkeGasSensorAtTemp : 0|2@1+ (1,0) [0|3] "" Vector__XXX
 SG_ Aftrtrtmnt1IntkGsSnsrPwrInRange : 0|2@1+ (1,0) [0|3] "" Vector__XXX
 SG_ Aftertreatment1IntakeO2 : 0|16@1+ (0.000514,-12) [-12|21] "%" Vector__XXX
 SG_ Aftertreatment1IntakeNOx : 0|16@1+ (0.05,-200) [-200|3012.75] "ppm" Vector__XXX
 SG_ Aftrtrtmnt1PrtcltTrpIntkGsTmpPrl : 0|5@1+ (1,0) [0|31] "" Vector__XXX
 SG_ Aftrtrtmnt1ExhstGsTmp1PrlmnryFMI : 0|5@1+ (1,0) [0|31] "" Vector__XXX
 SG_ Aftrtrtmnt1PrtcltTrpIntkGasTemp : 0|16@1+ (0.03125,-273) [-273|1735] "°C" Vector__XXX
 SG_ Aftertreatment1ExhaustGasTemp1 : 0|16@1+ (0.03125,-273) [-273|1735] "°C" Vector__XXX
 SG_ AntitheftRandomNumber : 0|56@1+ (1,0) [0|255] "" Vector__XXX
 SG_ AntitheftComponentStatusStates : 0|2@1+ (1,0) [0|3] "" Vector__XXX
 SG_ AntthftEncryptnSdPrsntIndicator : 0|2@1+ (1,0) [0|3] "" Vector__XXX
 SG_ AntitheftModifyPwdStates : 0|2@1+ (1,0) [0|3] "" Vector__XXX
 SG_ AntitheftPwdValidIndicator : 0|2@1+ (1,0) [0|3] "" Vector__XXX
 SG_ AntitheftPasswordRepresentation : 0|56@1+ (1,0) [0|255] "" Vector__XXX
 SG_ AntitheftCmdStates : 0|3@1+ (1,0) [0|7] "" Vector__XXX
 SG_ AntitheftDesiredExitModeStates : 0|2@1+ (1,0) [0|3] "" Vector__XXX
 SG_ AntthftEncryptonIndicatorStates : 0|2@1+ (1,0) [0|3] "" Vector__XXX
 SG_ EngAltWinding3Temp : 0|8@1+ (1,-40) [-40|210] "°C" Vector__XXX
 SG_ EngAltWinding2Temp : 0|8@1+ (1,-40) [-40|210] "°C" Vector__XXX
 SG_ EngAltWinding1Temp : 0|8@1+ (1,-40) [-40|210] "°C" Vector__XXX
 SG_ EngAltBearing2Temp : 0|8@1+ (1,-40) [-40|210] "°C" Vector__XXX
 SG_ EngAltBearing1Temp : 0|8@1+ (1,-40) [-40|210] "°C" Vector__XXX
 SG_ LevelPresetRearAxleRight : 0|16@1+ (0.1,-3200) [-3200|3225.5] "mm" Vector__XXX
 SG_ LevelPresetRearAxleLeft : 0|16@1+ (0.1,-3200) [-3200|3225.5] "mm" Vector__XXX
 SG_ LevelPresetFrontAxleRight : 0|16@1+ (0.1,-3200) [-3200|3225.5] "mm" Vector__XXX
 SG_ LevelPresetFrontAxleLeft : 0|16@1+ (0.1,-3200) [-3200|3225.5] "mm" Vector__XXX
 SG_ ElctrncShckAbsrbrCtrlMdLft_TgAxl : 0|2@1+ (1,0) [0|3] "" Vector__XXX
 SG_ ElctrncShckAbsrbrCtrlMdRearAxle : 0|2@1+ (1,0) [0|3] "" Vector__XXX
 SG_ ElctrncShckAbsrbrCtrlMdFrntAxle : 0|2@1+ (1,0) [0|3] "" Vector__XXX
 SG_ DamperStiffnessLift_TagAxle : 0|8@1+ (0.4,0) [0|100] "%" Vector__XXX
 SG_ DamperStiffnessRearAxle : 0|8@1+ (0.4,0) [0|100] "%" Vector__XXX
 SG_ DamperStiffnessFrontAxle : 0|8@1+ (0.4,0) [0|100] "%" Vector__XXX
 SG_ TestLimitMinimum : 0|16@1+ (1,0) [0|64255] "" Vector__XXX
 SG_ TestValue : 0|16@1+ (1,0) [0|64255] "" Vector__XXX
 SG_ TestIdentifier : 0|8@1+ (1,0) [0|255] "" Vector__XXX
 SG_ Aftrtrtmnt1PrtcltTrpDltPrssPrlmn : 0|5@1+ (1,0) [0|31] "" Vector__XXX
 SG_ Aftrtrtmnt1ExhstGsTmp2PrlmnryFMI : 0|5@1+ (1,0) [0|31] "" Vector__XXX
 SG_ Aftrtrtmnt1PrtclteTrapDiffPress : 0|16@1+ (0.1,0) [0|6425.5] "kPa" Vector__XXX
 SG_ Aftrtrtmnt1PrtcltTrpIntrmdtGsTmp : 0|16@1+ (0.03125,-273) [-273|1735] "deg" Vector__XXX
 SG_ Aftertreatment1ExhaustGasTemp2 : 0|16@1+ (0.03125,-273) [-273|1735] "deg" Vector__XXX
 SG_ Aftrtrtmnt1OtltOxygnSnsrPrlmnryF : 0|5@1+ (1,0) [0|31] "" Vector__XXX
 SG_ Aftrtrtmnt1OtltNOxSnsrPrlmnryFMI : 0|5@1+ (1,0) [0|31] "" Vector__XXX
 SG_ Aftrtrtmnt1OtltGsSnsrHeaterCtrl : 0|2@1+ (1,0) [0|3] "" Vector__XXX
 SG_ Aftrtrtmnt1OtltGsSnsrHtrPrlmnryF : 0|5@1+ (1,0) [0|31] "" Vector__XXX
 SG_ Aftrtrtmnt1OtltWdRngO2RdngStble : 0|2@1+ (1,0) [0|3] "" Vector__XXX
 SG_ Aftrtrtmnt1OtltNOxReadingStable : 0|2@1+ (1,0) [0|3] "" Vector__XXX
 SG_ Aftrtrtmnt1OtletGasSensorAtTemp : 0|2@1+ (1,0) [0|3] "" Vector__XXX
 SG_ Aftrtrtmnt1OtltGsSnsrPwrInRange : 0|2@1+ (1,0) [0|3] "" Vector__XXX
 SG_ Aftertreatment1OutletO2 : 0|16@1+ (0.000514,-12) [-12|21] "%" Vector__XXX
 SG_ Aftertreatment1OutletNOx : 0|16@1+ (0.05,-200) [-200|3012.75] "ppm" Vector__XXX
 SG_ Aftrtrtmnt1PrtcltTrpOtltExhstGsT : 0|5@1+ (1,0) [0|31] "" Vector__XXX
 SG_ Aftrtrtmnt1ExhstGsTmp3PrlmnryFMI : 0|5@1+ (1,0) [0|31] "" Vector__XXX
 SG_ Aftrtrtmnt1PrtcltTrpOtltGasTemp : 0|16@1+ (0.03125,-273) [-273|1735] "°C" Vector__XXX
 SG_ Aftertreatment1ExhaustGasTemp3 : 0|16@1+ (0.03125,-273) [-273|1735] "°C" Vector__XXX
 SG_ PrtcltTrp1TmSncLstActvRgnration : 0|32@1+ (1,0) [0|4211081215] "sec" Vector__XXX
 SG_ ParticulateTrap1AshLoadPercent : 0|8@1+ (1,0) [0|250] "%" Vector__XXX
 SG_ ParticulateTrap1SootLoadPercent : 0|8@1+ (1,0) [0|250] "%" Vector__XXX
 SG_ Aftrtrtmnt1TrpNmbrOfActvRgnrtnMn : 0|32@1+ (1,0) [0|4294967295] "counts" Vector__XXX
 SG_ Aftrtrtmnt1TrpNmbrOfActvRgnrtnIn : 0|32@1+ (1,0) [0|4294967295] "counts" Vector__XXX
 SG_ Aftrtrtmnt1TrpNmbrOfPssvRgnrtns : 0|32@1+ (1,0) [0|4294967295] "counts" Vector__XXX
 SG_ Aftrtrtmnt1TrpPssvRgnrationTime : 0|32@1+ (1,0) [0|4211081215] "sec" Vector__XXX
 SG_ Aftrtrtmnt1TrpNmbrOfActvRgnrtns : 0|32@1+ (1,0) [0|4294967295] "counts" Vector__XXX
 SG_ Aftertreatment1TripDisabledTime : 0|32@1+ (1,0) [0|4211081215] "sec" Vector__XXX
 SG_ Aftrtrtmnt1TrpActvRgnrationTime : 0|32@1+ (1,0) [0|4211081215] "sec" Vector__XXX
 SG_ Aftertreatment1TripFuelUsed : 0|32@1+ (0.5,0) [0|2105540607.5] "L" Vector__XXX
 SG_ Aftrtreatment2AirEnableActuator : 0|2@1+ (1,0) [0|3] "" Vector__XXX
 SG_ Aftertreatment2PurgeAirActuator : 0|2@1+ (1,0) [0|3] "" Vector__XXX
 SG_ Aftrtrtmnt2AtmzationAirActuator : 0|2@1+ (1,0) [0|3] "" Vector__XXX
 SG_ Aftertreatment2AirSystemRelay : 0|2@1+ (1,0) [0|3] "" Vector__XXX
 SG_ Aftrtrtment2AirPressActuatorPos : 0|8@1+ (0.4,0) [0|100] "%" Vector__XXX
 SG_ Aftertreatment2AirPressCtrl : 0|16@1+ (0.0025,0) [0|160.6375] "%" Vector__XXX
 SG_ Aftertreatment2PurgeAirPress : 0|16@1+ (0.1,0) [0|6425.5] "kPa" Vector__XXX
 SG_ Aftertreatment2SupplyAirPress : 0|16@1+ (0.1,0) [0|6425.5] "kPa" Vector__XXX
 SG_ Aftertreatment2SecondAirPress : 0|16@1+ (0.1,0) [0|6425.5] "kPa" Vector__XXX
 SG_ Aftrtreatment2SecondAirMassFlow : 0|16@1+ (0.2,0) [0|12851] "kg/hr" Vector__XXX
 SG_ Aftertreatment2SecondAirTemp : 0|16@1+ (0.03125,-273) [-273|1735] "°C" Vector__XXX
 SG_ Aftrtratment2SecondAirDiffPress : 0|16@1+ (0.0078125,-250) [-250|251.99] "kPa" Vector__XXX
 SG_ Aftrtratment2FuelEnableActuator : 0|2@1+ (1,0) [0|3] "" Vector__XXX
 SG_ Aftrtratment2RegenerationStatus : 0|2@1+ (1,0) [0|3] "" Vector__XXX
 SG_ Aftertreatment2Ignt : 0|2@1+ (1,0) [0|3] "" Vector__XXX
 SG_ Aftrtreatment2FuelDrainActuator : 0|2@1+ (1,0) [0|3] "" Vector__XXX
 SG_ Aftertreatment2FuelPressCtrl : 0|16@1+ (0.0025,0) [0|160.6375] "%" Vector__XXX
 SG_ Aftertreatment2FuelRate : 0|16@1+ (0.05,0) [0|3212.75] "L/hr" Vector__XXX
 SG_ Aftertreatment2FuelPress : 0|16@1+ (0.1,0) [0|6425.5] "kPa" Vector__XXX
 SG_ ParticulateTrapOutletPress2 : 0|16@1+ (0.1,0) [0|6425.5] "kPa" Vector__XXX
 SG_ ParticulateTrapIntakePress2 : 0|16@1+ (0.1,0) [0|6425.5] "kPa" Vector__XXX
 SG_ Aftrtrtmnt2TtlNmbrOfActvRgnrtnMn : 0|32@1+ (1,0) [0|4294967295] "counts" Vector__XXX
 SG_ Aftrtrtmnt2TtlNmbrOfActvRgnrtnIn : 0|32@1+ (1,0) [0|4294967295] "counts" Vector__XXX
 SG_ Aftrtrtmnt2TtlNmbrOfPssvRgnrtns : 0|32@1+ (1,0) [0|4294967295] "counts" Vector__XXX
 SG_ Aftrtrtmnt2TtlPssvRgnrationTime : 0|32@1+ (1,0) [0|4211081215] "sec" Vector__XXX
 SG_ Aftrtrtmnt2TtlNmbrOfActvRgnrtns : 0|32@1+ (1,0) [0|4294967295] "counts" Vector__XXX
 SG_ Aftrtreatment2TotalDisabledTime : 0|32@1+ (1,0) [0|4211081215] "s" Vector__XXX
 SG_ Aftrtrtmnt2TtalRegenerationTime : 0|32@1+ (1,0) [0|4211081215] "s" Vector__XXX
 SG_ Aftertreatment2TotalFuelUsed : 0|32@1+ (0.5,0) [0|2105540607.5] "L" Vector__XXX
 SG_ Aftrtrtmnt2IntkOxygnSnsrPrlmnryF : 0|5@1+ (1,0) [0|31] "" Vector__XXX
 SG_ Aftrtrtmnt2IntkNOxSnsrPrlmnryFMI : 0|5@1+ (1,0) [0|31] "" Vector__XXX
 SG_ Aftrtrtmnt2IntkGsSnsrHeaterCtrl : 0|2@1+ (1,0) [0|3] "" Vector__XXX
 SG_ Aftrtrtmnt2IntkGsSnsrHtrPrlmnryF : 0|5@1+ (1,0) [0|31] "" Vector__XXX
 SG_ Aftrtrtmnt2IntkWdRngO2RdngStble : 0|2@1+ (1,0) [0|3] "" Vector__XXX
 SG_ Aftrtrtmnt2IntkNOxReadingStable : 0|2@1+ (1,0) [0|3] "" Vector__XXX
 SG_ Aftrtrtmnt2IntkeGasSensorAtTemp : 0|2@1+ (1,0) [0|3] "" Vector__XXX
 SG_ Aftrtrtmnt2IntkGsSnsrPwrInRange : 0|2@1+ (1,0) [0|3] "" Vector__XXX
 SG_ Aftertreatment2IntakeO2 : 0|16@1+ (0.000514,-12) [-12|21] "%" Vector__XXX
 SG_ Aftertreatment2IntakeNOx : 0|16@1+ (0.05,-200) [-200|3012.75] "ppm" Vector__XXX
 SG_ Aftrtrtmnt2PrtcltTrpIntkGsTmpPrl : 0|5@1+ (1,0) [0|31] "" Vector__XXX
 SG_ Aftrtrtmnt2ExhstGsTmp1PrlmnryFMI : 0|5@1+ (1,0) [0|31] "" Vector__XXX
 SG_ Aftrtrtmnt2PrtcltTrpIntkGasTemp : 0|16@1+ (0.03125,-273) [-273|1735] "°C" Vector__XXX
 SG_ Aftertreatment2ExhaustGasTemp1 : 0|16@1+ (0.03125,-273) [-273|1735] "°C" Vector__XXX
 SG_ Aftrtrtmnt2PrtcltTrpDltPrssPrlmn : 0|5@1+ (1,0) [0|31] "" Vector__XXX
 SG_ Aftrtrtmnt2ExhstGsTmp2PrlmnryFMI : 0|5@1+ (1,0) [0|31] "" Vector__XXX
 SG_ Aftrtrtmnt2PrtclteTrapDiffPress : 0|16@1+ (0.1,0) [0|6425.5] "kPa" Vector__XXX
 SG_ Aftrtrtmnt2PrtcltTrpIntrmdtGsTmp : 0|16@1+ (0.03125,-273) [-273|1735] "°C" Vector__XXX
 SG_ Aftertreatment2ExhaustGasTemp2 : 0|16@1+ (0.03125,-273) [-273|1735] "°C" Vector__XXX
 SG_ Aftrtrtmnt2OtltOxygnSnsrPrlmnryF : 0|5@1+ (1,0) [0|31] "" Vector__XXX
 SG_ Aftrtrtmnt2OtltNOxSnsrPrlmnryFMI : 0|5@1+ (1,0) [0|31] "" Vector__XXX
 SG_ Aftrtrtmnt2OtltGsSnsrHeaterCtrl : 0|2@1+ (1,0) [0|3] "" Vector__XXX
 SG_ Aftrtrtmnt2OtltGsSnsrHtrPrlmnryF : 0|5@1+ (1,0) [0|31] "" Vector__XXX
 SG_ Aftrtrtmnt2OtltWdRngO2RdngStble : 0|2@1+ (1,0) [0|3] "" Vector__XXX
 SG_ Aftrtrtmnt2OtltNOxReadingStable : 0|2@1+ (1,0) [0|3] "" Vector__XXX
 SG_ Aftrtrtmnt2OtletGasSensorAtTemp : 0|2@1+ (1,0) [0|3] "" Vector__XXX
 SG_ Aftrtrtmnt2OtltGsSnsrPwrInRange : 0|2@1+ (1,0) [0|3] "" Vector__XXX
 SG_ Aftertreatment2OutletO2 : 0|16@1+ (0.000514,-12) [-12|21] "%" Vector__XXX
 SG_ Aftertreatment2OutletNOx : 0|16@1+ (0.05,-200) [-200|3012.75] "ppm" Vector__XXX
 SG_ Aftrtrtmnt2PrtcltTrpExhstGsTmpPr : 0|5@1+ (1,0) [0|31] "" Vector__XXX
 SG_ Aftrtrtmnt2ExhstGsTmp3PrlmnryFMI : 0|5@1+ (1,0) [0|31] "" Vector__XXX
 SG_ Aftrtrtmnt2PrtcltTrpOtltGasTemp : 0|16@1+ (0.03125,-273) [-273|1735] "°C" Vector__XXX
 SG_ Aftertreatment2ExhaustGasTemp3 : 0|16@1+ (0.03125,-273) [-273|1735] "°C" Vector__XXX
 SG_ PrtcltTrp2TmSncLstActvRgnration : 0|32@1+ (1,0) [0|4211081215] "sec" Vector__XXX
 SG_ ParticulateTrap2AshLoadPercent : 0|8@1+ (1,0) [0|250] "%" Vector__XXX
 SG_ ParticulateTrap2SootLoadPercent : 0|8@1+ (1,0) [0|250] "%" Vector__XXX
 SG_ Aftrtrtmnt2TrpNmbrOfActvRgnrtnMn : 0|32@1+ (1,0) [0|4294967295] "counts" Vector__XXX
 SG_ Aftrtrtmnt2TrpNmbrOfActvRgnrtnIn : 0|32@1+ (1,0) [0|4294967295] "counts" Vector__XXX
 SG_ Aftrtrtmnt2TrpNmbrOfPssvRgnrtns : 0|32@1+ (1,0) [0|4294967295] "counts" Vector__XXX
 SG_ Aftrtrtmnt2TrpPssvRgnrationTime : 0|32@1+ (1,0) [0|4211081215] "sec" Vector__XXX
 SG_ Aftrtrtmnt2TrpNmbrOfActvRgnrtns : 0|32@1+ (1,0) [0|4294967295] "counts" Vector__XXX
 SG_ Aftertreatment2TripDisabledTime : 0|32@1+ (1,0) [0|4211081215] "sec" Vector__XXX
 SG_ Aftrtrtmnt2TrpActvRgnrationTime : 0|32@1+ (1,0) [0|4211081215] "sec" Vector__XXX
 SG_ Aftertreatment2TripFuelUsed : 0|32@1+ (0.5,0) [0|2105540607.5] "L" Vector__XXX
 SG_ EngDerateRq : 0|8@1+ (0.4,0) [0|100] "%" Vector__XXX
 SG_ EngEmergencyShutdownIndication : 0|2@1+ (1,0) [0|3] "" Vector__XXX
 SG_ EngCtrlledShutdownRq : 0|2@1+ (1,0) [0|3] "" Vector__XXX
 SG_ EngCoolantCirculatingPumpCtrl : 0|2@1+ (1,0) [0|3] "" Vector__XXX
 SG_ EngBlock_CoolantPreheaterCtrl : 0|2@1+ (1,0) [0|3] "" Vector__XXX
 SG_ EngElctrclSystmPwrCnsrvtionCtrl : 0|2@1+ (1,0) [0|3] "" Vector__XXX
 SG_ EngOilPreheaterCtrl : 0|2@1+ (1,0) [0|3] "" Vector__XXX
 SG_ EngOilPrimingPumpCtrl : 0|2@1+ (1,0) [0|3] "" Vector__XXX
 SG_ EngFuelShutoffValveLeakTestCtrl : 0|2@1+ (1,0) [0|3] "" Vector__XXX
 SG_ EngFuelShutoff2Ctrl : 0|2@1+ (1,0) [0|3] "" Vector__XXX
 SG_ EngFuelShutoff1Ctrl : 0|2@1+ (1,0) [0|3] "" Vector__XXX
 SG_ EngFuelShutoffVentCtrl : 0|2@1+ (1,0) [0|3] "" Vector__XXX
 SG_ TmeRemainingInEngOperatingState : 0|16@1+ (1,0) [0|64255] "s" Vector__XXX
 SG_ FuelPumpPrimerCtrl : 0|2@1+ (1,0) [0|3] "" Vector__XXX
 SG_ EngOperatingState : 0|4@1+ (1,0) [0|15] "" Vector__XXX
 SG_ EngCoolantTemp2 : 0|8@1+ (1,-40) [-40|210] "deg" Vector__XXX
 SG_ NetVehicleWeightChange : 0|24@1+ (2,-16449535) [-16449535|16449535] "kg" Vector__XXX
 SG_ GrossCombinationWeight : 0|24@1+ (2,0) [0|32899070] "kg" Vector__XXX
 SG_ ValveAssemblySupplyPress : 0|16@1+ (5,0) [0|321275] "kPa" Vector__XXX
 SG_ ValveAssemblyLoadSensePress : 0|16@1+ (5,0) [0|321275] "kPa" Vector__XXX
 SG_ ValvePilotPress : 0|8@1+ (16,0) [0|4000] "kPa" Vector__XXX
 SG_ ValveLoadSensePress : 0|16@1+ (5,0) [0|321275] "kPa" Vector__XXX
 SG_ BellowPressRearAxleRight : 0|16@1+ (0.1,0) [0|6425.5] "kPa" Vector__XXX
 SG_ BellowPressRearAxleLeft : 0|16@1+ (0.1,0) [0|6425.5] "kPa" Vector__XXX
 SG_ BellowPressFrontAxleRight : 0|16@1+ (0.1,0) [0|6425.5] "kPa" Vector__XXX
 SG_ BellowPressFrontAxleLeft : 0|16@1+ (0.1,0) [0|6425.5] "kPa" Vector__XXX
 SG_ RelativeLevelRearAxleRight : 0|16@1+ (0.1,-3200) [-3200|3225.5] "mm" Vector__XXX
 SG_ RelativeLevelRearAxleLeft : 0|16@1+ (0.1,-3200) [-3200|3225.5] "mm" Vector__XXX
 SG_ RelativeLevelFrontAxleRight : 0|16@1+ (0.1,-3200) [-3200|3225.5] "mm" Vector__XXX
 SG_ RelativeLevelFrontAxleLeft : 0|16@1+ (0.1,-3200) [-3200|3225.5] "mm" Vector__XXX
 SG_ ProhibitAirSuspensionCtrl : 0|2@1+ (1,0) [0|3] "" Vector__XXX
 SG_ KneelingCmdRearAxle : 0|2@1+ (1,0) [0|3] "" Vector__XXX
 SG_ KneelingCmdFrontAxle : 0|2@1+ (1,0) [0|3] "" Vector__XXX
 SG_ DamperStiffnessRqLift_TagAxle : 0|8@1+ (0.4,0) [0|100] "%" Vector__XXX
 SG_ DamperStiffnessRqRearAxle : 0|8@1+ (0.4,0) [0|100] "%" Vector__XXX
 SG_ DamperStiffnessRqFrontAxle : 0|8@1+ (0.4,0) [0|100] "%" Vector__XXX
 SG_ LevelCtrlModeRq : 0|4@1+ (1,0) [0|15] "" Vector__XXX
 SG_ NominalLevelRqRearAxle : 0|4@1+ (1,0) [0|15] "" Vector__XXX
 SG_ NominalLevelRqFrontAxle : 0|4@1+ (1,0) [0|15] "" Vector__XXX
 SG_ KneelingCtrlModeRq : 0|2@1+ (1,0) [0|3] "" Vector__XXX
 SG_ KneelingRqRightSide : 0|2@1+ (1,0) [0|3] "" Vector__XXX
 SG_ KneelingRqLeftSide : 0|2@1+ (1,0) [0|3] "" Vector__XXX
 SG_ AutomaticTractionHelp : 0|2@1+ (1,0) [0|3] "" Vector__XXX
 SG_ LiftAxle2PosCmd : 0|2@1+ (1,0) [0|3] "" Vector__XXX
 SG_ LiftAxle1PosCmd : 0|2@1+ (1,0) [0|3] "" Vector__XXX
 SG_ SspensionCtrlRefusalInformation : 0|4@1+ (1,0) [0|15] "" Vector__XXX
 SG_ SuspensionRemoteCtrl2 : 0|2@1+ (1,0) [0|3] "" Vector__XXX
 SG_ SuspensionRemoteCtrl1 : 0|2@1+ (1,0) [0|3] "" Vector__XXX
 SG_ RearAxleInBumperRange : 0|2@1+ (1,0) [0|3] "" Vector__XXX
 SG_ FrontAxleInBumperRange : 0|2@1+ (1,0) [0|3] "" Vector__XXX
 SG_ DoorRelease : 0|2@1+ (1,0) [0|3] "" Vector__XXX
 SG_ VehicleMotionInhibit : 0|2@1+ (1,0) [0|3] "" Vector__XXX
 SG_ SecurityDevice : 0|2@1+ (1,0) [0|3] "" Vector__XXX
 SG_ LevelCtrlMode : 0|4@1+ (1,0) [0|15] "" Vector__XXX
 SG_ KneelingInformation : 0|4@1+ (1,0) [0|15] "" Vector__XXX
 SG_ LiftingCtrlModeRearAxle : 0|2@1+ (1,0) [0|3] "" Vector__XXX
 SG_ LiftingCtrlModeFrontAxle : 0|2@1+ (1,0) [0|3] "" Vector__XXX
 SG_ LoweringCtrlModeRearAxle : 0|2@1+ (1,0) [0|3] "" Vector__XXX
 SG_ LoweringCtrlModeFrontAxle : 0|2@1+ (1,0) [0|3] "" Vector__XXX
 SG_ AboveNominalLevelRearAxle : 0|2@1+ (1,0) [0|3] "" Vector__XXX
 SG_ AboveNominalLevelFrontAxle : 0|2@1+ (1,0) [0|3] "" Vector__XXX
 SG_ BelowNominalLevelRearAxle : 0|2@1+ (1,0) [0|3] "" Vector__XXX
 SG_ BelowNominalLevelFrontAxle : 0|2@1+ (1,0) [0|3] "" Vector__XXX
 SG_ NominalLevelRearAxle : 0|4@1+ (1,0) [0|15] "" Vector__XXX
 SG_ NominalLevelFrontAxle : 0|4@1+ (1,0) [0|15] "" Vector__XXX
 SG_ Alt4Status : 0|2@1+ (1,0) [0|3] "" Vector__XXX
 SG_ Alt3Status : 0|2@1+ (1,0) [0|3] "" Vector__XXX
 SG_ Alt2Status : 0|2@1+ (1,0) [0|3] "" Vector__XXX
 SG_ Alt1Status : 0|2@1+ (1,0) [0|3] "" Vector__XXX
 SG_ AltSpeed : 0|16@1+ (0.5,0) [0|32127.5] "RPM" Vector__XXX
 SG_ AuxAbsPressReading : 0|16@1+ (0.5,0) [0|32127.5] "kPa" Vector__XXX
 SG_ AuxGagePressReading1 : 0|16@1+ (0.5,0) [0|32127.5] "kPa" Vector__XXX
 SG_ AuxVacuumPressReading : 0|16@1+ (0.5,0) [0|32127.5] "kPa" Vector__XXX
 SG_ SolarSensorMax : 0|8@1+ (0.4,0) [0|100] "mW/cm²" Vector__XXX
 SG_ SolarIntensityPercent : 0|8@1+ (0.4,0) [0|100] "%" Vector__XXX
 SG_ TestIdentifier : 0|8@1+ (1,0) [1|64] "" Vector__XXX
 SG_ FlashRedStopLamp : 0|2@1+ (1,0) [0|3] "" Vector__XXX
 SG_ FlashProtectLamp : 0|2@1+ (1,0) [0|3] "" Vector__XXX
 SG_ FlashMalfuncIndicatorLamp : 0|2@1+ (1,0) [0|3] "" Vector__XXX
 SG_ FlashAmberWarningLamp : 0|2@1+ (1,0) [0|3] "" Vector__XXX
 SG_ MalfunctionIndicatorLampStatus : 0|2@1+ (1,0) [0|3] "" Vector__XXX
 SG_ RedStopLampState : 0|2@1+ (1,0) [0|3] "" Vector__XXX
 SG_ AmberWarningLampStatus : 0|2@1+ (1,0) [0|3] "" Vector__XXX
 SG_ ProtectLampStatus : 0|2@1+ (1,0) [0|3] "" Vector__XXX
 SG_ DTC5 : 0|32@1+ (1,0) [0|4294967295] "" Vector__XXX
 SG_ DTC4 : 0|32@1+ (1,0) [0|4294967295] "" Vector__XXX
 SG_ DTC3 : 0|32@1+ (1,0) [0|4294967295] "" Vector__XXX
 SG_ DTC2 : 0|32@1+ (1,0) [0|4294967295] "" Vector__XXX
 SG_ DTC1 : 0|32@1+ (1,0) [0|4294967295] "" Vector__XXX
 SG_ UtlityOverallPowerFactorLagging : 0|2@1+ (1,0) [0|3] "" Vector__XXX
 SG_ UtilityOverallPowerFactor : 0|16@1+ (1,-1) [-1|2.92181] "" Vector__XXX
 SG_ UtilityTotalReactivePower : 0|32@1+ (1,-2000000000) [-2000000000|2211081215] "VA" Vector__XXX
 SG_ UtilityTotalApparentPower : 0|32@1+ (1,-2000000000) [-2000000000|2211081215] "VA" Vector__XXX
 SG_ UtilityTotalRealPower : 0|32@1+ (1,-2000000000) [-2000000000|2211081215] "VA" Vector__XXX
 SG_ UtilityTotalKWHoursImport : 0|32@1+ (1,0) [0|4211081215] "kWh" Vector__XXX
 SG_ UtilityTotalKWHoursExport : 0|32@1+ (1,0) [0|4211081215] "kWh" Vector__XXX
 SG_ UtilityPhaseCPowerFactorLagging : 0|2@1+ (1,0) [0|3] "" Vector__XXX
 SG_ UtilityPhaseCPowerFactor : 0|16@1+ (1,-1) [-1|2.92181] "" Vector__XXX
 SG_ UtilityPhaseCReactivePower : 0|32@1+ (1,-2000000000) [-2000000000|2211081215] "VA" Vector__XXX
 SG_ UtilityPhaseCApparentPower : 0|32@1+ (1,-2000000000) [-2000000000|2211081215] "VA" Vector__XXX
 SG_ UtilityPhaseCRealPower : 0|32@1+ (1,-2000000000) [-2000000000|2211081215] "VA" Vector__XXX
 SG_ UtilityPhaseCACRMSCurrent : 0|16@1+ (1,0) [0|64255] "A" Vector__XXX
 SG_ UtilityPhaseCACFrequency : 0|16@1+ (1,0) [0|501.9921875] "Hz" Vector__XXX
 SG_ UtltyPhsCLneNeutralACRMSVoltage : 0|16@1+ (1,0) [0|64255] "V" Vector__XXX
 SG_ UtltyPhseCALineLineACRMSVoltage : 0|16@1+ (1,0) [0|64255] "V" Vector__XXX
 SG_ UtilityPhaseBPowerFactorLagging : 0|2@1+ (1,0) [0|3] "" Vector__XXX
 SG_ UtilityPhaseBPowerFactor : 0|16@1+ (1,-1) [-1|2.92181] "" Vector__XXX
 SG_ UtilityPhaseBReactivePower : 0|32@1+ (1,-2000000000) [-2000000000|2211081215] "VA" Vector__XXX
 SG_ UtilityPhaseBApparentPower : 0|32@1+ (1,-2000000000) [-2000000000|2211081215] "VA" Vector__XXX
 SG_ UtilityPhaseBRealPower : 0|32@1+ (1,-2000000000) [-2000000000|2211081215] "VA" Vector__XXX
 SG_ UtilityPhaseBACRMSCurrent : 0|16@1+ (1,0) [0|64255] "A" Vector__XXX
 SG_ UtilityPhaseBACFrequency : 0|16@1+ (1,0) [0|501.9921875] "Hz" Vector__XXX
 SG_ UtltyPhsBLneNeutralACRMSVoltage : 0|16@1+ (1,0) [0|64255] "V" Vector__XXX
 SG_ UtltyPhseBCLineLineACRMSVoltage : 0|16@1+ (1,0) [0|64255] "V" Vector__XXX
 SG_ UtilityPhaseAPowerFactorLagging : 0|2@1+ (1,0) [0|3] "" Vector__XXX
 SG_ UtilityPhaseAPowerFactor : 0|16@1+ (1,-1) [-1|2.92181] "" Vector__XXX
 SG_ UtilityPhaseAReactivePower : 0|32@1+ (1,-2000000000) [-2000000000|2211081215] "VA" Vector__XXX
 SG_ UtilityPhaseAApparentPower : 0|32@1+ (1,-2000000000) [-2000000000|2211081215] "VA" Vector__XXX
 SG_ UtilityPhaseARealPower : 0|32@1+ (1,-2000000000) [-2000000000|2211081215] "VA" Vector__XXX
 SG_ UtilityPhaseAACRMSCurrent : 0|16@1+ (1,0) [0|64255] "A" Vector__XXX
 SG_ UtilityPhaseAACFrequency : 0|16@1+ (1,0) [0|501.9921875] "Hz" Vector__XXX
 SG_ UtltyPhsALneNeutralACRMSVoltage : 0|16@1+ (1,0) [0|64255] "V" Vector__XXX
 SG_ UtltyPhseABLineLineACRMSVoltage : 0|16@1+ (1,0) [0|64255] "V" Vector__XXX
 SG_ UtilityAverageACRMSCurrent : 0|16@1+ (1,0) [0|64255] "A" Vector__XXX
 SG_ UtilityAverageACFrequency : 0|16@1+ (1,0) [0|501.9921875] "Hz" Vector__XXX
 SG_ UtltyAvrgLneNeutralACRMSVoltage : 0|16@1+ (1,0) [0|64255] "V" Vector__XXX
 SG_ UtltyAvrageLineLineACRMSVoltage : 0|16@1+ (1,0) [0|64255] "V" Vector__XXX
 SG_ GnrtorOverallPowerFactorLagging : 0|2@1+ (1,0) [0|3] "" Vector__XXX
 SG_ GeneratorOverallPowerFactor : 0|16@1+ (1,-1) [-1|2.92181] "" Vector__XXX
 SG_ GeneratorTotalReactivePower : 0|32@1+ (1,-2000000000) [-2000000000|2211081215] "VA" Vector__XXX
 SG_ GeneratorTotalApparentPower : 0|32@1+ (1,-2000000000) [-2000000000|2211081215] "VA" Vector__XXX
 SG_ GeneratorTotalRealPower : 0|32@1+ (1,-2000000000) [-2000000000|2211081215] "VA" Vector__XXX
 SG_ GeneratorTotalKWHoursImport : 0|32@1+ (1,0) [0|4211081215] "kWh" Vector__XXX
 SG_ GeneratorTotalKWHoursExport : 0|32@1+ (1,0) [0|4211081215] "kWh" Vector__XXX
 SG_ GnratorPhaseCPowerFactorLagging : 0|2@1+ (1,0) [0|3] "" Vector__XXX
 SG_ GeneratorPhaseCPowerFactor : 0|16@1+ (1,-1) [-1|2.92181] "" Vector__XXX
 SG_ GeneratorPhaseCReactivePower : 0|32@1+ (1,-2000000000) [-2000000000|2211081215] "VA" Vector__XXX
 SG_ GeneratorPhaseCApparentPower : 0|32@1+ (1,-2000000000) [-2000000000|2211081215] "VA" Vector__XXX
 SG_ GeneratorPhaseCRealPower : 0|32@1+ (1,-2000000000) [-2000000000|2211081215] "VA" Vector__XXX
 SG_ GeneratorPhaseCACRMSCurrent : 0|16@1+ (1,0) [0|64255] "A" Vector__XXX
 SG_ GeneratorPhaseCACFrequency : 0|16@1+ (1,0) [0|501.9921875] "Hz" Vector__XXX
 SG_ GnrtrPhsCLneNeutralACRMSVoltage : 0|16@1+ (1,0) [0|64255] "V" Vector__XXX
 SG_ GnrtrPhseCALineLineACRMSVoltage : 0|16@1+ (1,0) [0|64255] "V" Vector__XXX
 SG_ GnratorPhaseBPowerFactorLagging : 0|2@1+ (1,0) [0|3] "" Vector__XXX
 SG_ GeneratorPhaseBPowerFactor : 0|16@1+ (1,-1) [-1|2.92181] "" Vector__XXX
 SG_ GeneratorPhaseBReactivePower : 0|32@1+ (1,-2000000000) [-2000000000|2211081215] "VA" Vector__XXX
 SG_ GeneratorPhaseBApparentPower : 0|32@1+ (1,-2000000000) [-2000000000|2211081215] "VA" Vector__XXX
 SG_ GeneratorPhaseBRealPower : 0|32@1+ (1,-2000000000) [-2000000000|2211081215] "VA" Vector__XXX
 SG_ GeneratorPhaseBACRMSCurrent : 0|16@1+ (1,0) [0|64255] "A" Vector__XXX
 SG_ GeneratorPhaseBACFrequency : 0|16@1+ (1,0) [0|501.9921875] "Hz" Vector__XXX
 SG_ GnrtrPhsBLneNeutralACRMSVoltage : 0|16@1+ (1,0) [0|64255] "V" Vector__XXX
 SG_ GnrtrPhseBCLineLineACRMSVoltage : 0|16@1+ (1,0) [0|64255] "V" Vector__XXX
 SG_ GnratorPhaseAPowerFactorLagging : 0|2@1+ (1,0) [0|3] "" Vector__XXX
 SG_ GeneratorPhaseAPowerFactor : 0|16@1+ (1,-1) [-1|2.92181] "" Vector__XXX
 SG_ GeneratorPhaseAReactivePower : 0|32@1+ (1,-2000000000) [-2000000000|2211081215] "VA" Vector__XXX
 SG_ GeneratorPhaseAApparentPower : 0|32@1+ (1,-2000000000) [-2000000000|2211081215] "VA" Vector__XXX
 SG_ FlashRedStopLamp : 0|2@1+ (1,0) [0|3] "" Vector__XXX
 SG_ FlashProtectLamp : 0|2@1+ (1,0) [0|3] "" Vector__XXX
 SG_ FlashMalfuncIndicatorLamp : 0|2@1+ (1,0) [0|3] "" Vector__XXX
 SG_ FlashAmberWarningLamp : 0|2@1+ (1,0) [0|3] "" Vector__XXX
 SG_ MalfunctionIndicatorLampStatus : 0|2@1+ (1,0) [0|3] "" Vector__XXX
 SG_ AmberWarningLampStatus : 0|2@1+ (1,0) [0|3] "" Vector__XXX
 SG_ RedStopLampState : 0|2@1+ (1,0) [0|3] "" Vector__XXX
 SG_ ProtectLampStatus : 0|2@1+ (1,0) [0|3] "" Vector__XXX
 SG_ DTC5 : 0|32@1+ (1,0) [0|4294967295] "" Vector__XXX
 SG_ DTC4 : 0|32@1+ (1,0) [0|4294967295] "" Vector__XXX
 SG_ DTC3 : 0|32@1+ (1,0) [0|4294967295] "" Vector__XXX
 SG_ DTC2 : 0|32@1+ (1,0) [0|4294967295] "" Vector__XXX
 SG_ DTC1 : 0|32@1+ (1,0) [0|4294967295] "" Vector__XXX
 SG_ FlashRedStopLamp : 0|2@1+ (1,0) [0|3] "" Vector__XXX
 SG_ FlashProtectLamp : 0|2@1+ (1,0) [0|3] "" Vector__XXX
 SG_ FlashMalfuncIndicatorLamp : 0|2@1+ (1,0) [0|3] "" Vector__XXX
 SG_ FlashAmberWarningLamp : 0|2@1+ (1,0) [0|3] "" Vector__XXX
 SG_ MalfunctionIndicatorLampStatus : 0|2@1+ (1,0) [0|3] "" Vector__XXX
 SG_ AmberWarningLampStatus : 0|2@1+ (1,0) [0|3] "" Vector__XXX
 SG_ RedStopLampState : 0|2@1+ (1,0) [0|3] "" Vector__XXX
 SG_ ProtectLampStatus : 0|2@1+ (1,0) [0|3] "" Vector__XXX
 SG_ DTC5 : 0|32@1+ (1,0) [0|4294967295] "" Vector__XXX
 SG_ DTC4 : 0|32@1+ (1,0) [0|4294967295] "" Vector__XXX
 SG_ DTC3 : 0|32@1+ (1,0) [0|4294967295] "" Vector__XXX
 SG_ DTC2 : 0|32@1+ (1,0) [0|4294967295] "" Vector__XXX
 SG_ DTC1 : 0|32@1+ (1,0) [0|4294967295] "" Vector__XXX
 SG_ FlashRedStopLamp : 0|2@1+ (1,0) [0|3] "" Vector__XXX
 SG_ FlashProtectLamp : 0|2@1+ (1,0) [0|3] "" Vector__XXX
 SG_ FlashMalfuncIndicatorLamp : 0|2@1+ (1,0) [0|3] "" Vector__XXX
 SG_ FlashAmberWarningLamp : 0|2@1+ (1,0) [0|3] "" Vector__XXX
 SG_ MalfunctionIndicatorLampStatus : 0|2@1+ (1,0) [0|3] "" Vector__XXX
 SG_ AmberWarningLampStatus : 0|2@1+ (1,0) [0|3] "" Vector__XXX
 SG_ RedStopLampState : 0|2@1+ (1,0) [0|3] "" Vector__XXX
 SG_ ProtectLampStatus : 0|2@1+ (1,0) [0|3] "" Vector__XXX
 SG_ DTC5 : 0|32@1+ (1,0) [0|4294967295] "" Vector__XXX
 SG_ DTC4 : 0|32@1+ (1,0) [0|4294967295] "" Vector__XXX
 SG_ DTC3 : 0|32@1+ (1,0) [0|4294967295] "" Vector__XXX
 SG_ DTC2 : 0|32@1+ (1,0) [0|4294967295] "" Vector__XXX
 SG_ DTC1 : 0|32@1+ (1,0) [0|4294967295] "" Vector__XXX
 SG_ FlashRedStopLamp : 0|2@1+ (1,0) [0|3] "" Vector__XXX
 SG_ FlashProtectLamp : 0|2@1+ (1,0) [0|3] "" Vector__XXX
 SG_ FlashMalfuncIndicatorLamp : 0|2@1+ (1,0) [0|3] "" Vector__XXX
 SG_ FlashAmberWarningLamp : 0|2@1+ (1,0) [0|3] "" Vector__XXX
 SG_ MalfunctionIndicatorLampStatus : 0|2@1+ (1,0) [0|3] "" Vector__XXX
 SG_ AmberWarningLampStatus : 0|2@1+ (1,0) [0|3] "" Vector__XXX
 SG_ RedStopLampState : 0|2@1+ (1,0) [0|3] "" Vector__XXX
 SG_ ProtectLampStatus : 0|2@1+ (1,0) [0|3] "" Vector__XXX
 SG_ DTC5 : 0|32@1+ (1,0) [0|4294967295] "" Vector__XXX
 SG_ DTC4 : 0|32@1+ (1,0) [0|4294967295] "" Vector__XXX
 SG_ DTC3 : 0|32@1+ (1,0) [0|4294967295] "" Vector__XXX
 SG_ DTC2 : 0|32@1+ (1,0) [0|4294967295] "" Vector__XXX
 SG_ DTC1 : 0|32@1+ (1,0) [0|4294967295] "" Vector__XXX
 SG_ FlashRedStopLamp : 0|2@1+ (1,0) [0|3] "" Vector__XXX
 SG_ FlashProtectLamp : 0|2@1+ (1,0) [0|3] "" Vector__XXX
 SG_ FlashMalfuncIndicatorLamp : 0|2@1+ (1,0) [0|3] "" Vector__XXX
 SG_ FlashAmberWarningLamp : 0|2@1+ (1,0) [0|3] "" Vector__XXX
 SG_ MalfunctionIndicatorLampStatus : 0|2@1+ (1,0) [0|3] "" Vector__XXX
 SG_ AmberWarningLampStatus : 0|2@1+ (1,0) [0|3] "" Vector__XXX
 SG_ RedStopLampState : 0|2@1+ (1,0) [0|3] "" Vector__XXX
 SG_ ProtectLampStatus : 0|2@1+ (1,0) [0|3] "" Vector__XXX
 SG_ DTC5 : 0|32@1+ (1,0) [0|4294967295] "" Vector__XXX
 SG_ DTC4 : 0|32@1+ (1,0) [0|4294967295] "" Vector__XXX
 SG_ DTC3 : 0|32@1+ (1,0) [0|4294967295] "" Vector__XXX
 SG_ DTC2 : 0|32@1+ (1,0) [0|4294967295] "" Vector__XXX
 SG_ DTC1 : 0|32@1+ (1,0) [0|4294967295] "" Vector__XXX
 SG_ FlashRedStopLamp : 0|2@1+ (1,0) [0|3] "" Vector__XXX
 SG_ FlashProtectLamp : 0|2@1+ (1,0) [0|3] "" Vector__XXX
 SG_ FlashMalfuncIndicatorLamp : 0|2@1+ (1,0) [0|3] "" Vector__XXX
 SG_ FlashAmberWarningLamp : 0|2@1+ (1,0) [0|3] "" Vector__XXX
 SG_ MalfunctionIndicatorLampStatus : 0|2@1+ (1,0) [0|3] "" Vector__XXX
 SG_ AmberWarningLampStatus : 0|2@1+ (1,0) [0|3] "" Vector__XXX
 SG_ RedStopLampState : 0|2@1+ (1,0) [0|3] "" Vector__XXX
 SG_ ProtectLampStatus : 0|2@1+ (1,0) [0|3] "" Vector__XXX
 SG_ DTC5 : 0|32@1+ (1,0) [0|4294967295] "" Vector__XXX
 SG_ DTC4 : 0|32@1+ (1,0) [0|4294967295] "" Vector__XXX
 SG_ DTC3 : 0|32@1+ (1,0) [0|4294967295] "" Vector__XXX
 SG_ DTC2 : 0|32@1+ (1,0) [0|4294967295] "" Vector__XXX
 SG_ DTC1 : 0|32@1+ (1,0) [0|4294967295] "" Vector__XXX
 SG_ FlashRedStopLamp : 0|2@1+ (1,0) [0|3] "" Vector__XXX
 SG_ FlashProtectLamp : 0|2@1+ (1,0) [0|3] "" Vector__XXX
 SG_ FlashMalfuncIndicatorLamp : 0|2@1+ (1,0) [0|3] "" Vector__XXX
 SG_ FlashAmberWarningLamp : 0|2@1+ (1,0) [0|3] "" Vector__XXX
 SG_ MalfunctionIndicatorLampStatus : 0|2@1+ (1,0) [0|3] "" Vector__XXX
 SG_ AmberWarningLampStatus : 0|2@1+ (1,0) [0|3] "" Vector__XXX
 SG_ RedStopLampState : 0|2@1+ (1,0) [0|3] "" Vector__XXX
 SG_ ProtectLampStatus : 0|2@1+ (1,0) [0|3] "" Vector__XXX
 SG_ DTC5 : 0|32@1+ (1,0) [0|4294967295] "" Vector__XXX
 SG_ DTC4 : 0|32@1+ (1,0) [0|4294967295] "" Vector__XXX
 SG_ DTC3 : 0|32@1+ (1,0) [0|4294967295] "" Vector__XXX
 SG_ DTC2 : 0|32@1+ (1,0) [0|4294967295] "" Vector__XXX
 SG_ DTC1 : 0|32@1+ (1,0) [0|4294967295] "" Vector__XXX
 SG_ FlashRedStopLamp : 0|2@1+ (1,0) [0|3] "" Vector__XXX
 SG_ FlashProtectLamp : 0|2@1+ (1,0) [0|3] "" Vector__XXX
 SG_ FlashMalfuncIndicatorLamp : 0|2@1+ (1,0) [0|3] "" Vector__XXX
 SG_ FlashAmberWarningLamp : 0|2@1+ (1,0) [0|3] "" Vector__XXX
 SG_ MalfunctionIndicatorLampStatus : 0|2@1+ (1,0) [0|3] "" Vector__XXX
 SG_ AmberWarningLampStatus : 0|2@1+ (1,0) [0|3] "" Vector__XXX
 SG_ RedStopLampState : 0|2@1+ (1,0) [0|3] "" Vector__XXX
 SG_ ProtectLampStatus : 0|2@1+ (1,0) [0|3] "" Vector__XXX
 SG_ DTC5 : 0|32@1+ (1,0) [0|4294967295] "" Vector__XXX
 SG_ DTC4 : 0|32@1+ (1,0) [0|4294967295] "" Vector__XXX
 SG_ DTC3 : 0|32@1+ (1,0) [0|4294967295] "" Vector__XXX
 SG_ DTC2 : 0|32@1+ (1,0) [0|4294967295] "" Vector__XXX
 SG_ DTC1 : 0|32@1+ (1,0) [0|4294967295] "" Vector__XXX
 SG_ FlashRedStopLamp : 0|2@1+ (1,0) [0|3] "" Vector__XXX
 SG_ FlashProtectLamp : 0|2@1+ (1,0) [0|3] "" Vector__XXX
 SG_ FlashMalfuncIndicatorLamp : 0|2@1+ (1,0) [0|3] "" Vector__XXX
 SG_ FlashAmberWarningLamp : 0|2@1+ (1,0) [0|3] "" Vector__XXX
 SG_ MalfunctionIndicatorLampStatus : 0|2@1+ (1,0) [0|3] "" Vector__XXX
 SG_ AmberWarningLampStatus : 0|2@1+ (1,0) [0|3] "" Vector__XXX
 SG_ RedStopLampState : 0|2@1+ (1,0) [0|3] "" Vector__XXX
 SG_ ProtectLampStatus : 0|2@1+ (1,0) [0|3] "" Vector__XXX
 SG_ DTC5 : 0|32@1+ (1,0) [0|4294967295] "" Vector__XXX
 SG_ DTC4 : 0|32@1+ (1,0) [0|4294967295] "" Vector__XXX
 SG_ DTC3 : 0|32@1+ (1,0) [0|4294967295] "" Vector__XXX
 SG_ DTC2 : 0|32@1+ (1,0) [0|4294967295] "" Vector__XXX
 SG_ DTC1 : 0|32@1+ (1,0) [0|4294967295] "" Vector__XXX
 SG_ FlashRedStopLamp : 0|2@1+ (1,0) [0|3] "" Vector__XXX
 SG_ FlashProtectLamp : 0|2@1+ (1,0) [0|3] "" Vector__XXX
 SG_ FlashMalfuncIndicatorLamp : 0|2@1+ (1,0) [0|3] "" Vector__XXX
 SG_ FlashAmberWarningLamp : 0|2@1+ (1,0) [0|3] "" Vector__XXX
 SG_ MalfunctionIndicatorLampStatus : 0|2@1+ (1,0) [0|3] "" Vector__XXX
 SG_ AmberWarningLampStatus : 0|2@1+ (1,0) [0|3] "" Vector__XXX
 SG_ RedStopLampState : 0|2@1+ (1,0) [0|3] "" Vector__XXX
 SG_ ProtectLampStatus : 0|2@1+ (1,0) [0|3] "" Vector__XXX
 SG_ DTC5 : 0|32@1+ (1,0) [0|4294967295] "" Vector__XXX
 SG_ DTC4 : 0|32@1+ (1,0) [0|4294967295] "" Vector__XXX
 SG_ DTC3 : 0|32@1+ (1,0) [0|4294967295] "" Vector__XXX
 SG_ DTC2 : 0|32@1+ (1,0) [0|4294967295] "" Vector__XXX
 SG_ DTC1 : 0|32@1+ (1,0) [0|4294967295] "" Vector__XXX
 SG_ FlashRedStopLamp : 0|2@1+ (1,0) [0|3] "" Vector__XXX
 SG_ FlashProtectLamp : 0|2@1+ (1,0) [0|3] "" Vector__XXX
 SG_ FlashMalfuncIndicatorLamp : 0|2@1+ (1,0) [0|3] "" Vector__XXX
 SG_ FlashAmberWarningLamp : 0|2@1+ (1,0) [0|3] "" Vector__XXX
 SG_ MalfunctionIndicatorLampStatus : 0|2@1+ (1,0) [0|3] "" Vector__XXX
 SG_ AmberWarningLampStatus : 0|2@1+ (1,0) [0|3] "" Vector__XXX
 SG_ RedStopLampState : 0|2@1+ (1,0) [0|3] "" Vector__XXX
 SG_ ProtectLampStatus : 0|2@1+ (1,0) [0|3] "" Vector__XXX
 SG_ DTC5 : 0|32@1+ (1,0) [0|4294967295] "" Vector__XXX
 SG_ DTC4 : 0|32@1+ (1,0) [0|4294967295] "" Vector__XXX
 SG_ DTC3 : 0|32@1+ (1,0) [0|4294967295] "" Vector__XXX
 SG_ DTC2 : 0|32@1+ (1,0) [0|4294967295] "" Vector__XXX
 SG_ DTC1 : 0|32@1+ (1,0) [0|4294967295] "" Vector__XXX
 SG_ FlashRedStopLamp : 0|2@1+ (1,0) [0|3] "" Vector__XXX
 SG_ FlashProtectLamp : 0|2@1+ (1,0) [0|3] "" Vector__XXX
 SG_ FlashMalfuncIndicatorLamp : 0|2@1+ (1,0) [0|3] "" Vector__XXX
 SG_ FlashAmberWarningLamp : 0|2@1+ (1,0) [0|3] "" Vector__XXX
 SG_ MalfunctionIndicatorLampStatus : 0|2@1+ (1,0) [0|3] "" Vector__XXX
 SG_ AmberWarningLampStatus : 0|2@1+ (1,0) [0|3] "" Vector__XXX
 SG_ RedStopLampState : 0|2@1+ (1,0) [0|3] "" Vector__XXX
 SG_ ProtectLampStatus : 0|2@1+ (1,0) [0|3] "" Vector__XXX
 SG_ DTC5 : 0|32@1+ (1,0) [0|4294967295] "" Vector__XXX
 SG_ DTC4 : 0|32@1+ (1,0) [0|4294967295] "" Vector__XXX
 SG_ DTC3 : 0|32@1+ (1,0) [0|4294967295] "" Vector__XXX
 SG_ DTC2 : 0|32@1+ (1,0) [0|4294967295] "" Vector__XXX
 SG_ DTC1 : 0|32@1+ (1,0) [0|4294967295] "" Vector__XXX
 SG_ FlashRedStopLamp : 0|2@1+ (1,0) [0|3] "" Vector__XXX
 SG_ FlashProtectLamp : 0|2@1+ (1,0) [0|3] "" Vector__XXX
 SG_ FlashMalfuncIndicatorLamp : 0|2@1+ (1,0) [0|3] "" Vector__XXX
 SG_ FlashAmberWarningLamp : 0|2@1+ (1,0) [0|3] "" Vector__XXX
 SG_ MalfunctionIndicatorLampStatus : 0|2@1+ (1,0) [0|3] "" Vector__XXX
 SG_ AmberWarningLampStatus : 0|2@1+ (1,0) [0|3] "" Vector__XXX
 SG_ RedStopLampState : 0|2@1+ (1,0) [0|3] "" Vector__XXX
 SG_ ProtectLampStatus : 0|2@1+ (1,0) [0|3] "" Vector__XXX
 SG_ DTC5 : 0|32@1+ (1,0) [0|4294967295] "" Vector__XXX
 SG_ DTC4 : 0|32@1+ (1,0) [0|4294967295] "" Vector__XXX
 SG_ DTC3 : 0|32@1+ (1,0) [0|4294967295] "" Vector__XXX
 SG_ DTC2 : 0|32@1+ (1,0) [0|4294967295] "" Vector__XXX
 SG_ DTC1 : 0|32@1+ (1,0) [0|4294967295] "" Vector__XXX
 SG_ FlashRedStopLamp : 0|2@1+ (1,0) [0|3] "" Vector__XXX
 SG_ FlashProtectLamp : 0|2@1+ (1,0) [0|3] "" Vector__XXX
 SG_ FlashMalfuncIndicatorLamp : 0|2@1+ (1,0) [0|3] "" Vector__XXX
 SG_ FlashAmberWarningLamp : 0|2@1+ (1,0) [0|3] "" Vector__XXX
 SG_ MalfunctionIndicatorLampStatus : 0|2@1+ (1,0) [0|3] "" Vector__XXX
 SG_ AmberWarningLampStatus : 0|2@1+ (1,0) [0|3] "" Vector__XXX
 SG_ RedStopLampState : 0|2@1+ (1,0) [0|3] "" Vector__XXX
 SG_ ProtectLampStatus : 0|2@1+ (1,0) [0|3] "" Vector__XXX
 SG_ DTC5 : 0|32@1+ (1,0) [0|4294967295] "" Vector__XXX
 SG_ DTC4 : 0|32@1+ (1,0) [0|4294967295] "" Vector__XXX
 SG_ DTC3 : 0|32@1+ (1,0) [0|4294967295] "" Vector__XXX
 SG_ DTC2 : 0|32@1+ (1,0) [0|4294967295] "" Vector__XXX
 SG_ DTC1 : 0|32@1+ (1,0) [0|4294967295] "" Vector__XXX
 SG_ FlashRedStopLamp : 0|2@1+ (1,0) [0|3] "" Vector__XXX
 SG_ FlashProtectLamp : 0|2@1+ (1,0) [0|3] "" Vector__XXX
 SG_ FlashMalfuncIndicatorLamp : 0|2@1+ (1,0) [0|3] "" Vector__XXX
 SG_ FlashAmberWarningLamp : 0|2@1+ (1,0) [0|3] "" Vector__XXX
 SG_ MalfunctionIndicatorLampStatus : 0|2@1+ (1,0) [0|3] "" Vector__XXX
 SG_ AmberWarningLampStatus : 0|2@1+ (1,0) [0|3] "" Vector__XXX
 SG_ RedStopLampState : 0|2@1+ (1,0) [0|3] "" Vector__XXX
 SG_ ProtectLampStatus : 0|2@1+ (1,0) [0|3] "" Vector__XXX
 SG_ DTC5 : 0|32@1+ (1,0) [0|4294967295] "" Vector__XXX
 SG_ DTC4 : 0|32@1+ (1,0) [0|4294967295] "" Vector__XXX
 SG_ DTC3 : 0|32@1+ (1,0) [0|4294967295] "" Vector__XXX
 SG_ DTC2 : 0|32@1+ (1,0) [0|4294967295] "" Vector__XXX
 SG_ DTC1 : 0|32@1+ (1,0) [0|4294967295] "" Vector__XXX

CM_ SG_ 3221225472 EngStartEnableDevice1Config "The start enable device installed for start enable device 1.";
CM_ SG_ 3221225472 EngStartEnableDevice2 "Devices that assist an engine in starting, e.";
CM_ SG_ 3221225472 EngStartEnableDevice1 "Devices that assist an Engine in starting, e.";
CM_ SG_ 3221225472 PoweredVehicleWeight "Total mass imposed by the tires of the powered vehicle on the road surface.";
CM_ SG_ 3221225472 GrossCombinationVehicleWeight "The total weight of the truck and all attached trailers.";
CM_ SG_ 3221225472 EngAverageCombustionTime "The average combustion time of all cylinders of an engine.";
CM_ SG_ 3221225472 EngDesiredCombustionTime "The desired combustion time based upon engine load and speed lookup maps.";
CM_ SG_ 3221225472 EngCyl20CombustionTime "The amount of time from when the ignition of the fuel is initiated to when the fuel is completely ignited (i.";
CM_ SG_ 3221225472 EngCyl19CombustionTime "The amount of time from when the ignition of the fuel is initiated to when the fuel is completely ignited (i.";
CM_ SG_ 3221225472 EngCyl18CombustionTime "The amount of time from when the ignition of the fuel is initiated to when the fuel is completely ignited (i.";
CM_ SG_ 3221225472 EngCyl17CombustionTime "The amount of time from when the ignition of the fuel is initiated to when the fuel is completely ignited (i.";
CM_ SG_ 3221225472 EngCyl16CombustionTime "The amount of time from when the ignition of the fuel is initiated to when the fuel is completely ignited (i.";
CM_ SG_ 3221225472 EngCyl15CombustionTime "The amount of time from when the ignition of the fuel is initiated to when the fuel is completely ignited (i.";
CM_ SG_ 3221225472 EngCyl14CombustionTime "The amount of time from when the ignition of the fuel is initiated to when the fuel is completely ignited (i.";
CM_ SG_ 3221225472 EngCyl13CombustionTime "The amount of time from when the ignition of the fuel is initiated to when the fuel is completely ignited (i.";
CM_ SG_ 3221225472 EngCyl12CombustionTime "The amount of time from when the ignition of the fuel is initiated to when the fuel is completely ignited (i.";
CM_ SG_ 3221225472 EngCyl11CombustionTime "The amount of time from when the ignition of the fuel is initiated to when the fuel is completely ignited (i.";
CM_ SG_ 3221225472 EngCyl10CombustionTime "The amount of time from when the ignition of the fuel is initiated to when the fuel is completely ignited (i.";
CM_ SG_ 3221225472 EngCyl9CombustionTime "The amount of time from when the ignition of the fuel is initiated to when the fuel is completely ignited (i.";
CM_ SG_ 3221225472 EngCyl8CombustionTime "The amount of time from when the ignition of the fuel is initiated to when the fuel is completely ignited (i.";
CM_ SG_ 3221225472 EngCyl7CombustionTime "The amount of time from when the ignition of the fuel is initiated to when the fuel is completely ignited (i.";
CM_ SG_ 3221225472 EngCyl6CombustionTime "The amount of time from when the ignition of the fuel is initiated to when the fuel is completely ignited (i.";
CM_ SG_ 3221225472 EngCyl5CombustionTime "The amount of time from when the ignition of the fuel is initiated to when the fuel is completely ignited (i.";
CM_ SG_ 3221225472 EngCyl4CombustionTime "The amount of time from when the ignition of the fuel is initiated to when the fuel is completely ignited (i.";
CM_ SG_ 3221225472 EngCyl3CombustionTime "The amount of time from when the ignition of the fuel is initiated to when the fuel is completely ignited (i.";
CM_ SG_ 3221225472 EngCyl2CombustionTime "The amount of time from when the ignition of the fuel is initiated to when the fuel is completely ignited (i.";
CM_ SG_ 3221225472 EngCyl1CombustionTime "The amount of time from when the ignition of the fuel is initiated to when the fuel is completely ignited (i.";
CM_ SG_ 3221225472 TotalCountOfConfigChangesMade "Total number of times changes have been made to any of the configurable parameters.";
CM_ SG_ 3221225472 TransOilLevelRq "Conveys operator or vehicle system desire for a transmission oil level reading to be taken.";
CM_ SG_ 3221225472 FifthWheelReleaseCtrl "Operator input used to release the fifth wheel.";
CM_ SG_ 3221225472 FfthWhlRlaseCtrlSecurityLockout "Operator's fifth wheel release control interlock.";
CM_ SG_ 3221225472 TransferCaseSelectorSwitch "Operator switch to select the condition of the transfer case.";
CM_ SG_ 3221225472 RqCabZoneHeating "Request to activate cab zone heating.";
CM_ SG_ 3221225472 RqEngZoneHeating "Request to activate engine zone heating.";
CM_ SG_ 3221225472 AuxHeaterModeRq "Request to activate the auxiliary heater.";
CM_ SG_ 3221225472 EngAutomaticStartEnableSwitch "Switch signal which enables the idle management system to be enabled.";
CM_ SG_ 3221225472 VhclLmtngSpdGvrnrIncrmentSwitch "Switch signal which increases the Vehicle Limiting Speed Governor (VLSG).";
CM_ SG_ 3221225472 VhclLmtngSpdGvrnrDcrementSwitch "Switch signal which decreases the Vehicle Limiting Speed Governor (VLSG).";
CM_ SG_ 3221225472 BatteryMainSwitchHoldRq "Request to hold the battery main switch.";
CM_ SG_ 3221225472 AuxHeaterCoolantPumpRq "Indicates whether to activate the auxiliary heater coolant water pump.";
CM_ SG_ 3221225472 CabInteriorTempCmd "Parameter used to command a certain cab interior temperature.";
CM_ SG_ 3221225472 RqedPercentFanSpeed "Fan speed as a ratio of the actual fan drive (current speed) to the fully engaged fan drive (maximum fan speed).";
CM_ SG_ 3221225472 CruiseCtrlHighSetLimitSpeed "Maximum vehicle velocity at which cruise can be set.";
CM_ SG_ 3221225472 AuxHeaterMaxOutputPower "The maximum output power of the auxiliary heater.";
CM_ SG_ 3221225472 TripServiceBrakeApps "Total number of times the service brakes have been activated since the last trip reset.";
CM_ SG_ 3221225472 TripServiceBrakeDistance "Total distance over which the service brakes have been active since the last trip reset.";
CM_ SG_ 3221225472 TripCompressionBrakeDistance "Total distance over which the compression brakes have been active since the last trip reset.";
CM_ SG_ 3221225472 TotalCompressionBrakeDistance "Total distance over which the compression brakes have been active for the life of the engine.";
CM_ SG_ 3221225472 CbA_CRfrgrntCmprssorOutletPress "This is the gage pressure at the compressor outlet in the cab air conditioning system.";
CM_ SG_ 3221225472 Battery2Temp "Temperature of the battery 2.";
CM_ SG_ 3221225472 Battery1Temp "Temperature of the battery 1.";
CM_ SG_ 3221225472 BatteryMainSwitchHoldState "Parameter indicating whether the battery main switch is held due to an external request or not.";
CM_ SG_ 3221225472 Joystick3XAxisDetentPosStatus "Reports when the current joystick position is in the detent position for that axis of travel.";
CM_ SG_ 3221225472 Joystick3Button9PressedStatus "Reports when the joystick button has been pressed.";
CM_ SG_ 3221225472 Joystick3Button10PressedStatus "Reports when the joystick button has been pressed.";
CM_ SG_ 3221225472 Joystick3Button11PressedStatus "Reports when the joystick button has been pressed.";
CM_ SG_ 3221225472 Joystick3Button12PressedStatus "Reports when the joystick button has been pressed.";
CM_ SG_ 3221225472 Joystick3YAxisDetentPosStatus "Reports when the current joystick position is in the detent position for that axis of travel.";
CM_ SG_ 3221225472 Joystick3YAxisPos "The position of the joystick in the relative motion of travel from the neutral position.";
CM_ SG_ 3221225472 Joystick3YAxisNeutralPosStatus "Reports when the current joystick position is in the neutral position for that axis of travel.";
CM_ SG_ 3221225472 Joystick3XAxisPos "The position of the joystick in the relative motion of travel from the neutral position.";
CM_ SG_ 3221225472 Joystick3XAxisNeutralPosStatus "Reports when the current joystick position is in the neutral position for that axis of travel.";
CM_ SG_ 3221225472 Joystick3Button5PressedStatus "Reports when the joystick button has been pressed.";
CM_ SG_ 3221225472 Joystick3Button6PressedStatus "Reports when the joystick button has been pressed.";
CM_ SG_ 3221225472 Joystick3Button7PressedStatus "Reports when the joystick button has been pressed.";
CM_ SG_ 3221225472 Joystick3Button8PressedStatus "Reports when the joystick button has been pressed.";
CM_ SG_ 3221225472 Joystick3Button1PressedStatus "Reports when the joystick button has been pressed.";
CM_ SG_ 3221225472 Joystick3Button2PressedStatus "Reports when the joystick button has been pressed.";
CM_ SG_ 3221225472 Joystick3Button3PressedStatus "Reports when the joystick button has been pressed.";
CM_ SG_ 3221225472 Joystick3Button4PressedStatus "Reports when the joystick button has been pressed.";
CM_ SG_ 3221225472 Joystick2XAxisDetentPosStatus "Reports when the current joystick position is in the detent position for that axis of travel.";
CM_ SG_ 3221225472 Joystick2YAxisDetentPosStatus "Reports when the current joystick position is in the detent position for that axis of travel.";
CM_ SG_ 3221225472 Joystick2YAxisPos "The position of the joystick in the relative motion of travel from the neutral position.";
CM_ SG_ 3221225472 Joystick2YAxisNeutralPosStatus "Reports when the current joystick position is in the neutral position for that axis of travel.";
CM_ SG_ 3221225472 Joystick2XAxisPos "The position of the joystick in the relative motion of travel from the neutral position.";
CM_ SG_ 3221225472 Joystick2XAxisNeutralPosStatus "Reports when the current joystick position is in the neutral position for that axis of travel.";
CM_ SG_ 3221225472 Joystick2Button9PressedStatus "Reports when the joystick button has been pressed.";
CM_ SG_ 3221225472 Joystick2Button10PressedStatus "Reports when the joystick button has been pressed.";
CM_ SG_ 3221225472 Joystick2Button11PressedStatus "Reports when the joystick button has been pressed.";
CM_ SG_ 3221225472 Joystick2Button12PressedStatus "Reports when the joystick button has been pressed.";
CM_ SG_ 3221225472 Joystick2Button5PressedStatus "Reports when the joystick button has been pressed.";
CM_ SG_ 3221225472 Joystick2Button6PressedStatus "Reports when the joystick button has been pressed.";
CM_ SG_ 3221225472 Joystick2Button7PressedStatus "Reports when the joystick button has been pressed.";
CM_ SG_ 3221225472 Joystick2Button8PressedStatus "Reports when the joystick button has been pressed.";
CM_ SG_ 3221225472 Joystick2Button1PressedStatus "Reports when the joystick button has been pressed.";
CM_ SG_ 3221225472 Joystick2Button2PressedStatus "Reports when the joystick button has been pressed.";
CM_ SG_ 3221225472 Joystick2Button3PressedStatus "Reports when the joystick button has been pressed.";
CM_ SG_ 3221225472 Joystick2Button4PressedStatus "Reports when the joystick button has been pressed.";
CM_ SG_ 3221225472 Joystick1XAxisDetentPosStatus "Reports when the current joystick position is in the detent position for that axis of travel.";
CM_ SG_ 3221225472 Joystick1YAxisDetentPosStatus "Reports when the current joystick position is in the detent position for that axis of travel.";
CM_ SG_ 3221225472 Joystick1YAxisPos "The position of the joystick in the relative motion of travel from the neutral position.";
CM_ SG_ 3221225472 Joystick1YAxisNeutralPosStatus "Reports when the current joystick position is in the neutral position for that axis of travel.";
CM_ SG_ 3221225472 Joystick1XAxisPos "The position of the joystick in the relative motion of travel from the neutral position.";
CM_ SG_ 3221225472 Joystick1Button9PressedStatus "Reports when the joystick button has been pressed.";
CM_ SG_ 3221225472 Joystick1Button10PressedStatus "Reports when the joystick button has been pressed.";
CM_ SG_ 3221225472 Joystick1Button11PressedStatus "Reports when the joystick button has been pressed.";
CM_ SG_ 3221225472 Joystick1Button12PressedStatus "Reports when the joystick button has been pressed.";
CM_ SG_ 3221225472 Joystick1Button5PressedStatus "Reports when the joystick button has been pressed.";
CM_ SG_ 3221225472 Joystick1Button6PressedStatus "Reports when the joystick button has been pressed.";
CM_ SG_ 3221225472 Joystick1Button7PressedStatus "Reports when the joystick button has been pressed.";
CM_ SG_ 3221225472 Joystick1Button8PressedStatus "Reports when the joystick button has been pressed.";
CM_ SG_ 3221225472 Joystick1Button1PressedStatus "Reports when the joystick button has been pressed.";
CM_ SG_ 3221225472 Joystick1Button2PressedStatus "Reports when the joystick button has been pressed.";
CM_ SG_ 3221225472 Joystick1Button3PressedStatus "Reports when the joystick button has been pressed.";
CM_ SG_ 3221225472 Joystick1Button4PressedStatus "Reports when the joystick button has been pressed.";
CM_ SG_ 3221225472 Joystick1XAxisNeutralPosStatus "Reports when the current joystick position is in the neutral position for that axis of travel.";
CM_ SG_ 3221225472 ParkingBrakeRedWarningSignal "This parameter commands the Parking Brake red optical warning signal.";
CM_ SG_ 3221225472 ParkBrakeReleaseInhibitStatus "This parameter provides reports on the status of the Park Brake Release Inhibit function.";
CM_ SG_ 3221225472 ParkingBrakeActuator "Signal which indicates the current state of the actuator(s) that control the parking brake (see also SPN 70).";
CM_ SG_ 3221225472 BrakeSecondPress "Gage pressure of air in the secondary, or service side, of the air brake system.";
CM_ SG_ 3221225472 BrakePrimaryPress "Gage pressure of air in the primary, or supply side, of the air brake system.";
CM_ SG_ 3221225472 AuxPumpPress "Gage pressure of auxiliary water pump driven as a PTO device.";
CM_ SG_ 3221225472 DTC1 "Diagnostic Trouble CodeDiagnostic Trouble CodeDiagnostic Trouble CodeDiagnostic Trouble CodeDiagnostic Trouble CodeDiagnostic Trouble CodeDiagnostic Trouble CodeDiagnostic Trouble CodeDiagnostic Trouble CodeDiagnostic Trouble CodeDiagnostic Trouble CodeDiagnostic Trouble CodeDiagnostic Trouble CodeDiagnostic Trouble CodeDiagnostic Trouble CodeDiagnostic Trouble CodeDiagnostic Trouble Code";
CM_ SG_ 3221225472 DataDictionaryMethod "A manufacturer defined code to define the proprietary communications method.";
CM_ SG_ 3221225472 DataDictionaryManufacturerCode "The J1939 Manufacturer Code (see J1939 Table B10) associated with the manufacturer who defined the proprietary";
CM_ SG_ 3221225472 EngExhstGsOxygnSnsrClsdLpOprtnBn "This parameter indicates the status of the bank 1 O2 sensor feedback closed loop operationThis parameter indicates the status of the bank 1 O2 sensor feedback closed loop operation";
CM_ SG_ 3221225472 ShorttermFuelTrimBank2 "This parameter is the short-term percent change in fueling based on the O2 sensor feedback for cylinder bank 2, based on";
CM_ SG_ 3221225472 LongtermFuelTrimBank2 "This parameter is the long-term percent change in fueling based on the O2 sensor feedback for cylinder bank 2, based on";
CM_ SG_ 3221225472 ShorttermFuelTrimBank1 "This parameter is the short-term percent change in fueling based on the O2 sensor feedback for cylinder bank 1, based on";
CM_ SG_ 3221225472 LongtermFuelTrimBank1 "This parameter is the long-term percent change in fueling based on the O2 sensor feedback for cylinder bank 1, based on";
CM_ SG_ 3221225472 EngSpdSnsor1TimingPatternStatus "This is the timing pattern status of the engine speed sensor signal for sensor 1.";
CM_ SG_ 3221225472 EngSpdSnsor2TimingPatternStatus "This is the timing pattern status of the engine speed sensor signal for sensor 2.";
CM_ SG_ 3221225472 EngSpdSnsor3TimingPatternStatus "This is the timing pattern status of the engine speed sensor signal for sensor 3.";
CM_ SG_ 3221225472 EngSpeed3 "The engine speed as measured by speed sensor 3.";
CM_ SG_ 3221225472 EngSpeed2 "The engine speed as measured by speed sensor 2";
CM_ SG_ 3221225472 EngSpeed1 "The engine speed as measured by speed sensor 1.";
CM_ SG_ 3221225472 DsrdEngCoolantThermostatOpening "Indicates the desired position of the engine coolant control valve.";
CM_ SG_ 3221225472 DesiredEngCoolantPumpOutletTemp "Desired engine coolant temperature of the engine to an electronic thermostat.";
CM_ SG_ 3221225472 EngCoolantThermostatMode "Specifies if the engine coolant thermostat valve will operate in temperature control mode or position control mode.";
CM_ SG_ 3221225472 AuxI_OChannel19 "Identifies the current value of auxiliary input/output channels that are configured uniquely per application.";
CM_ SG_ 3221225472 AuxI_OChannel20 "Identifies the current value of auxiliary input/output channels that are configured uniquely per application.";
CM_ SG_ 3221225472 AuxI_OChannel21 "Identifies the current value of auxiliary input/output channels that are configured uniquely per application.";
CM_ SG_ 3221225472 AuxI_OChannel22 "Identifies the current value of auxiliary input/output channels that are configured uniquely per application.";
CM_ SG_ 3221225472 AuxI_OChannel15 "Identifies the current value of auxiliary input/output channels that are configured uniquely per application.";
CM_ SG_ 3221225472 AuxI_OChannel16 "Identifies the current value of auxiliary input/output channels that are configured uniquely per application.";
CM_ SG_ 3221225472 AuxI_OChannel17 "Identifies the current value of auxiliary input/output channels that are configured uniquely per application.";
CM_ SG_ 3221225472 AuxI_OChannel18 "Identifies the current value of auxiliary input/output channels that are configured uniquely per application.";
CM_ SG_ 3221225472 AuxI_OChannel11 "Identifies the current value of auxiliary input/output channels that are configured uniquely per application.";
CM_ SG_ 3221225472 AuxI_OChannel12 "Identifies the current value of auxiliary input/output channels that are configured uniquely per application.";
CM_ SG_ 3221225472 AuxI_OChannel13 "Identifies the current value of auxiliary input/output channels that are configured uniquely per application.";
CM_ SG_ 3221225472 AuxI_OChannel14 "Identifies the current value of auxiliary input/output channels that are configured uniquely per application.";
CM_ SG_ 3221225472 AuxI_OChannel7 "Identifies the current value of auxiliary input/output channels that are configured uniquely per application.";
CM_ SG_ 3221225472 AuxI_OChannel8 "Identifies the current value of auxiliary input/output channels that are configured uniquely per application.";
CM_ SG_ 3221225472 AuxI_OChannel9 "Identifies the current value of auxiliary input/output channels that are configured uniquely per application.";
CM_ SG_ 3221225472 AuxI_OChannel10 "Identifies the current value of auxiliary input/output channels that are configured uniquely per application.";
CM_ SG_ 3221225472 AuxI_OChannel3 "Identifies the current value of auxiliary input/output channels that are configured uniquely per application.";
CM_ SG_ 3221225472 AuxI_OChannel4 "Identifies the current value of auxiliary input/output channels that are configured uniquely per application.";
CM_ SG_ 3221225472 AuxI_OChannel5 "Identifies the current value of auxiliary input/output channels that are configured uniquely per application.";
CM_ SG_ 3221225472 AuxI_OChannel6 "Identifies the current value of auxiliary input/output channels that are configured uniquely per application.";
CM_ SG_ 3221225472 Aftrtrtment1AirPressActuatorPos "Position of the #1 aftertreatment air pressure actuator as measured by a position feedback sensor.";
CM_ SG_ 3221225472 Aftertreatment1AirPressCtrl "Position that the controller is commanding the aftertreatment #1 air pressure control to maintain.";
CM_ SG_ 3221225472 Aftrtreatment1SecondAirMassFlow "Indicates the secondary air mass flow for aftertreatment 1.";
CM_ SG_ 3221225472 Aftertreatment1SecondAirTemp "Indicates the secondary air temperature for aftertreatment 1.";
CM_ SG_ 3221225472 Aftrtratment1SecondAirDiffPress "Indicates the secondary air differential pressure for aftertreatment 1.";
CM_ SG_ 3221225472 Aftertreatment1Ignt "Indicates whether aftertreatment #1 ignition circuit is energized by the ECM.";
CM_ SG_ 3221225472 Aftrtreatment1FuelDrainActuator "Indicates whether aftertreatment 1 fuel drain actuator is on or off";
CM_ SG_ 3221225472 Aftertreatment1FuelPressCtrl "Position that the controller is commanding the aftertreatment #1 fuel pressure control to maintain.";
CM_ SG_ 3221225472 Aftertreatment1FuelPress1 "First fuel pressure measurement for the aftertreatment 1 system";
CM_ SG_ 3221225472 Aftertreatment1FuelPress2 "Second fuel pressure measurement for the aftertreatment 1 system";
CM_ SG_ 3221225472 Aftrtrtmnt1TtlNmbrOfActvRgnrtnMn "Total number of aftertreatment device 1 active regeneration manual requests by the operator over the lifetime of the device.";
CM_ SG_ 3221225472 Aftrtrtmnt1TtlNmbrOfActvRgnrtnIn "Total number of aftertreatment device 1 active regeneration inhibit requests by the operator over the lifetime of the device.";
CM_ SG_ 3221225472 Aftrtrtmnt1TtlNmbrOfPssvRgnrtns "Total number of passive regenerations by aftertreatment device 1 over the lifetime of the device.";
CM_ SG_ 3221225472 Aftrtrtmnt1TtlPssvRgnrationTime "Total amount of time that aftertreatment device 1 has been in passive regeneration over the lifetime of the device.";
CM_ SG_ 3221225472 Aftrtrtmnt1TtlNmbrOfActvRgnrtns "Total number of active regenerations by aftertreatment device 1 over the lifetime of the device.";
CM_ SG_ 3221225472 Aftrtreatment1TotalDisabledTime "Total amount of time that aftertreatment 1 regeneration has been manually disabled.";
CM_ SG_ 3221225472 Aftrtrtmnt1TtalRegenerationTime "Total amount of time that aftertreatment device 1 has been regenerating over the lifetime of the device.";
CM_ SG_ 3221225472 Aftertreatment1TotalFuelUsed "Total amount of fuel used by aftertreatment device 1 over the lifetime of the device.";
CM_ SG_ 3221225472 Aftrtrtmnt1IntkGsSnsrHeaterCtrl "Indicates the heater status in the warm-up process.";
CM_ SG_ 3221225472 Aftertreatment1IntakeO2 "The actual oxidation factor (%O2) of the gas within the exhaust stream.";
CM_ SG_ 3221225472 Aftrtrtmnt1PrtcltTrpIntkGasTemp "Temperature of engine combustion byproducts entering the particulate trap in exhaust bank 1.";
CM_ SG_ 3221225472 Aftertreatment1ExhaustGasTemp1 "The reading from the exhaust gas temperature sensor located farthest upstream in the aftertreatment system in exhaust bank 1.";
CM_ SG_ 3221225472 AntitheftRandomNumber "A seven byte random numeric code provided by the component in response to an anti-theft request.";
CM_ SG_ 3221225472 AntitheftComponentStatusStates "Indicates whether or not the component can be started.";
CM_ SG_ 3221225472 AntthftEncryptnSdPrsntIndicator "Indicates the presence of the encryption seed random number.";
CM_ SG_ 3221225472 AntitheftPwdValidIndicator "Indicates the presence of a validated password.";
CM_ SG_ 3221225472 AntitheftPasswordRepresentation "This parameter is the seven byte numeric code (i.";
CM_ SG_ 3221225472 AntitheftCmdStates "This parameter is used to identify the specific requests being sent to the component.";
CM_ SG_ 3221225472 EngAltWinding3Temp "Temperature of the windings inside the alternator.";
CM_ SG_ 3221225472 EngAltWinding2Temp "Temperature of the windings inside the alternator.";
CM_ SG_ 3221225472 EngAltWinding1Temp "Temperature of the windings inside the alternator.";
CM_ SG_ 3221225472 EngAltBearing2Temp "Temperature of the bearing inside the alternator.";
CM_ SG_ 3221225472 EngAltBearing1Temp "Temperature of the bearing inside the alternator.";
CM_ SG_ 3221225472 LevelPresetRearAxleRight "Set value for nominal level 'preset level' at the right side of the rear axle.";
CM_ SG_ 3221225472 LevelPresetRearAxleLeft "Set value for nominal level 'preset level' at the left side of the rear axle.";
CM_ SG_ 3221225472 LevelPresetFrontAxleRight "Set value for nominal level 'preset level' at the right side of the front axle.";
CM_ SG_ 3221225472 LevelPresetFrontAxleLeft "Set value for nominal level 'preset level' at the left side of the front axle.";
CM_ SG_ 3221225472 ElctrncShckAbsrbrCtrlMdLft_TgAxl "Signal which indicates the current mode of operation of the electronic shock absorber control at the lift/tag axle.";
CM_ SG_ 3221225472 ElctrncShckAbsrbrCtrlMdRearAxle "Signal which indicates the current mode of operation of the electronic shock absorber control at the rear axle.";
CM_ SG_ 3221225472 ElctrncShckAbsrbrCtrlMdFrntAxle "Signal which indicates the current mode of operation of the electronic shock absorber control at the front axle.";
CM_ SG_ 3221225472 TestLimitMinimum "The test value must be greater than or equal to Test Limit Minimum in order for the test to passThe threshold which the test value must be above to pass the test.";
CM_ SG_ 3221225472 TestValue "The test value collected during the test.The test value collected during the test.";
CM_ SG_ 3221225472 TestIdentifier "Test IdentifierDesignates the test to be run.Designates the test to be run.";
CM_ SG_ 3221225472 Aftrtrtmnt1PrtcltTrpDltPrssPrlmn "Used to identify the applicable J1939-73 FMI detected in the particulate trap differential pressure sensor by the manufacturer’s";
CM_ SG_ 3221225472 Aftrtrtmnt1ExhstGsTmp2PrlmnryFMI "Used to identify the applicable J1939-73 FMI detected in the exhaust gas temperature 2 sensor by the manufacturer’s sensor";
CM_ SG_ 3221225472 Aftrtrtmnt1PrtclteTrapDiffPress "Exhaust differential pressure measured between the intake and exhaust of a particulate trap in exhaust bank 1.";
CM_ SG_ 3221225472 Aftertreatment1ExhaustGasTemp2 "The reading from the exhaust gas temperature sensor located midstream of the other two temperature sensors in the";
CM_ SG_ 3221225472 Aftrtrtmnt1OtltGsSnsrHeaterCtrl "Indicates the heater status in the warm-up process.";
CM_ SG_ 3221225472 Aftertreatment1OutletO2 "The actual oxidation factor (%O2) of the gas within the exhaust stream.";
CM_ SG_ 3221225472 Aftrtrtmnt1PrtcltTrpOtltGasTemp "Temperature of engine combustion byproducts leaving the particulate trap exhaust in exhaust bank 1.";
CM_ SG_ 3221225472 PrtcltTrp1TmSncLstActvRgnration "Indicates the time since the last active regeneration event of particulate trap 1.";
CM_ SG_ 3221225472 ParticulateTrap1AshLoadPercent "Indicates the ash load percent of particulate trap 1.";
CM_ SG_ 3221225472 ParticulateTrap1SootLoadPercent "Indicates the soot load percent of particulate trap 1.";
CM_ SG_ 3221225472 Aftrtrtmnt1TrpNmbrOfActvRgnrtnMn "Total number of Aftertreatment device 1 active regeneration manual requests by the operator during the current trip period.";
CM_ SG_ 3221225472 Aftrtrtmnt1TrpNmbrOfActvRgnrtnIn "Total number of aftertreatment device 1 active regeneration inhibit requests by the operator during the current trip period.";
CM_ SG_ 3221225472 Aftrtrtmnt1TrpNmbrOfPssvRgnrtns "Total number of passive regenerations by Aftertreatment device 1 during the current trip period.";
CM_ SG_ 3221225472 Aftrtrtmnt1TrpPssvRgnrationTime "Total amount of time that aftertreatment device 1 has been in passive regeneration during the current trip period.";
CM_ SG_ 3221225472 Aftrtrtmnt1TrpNmbrOfActvRgnrtns "Total number of active regenerations by Aftertreatment device 1 during the current trip period.";
CM_ SG_ 3221225472 Aftertreatment1TripDisabledTime "Total amount of time that aftertreatment 1 regeneration has been manually disabled during the current trip period.";
CM_ SG_ 3221225472 Aftrtrtmnt1TrpActvRgnrationTime "Total amount of time that aftertreatment device 1 has been in active regeneration during the current trip period.";
CM_ SG_ 3221225472 Aftertreatment1TripFuelUsed "Total amount of fuel used by aftertreatment device 1 during the current trip period.";
CM_ SG_ 3221225472 Aftrtrtment2AirPressActuatorPos "Position of the #2 aftertreatment air pressure actuator as measured by a position feedback sensor.";
CM_ SG_ 3221225472 Aftertreatment2AirPressCtrl "Position that the controller is commanding the aftertreatment #2 air pressure control to maintain.";
CM_ SG_ 3221225472 Aftrtreatment2SecondAirMassFlow "Indicates the secondary air mass flow for aftertreatment 2.";
CM_ SG_ 3221225472 Aftertreatment2SecondAirTemp "Indicates the secondary air temperature for aftertreatment 2.";
CM_ SG_ 3221225472 Aftrtratment2SecondAirDiffPress "Indicates the secondary air differential pressure for aftertreatment 2.";
CM_ SG_ 3221225472 Aftertreatment2Ignt "Indicates whether aftertreatment #2 ignition circuit is energized by the ECM.";
CM_ SG_ 3221225472 Aftrtreatment2FuelDrainActuator "Indicates whether aftertreatment 2 fuel drain actuator is on or off";
CM_ SG_ 3221225472 Aftertreatment2FuelPressCtrl "Position that the controller is commanding the aftertreatment #2 fuel pressure control to maintain.";
CM_ SG_ 3221225472 Aftertreatment2FuelPress "Pressure of the fuel for Aftertreatment #2.";
CM_ SG_ 3221225472 Aftrtrtmnt2TtlNmbrOfActvRgnrtnMn "Total number of Aftertreatment device 2 active regeneration manual requests by the operator over the lifetime of the device.";
CM_ SG_ 3221225472 Aftrtrtmnt2TtlNmbrOfActvRgnrtnIn "Total number of Aftertreatment device 2 active regeneration inhibit requests by the operator over the lifetime of the device.";
CM_ SG_ 3221225472 Aftrtrtmnt2TtlNmbrOfPssvRgnrtns "Total number of passive regenerations by Aftertreatment device 2 over the lifetime of the device.";
CM_ SG_ 3221225472 Aftrtrtmnt2TtlPssvRgnrationTime "Total amount of time that Aftertreatment device 2 has been in passive regeneration over the lifetime of the device.";
CM_ SG_ 3221225472 Aftrtrtmnt2TtlNmbrOfActvRgnrtns "Total number of active regenerations by aftertreatment device 2 over the lifetime of the device.";
CM_ SG_ 3221225472 Aftrtreatment2TotalDisabledTime "Total amount of time that aftertreatment 2 regeneration has been manually disabled.";
CM_ SG_ 3221225472 Aftrtrtmnt2TtalRegenerationTime "Total amount of time that aftertreatment device 2 has been regenerating over the lifetime of the device.";
CM_ SG_ 3221225472 Aftertreatment2TotalFuelUsed "Total amount of fuel used by aftertreatment device 2 over the lifetime of the device.";
CM_ SG_ 3221225472 Aftrtrtmnt2IntkGsSnsrHeaterCtrl "Indicates the heater status in the warm-up process.";
CM_ SG_ 3221225472 Aftertreatment2IntakeO2 "The actual oxidation factor (%O2) of the gas within the exhaust stream.";
CM_ SG_ 3221225472 Aftrtrtmnt2PrtcltTrpIntkGasTemp "Temperature of engine combustion byproducts entering the particulate trap in exhaust bank 2.";
CM_ SG_ 3221225472 Aftertreatment2ExhaustGasTemp1 "The reading from the exhaust gas temperature sensor located farthest upstream in the aftertreatment system in exhaust bank 2.";
CM_ SG_ 3221225472 Aftrtrtmnt2PrtclteTrapDiffPress "Exhaust differential pressure measured between the intake and exhaust of a particulate trap in exhaust bank 2.";
CM_ SG_ 3221225472 Aftrtrtmnt2OtltGsSnsrHeaterCtrl "Indicates the heater status in the warm-up process.";
CM_ SG_ 3221225472 Aftertreatment2OutletO2 "The actual oxidation factor (%O2) of the gas within the exhaust stream.";
CM_ SG_ 3221225472 Aftrtrtmnt2PrtcltTrpOtltGasTemp "Temperature of engine combustion byproducts leaving the particulate trap exhaust in exhaust bank 2.";
CM_ SG_ 3221225472 PrtcltTrp2TmSncLstActvRgnration "Indicates the time since the last active regeneration event of particulate trap 2.";
CM_ SG_ 3221225472 ParticulateTrap2AshLoadPercent "Indicates the ash load percent of particulate trap 2.";
CM_ SG_ 3221225472 ParticulateTrap2SootLoadPercent "Indicates the soot load percent of particulate trap 2.";
CM_ SG_ 3221225472 Aftrtrtmnt2TrpNmbrOfActvRgnrtnMn "Total number of aftertreatment device 2 active regeneration manual requests by the operator during the current trip period.";
CM_ SG_ 3221225472 Aftrtrtmnt2TrpNmbrOfActvRgnrtnIn "Total number of aftertreatment device 2 active regeneration inhibit requests by the operator during the current trip period.";
CM_ SG_ 3221225472 Aftrtrtmnt2TrpNmbrOfPssvRgnrtns "Total number of passive regenerations by aftertreatment device 2 during the current trip period.";
CM_ SG_ 3221225472 Aftrtrtmnt2TrpPssvRgnrationTime "Total amount of time that aftertreatment device 2 has been in passive regeneration during the current trip period.";
CM_ SG_ 3221225472 Aftrtrtmnt2TrpNmbrOfActvRgnrtns "Total number of active regenerations by aftertreatment device 2 during the current trip period.";
CM_ SG_ 3221225472 Aftertreatment2TripDisabledTime "Total amount of time that aftertreatment 2 regeneration has been manually disabled during the current trip period.";
CM_ SG_ 3221225472 Aftrtrtmnt2TrpActvRgnrationTime "Total amount of time that aftertreatment device 2 has been in active regeneration during the current trip period.";
CM_ SG_ 3221225472 Aftertreatment2TripFuelUsed "Total amount of fuel used by aftertreatment device 2 during the current trip period.";
CM_ SG_ 3221225472 EngDerateRq "This parameter is a derate request made from the engine control system to an external system, where the engine is";
CM_ SG_ 3221225472 EngEmergencyShutdownIndication "A signal issued by the engine control system to a user or external system indicating that it is immediately shutting the engine";
CM_ SG_ 3221225472 EngCtrlledShutdownRq "A signal issued by the engine control system to a user or external system requesting for a controlled shutdown.";
CM_ SG_ 3221225472 EngCoolantCirculatingPumpCtrl "Control setting for an electrically actuated engine coolant circulating pump.";
CM_ SG_ 3221225472 EngBlock_CoolantPreheaterCtrl "Control setting for an electrically actuated engine block or coolant pre-heating device.";
CM_ SG_ 3221225472 EngElctrclSystmPwrCnsrvtionCtrl "Control setting for cutting power to various devices when the engine is not in use.";
CM_ SG_ 3221225472 EngOilPreheaterCtrl "Control setting for an electrically actuated oil pre-heating device.";
CM_ SG_ 3221225472 EngOilPrimingPumpCtrl "This control is used to activate a pump that lubricates the engine, particularly prior to initial engine startup.";
CM_ SG_ 3221225472 EngFuelShutoffValveLeakTestCtrl "Control setting for fuel shutoff valve proving system test.";
CM_ SG_ 3221225472 EngFuelShutoff2Ctrl "Control setting for fuel shutoff 2.";
CM_ SG_ 3221225472 EngFuelShutoff1Ctrl "Control setting for fuel shutoff 1.";
CM_ SG_ 3221225472 EngFuelShutoffVentCtrl "Control setting for a fuel shutoff vent.";
CM_ SG_ 3221225472 TmeRemainingInEngOperatingState "This parameter is used to indicate the time remaining in the current engine operating state, based on the state defined in the";
CM_ SG_ 3221225472 FuelPumpPrimerCtrl "Parameter used to activate or deactivate a priming system on the fuel transfer system.";
CM_ SG_ 3221225472 EngOperatingState "This parameter is used to indicate the current state, or mode, of operation by the engine.";
CM_ SG_ 3221225472 EngCoolantTemp2 "Second temperature of liquid found in the engine cooling system.";
CM_ SG_ 3221225472 NetVehicleWeightChange "Identifies the net vehicle weight change from the time of last vehicle net weight zeroing.";
CM_ SG_ 3221225472 GrossCombinationWeight "Total weight of the truck and all the trailers with on-board scales.";
CM_ SG_ 3221225472 ValveAssemblySupplyPress "Pressure of the hydraulic supply port to a valve assembly.";
CM_ SG_ 3221225472 ValveAssemblyLoadSensePress "The maximum pressure of a valve assembly's current collective load sense pressures where a valve assembly can consist";
CM_ SG_ 3221225472 ValvePilotPress "Pressure of a valve's pilot supply port.";
CM_ SG_ 3221225472 ValveLoadSensePress "The maximum of the currently measured pressures of a valve's work port A and work port B.";
CM_ SG_ 3221225472 RelativeLevelRearAxleRight "Information of the height at the left side of the rear axle referred to normal level 1.";
CM_ SG_ 3221225472 RelativeLevelRearAxleLeft "Information of the height at the left side of the rear axle referred to normal level 1.";
CM_ SG_ 3221225472 RelativeLevelFrontAxleRight "Information of the height at the right side of the front axle referred to normal level 1.";
CM_ SG_ 3221225472 RelativeLevelFrontAxleLeft "Information of the height at the left side of the front axle referred to normal level 1.";
CM_ SG_ 3221225472 ProhibitAirSuspensionCtrl "This parameter contains an external request to prohibit all air suspension control.";
CM_ SG_ 3221225472 KneelingCmdRearAxle "Command signal to activate the kneeling functionality at the rear axle of the vehicle.";
CM_ SG_ 3221225472 DamperStiffnessRqRearAxle "Demand value for the shock absorber control at the rear axle.";
CM_ SG_ 3221225472 DamperStiffnessRqFrontAxle "Demand value for the shock absorber control at the front axle.";
CM_ SG_ 3221225472 NominalLevelRqRearAxle "Command signal to activate a level of the rear axle programmed and/or memorised in the ECU.";
CM_ SG_ 3221225472 LiftAxle2PosCmd "Signal to command the position / load condition of lift / tag axle #2.";
CM_ SG_ 3221225472 LiftAxle1PosCmd "Signal to command the position/load condition of lift/tag axle #1.";
CM_ SG_ 3221225472 SspensionCtrlRefusalInformation "Signal which indicates that the air suspension control cannot perform a request due to the operating conditions.";
CM_ SG_ 3221225472 SuspensionRemoteCtrl2 "Signal which indicates that the suspension system is controlled by remote control #2.";
CM_ SG_ 3221225472 SuspensionRemoteCtrl1 "Signal which indicates that the suspension system is controlled by remote control #1.";
CM_ SG_ 3221225472 RearAxleInBumperRange "Signal which indicates that the vehicle height at the rear axle (SPNs 1723 and 1724) is within the bumper range.";
CM_ SG_ 3221225472 FrontAxleInBumperRange "Signal which indicates that the vehicle height at the front axle (SPNs 1721 and 1722) is within the bumper range.";
CM_ SG_ 3221225472 DoorRelease "Signal which indicates that the doors may be opened.";
CM_ SG_ 3221225472 VehicleMotionInhibit "Signal which indicates whether vehicle motion is inhibited.";
CM_ SG_ 3221225472 SecurityDevice "The signal which indicates the status of the security device.";
CM_ SG_ 3221225472 AboveNominalLevelRearAxle "Signal which indicates whether the actual height of the rear axle is above the nominal (desired) level of the rear axle.";
CM_ SG_ 3221225472 AboveNominalLevelFrontAxle "Signal which indicates whether the actual height of the front axle is above the nominal (desired) level of the front axle.";
CM_ SG_ 3221225472 BelowNominalLevelRearAxle "Signal which indicates whether the actual height of the rear axle is below the nominal (desired) level for the rear axle.";
CM_ SG_ 3221225472 BelowNominalLevelFrontAxle "Signal which indicates whether the actual height of the front axle is below the nominal (desired) level for the front axle.";
CM_ SG_ 3221225472 NominalLevelRearAxle "Signal which indicates the nominal (desired) height of the rear axle to be controlled by the suspension system.";
CM_ SG_ 3221225472 NominalLevelFrontAxle "Signal which indicates the nominal (desired) height of the front axle to be controlled by the suspension system.";
CM_ SG_ 3221225472 Alt4Status "Alternator 4 operating status.";
CM_ SG_ 3221225472 Alt3Status "Alternator 3 operating status.";
CM_ SG_ 3221225472 Alt2Status "Alternator 2 operating status.";
CM_ SG_ 3221225472 Alt1Status "Alternator 1 operating status.";
CM_ SG_ 3221225472 AltSpeed "Actual rotation speed of the alternator.";
CM_ SG_ 3221225472 AuxAbsPressReading "Identifies the current absolute pressure (relative to 0 pressure) that is configured uniquely per application.";
CM_ SG_ 3221225472 AuxGagePressReading1 "Identifies the current gage pressure (relative to atmosphere) that is configured uniquely per application.";
CM_ SG_ 3221225472 AuxVacuumPressReading "Identifies the current vacuum pressure (relative to atmosphere) that is configured uniquely per application.";
CM_ SG_ 3221225472 SolarSensorMax "This is the maximum value which can be reported by the sensor for the solar intensity.";
CM_ SG_ 3221225472 SolarIntensityPercent "This is the solar radiation (power density) falling on the vehicle in percent of the maximum sensor value (SPN 2611).";
CM_ SG_ 3221225472 FlashRedStopLamp "This parameter provides the capability to flash the RSL (SPN 3039).This parameter provides the capability to flash the RSL (SPN 3039).This parameter provides the capability to flash the RSL (SPN 3039).This parameter provides the capability to flash the RSL (SPN 3039).This parameter provides the capability to flash the RSL (SPN 3039).This parameter provides the capability to flash the RSL (SPN 3039).This parameter provides the capability to flash the RSL (SPN 3039).This parameter provides the capability to flash the RSL (SPN 3039).This parameter provides the capability to flash the RSL (SPN 3039).This parameter provides the capability to flash the RSL (SPN 3039).This parameter provides the capability to flash the RSL (SPN 3039).This parameter provides the capability to flash the RSL (SPN 3039).This parameter provides the capability to flash the RSL (SPN 3039).This parameter provides the capability to flash the RSL (SPN 3039).This parameter provides the capability to flash the RSL (SPN 3039).This parameter pro";
CM_ SG_ 3221225472 FlashProtectLamp "This parameter provides the capability to flash the engine protect lamp (SPN 3041).This parameter provides the capability to flash the engine protect lamp (SPN 3041).This parameter provides the capability to flash the engine protect lamp (SPN 3041).This parameter provides the capability to flash the engine protect lamp (SPN 3041).This parameter provides the capability to flash the engine protect lamp (SPN 3041).This parameter provides the capability to flash the engine protect lamp (SPN 3041).This parameter provides the capability to flash the engine protect lamp (SPN 3041).This parameter provides the capability to flash the engine protect lamp (SPN 3041).This parameter provides the capability to flash the engine protect lamp (SPN 3041).This parameter provides the capability to flash the engine protect lamp (SPN 3041).This parameter provides the capability to flash the engine protect lamp (SPN 3041).This parameter provides the capability to flash the engine protect lamp (SPN 3041).This parameter provides the";
CM_ SG_ 3221225472 FlashMalfuncIndicatorLamp "This parameter provides the capability to flash the MIL (SPN 3038).This parameter provides the capability to flash the MIL (SPN 3038).This parameter provides the capability to flash the MIL (SPN 3038).This parameter provides the capability to flash the MIL (SPN 3038).This parameter provides the capability to flash the MIL (SPN 3038).This parameter provides the capability to flash the MIL (SPN 3038).This parameter provides the capability to flash the MIL (SPN 3038).This parameter provides the capability to flash the MIL (SPN 3038).This parameter provides the capability to flash the MIL (SPN 3038).This parameter provides the capability to flash the MIL (SPN 3038).This parameter provides the capability to flash the MIL (SPN 3038).This parameter provides the capability to flash the MIL (SPN 3038).This parameter provides the capability to flash the MIL (SPN 3038).This parameter provides the capability to flash the MIL (SPN 3038).This parameter provides the capability to flash the MIL (SPN 3038).This parameter pro";
CM_ SG_ 3221225472 FlashAmberWarningLamp "This parameter provides the capability to flash the AWL (SPN 3040). This parameter provides the capability to flash the AWL (SPN 3040). This parameter provides the capability to flash the AWL (SPN 3040). This parameter provides the capability to flash the AWL (SPN 3040). This parameter provides the capability to flash the AWL (SPN 3040). This parameter provides the capability to flash the AWL (SPN 3040). This parameter provides the capability to flash the AWL (SPN 3040). This parameter provides the capability to flash the AWL (SPN 3040). This parameter provides the capability to flash the AWL (SPN 3040). This parameter provides the capability to flash the AWL (SPN 3040). This parameter provides the capability to flash the AWL (SPN 3040). This parameter provides the capability to flash the AWL (SPN 3040). This parameter provides the capability to flash the AWL (SPN 3040). This parameter provides the capability to flash the AWL (SPN 3040). This parameter provides the capability to flash the AWL (SPN 3040). Thi";
CM_ SG_ 3221225472 MalfunctionIndicatorLampStatus "A lamp used to relay only emissions-related trouble code information.A lamp used to relay only emissions-related trouble code information.A lamp used to relay only emissions-related trouble code information.A lamp used to relay only emissions-related trouble code information.A lamp used to relay only emissions-related trouble code information.A lamp used to relay only emissions-related trouble code information.A lamp used to relay only emissions-related trouble code information.A lamp used to relay only emissions-related trouble code information.A lamp used to relay only emissions-related trouble code information.A lamp used to relay only emissions-related trouble code information.A lamp used to relay only emissions-related trouble code information.A lamp used to relay only emissions-related trouble code information.A lamp used to relay only emissions-related trouble code information.A lamp used to relay only emissions-related trouble code information.A lamp used to relay only emissions-related trouble code ";
CM_ SG_ 3221225472 RedStopLampState "This lamp is uesed to relay trouble code information that is of a severe enought condition that it warrants stopping the vehicle.This lamp is uesed to relay trouble code information that is of a severe enought condition that it warrants stopping the vehicle.This lamp is uesed to relay trouble code information that is of a severe enought condition that it warrants stopping the vehicle.This lamp is uesed to relay trouble code information that is of a severe enought condition that it warrants stopping the vehicle.This lamp is uesed to relay trouble code information that is of a severe enought condition that it warrants stopping the vehicle.This lamp is uesed to relay trouble code information that is of a severe enought condition that it warrants stopping the vehicle.This lamp is uesed to relay trouble code information that is of a severe enought condition that it warrants stopping the vehicle.This lamp is uesed to relay trouble code information that is of a severe enought condition that it warrants stopping the";
CM_ SG_ 3221225472 AmberWarningLampStatus "This lamp is used to relay trouble code information that is reporting a problem with the vehicle system but the vehicle need
not be immediately stopped.This lamp is used to relay trouble code information that is reporting a problem with the vehicle system but the vehicle need
not be immediately stopped.This lamp is used to relay trouble code information that is reporting a problem with the vehicle system but the vehicle need
not be immediately stopped.This lamp is used to relay trouble code information that is reporting a problem with the vehicle system but the vehicle need
not be immediately stopped.This lamp is used to relay trouble code information that is reporting a problem with the vehicle system but the vehicle need
not be immediately stopped.This lamp is used to relay trouble code information that is reporting a problem with the vehicle system but the vehicle need
not be immediately stopped.This lamp is used to relay trouble code information that is reporting a problem with the vehicle system b";
CM_ SG_ 3221225472 ProtectLampStatus "This lamp is used to relay trouble code informatio that is reporting a problem with a vehicle system that is most
probably not electronic subsystem related.This lamp is used to relay trouble code informatio that is reporting a problem with a vehicle system that is most
probably not electronic subsystem related.This lamp is used to relay trouble code informatio that is reporting a problem with a vehicle system that is most
probably not electronic subsystem related.This lamp is used to relay trouble code informatio that is reporting a problem with a vehicle system that is most
probably not electronic subsystem related.This lamp is used to relay trouble code informatio that is reporting a problem with a vehicle system that is most
probably not electronic subsystem related.This lamp is used to relay trouble code informatio that is reporting a problem with a vehicle system that is most
probably not electronic subsystem related.This lamp is used to relay trouble code informatio that is reporting a problem wi";
CM_ SG_ 3221225472 DTC5 "Diagnostic Trouble CodeDiagnostic Trouble CodeDiagnostic Trouble CodeDiagnostic Trouble CodeDiagnostic Trouble CodeDiagnostic Trouble CodeDiagnostic Trouble CodeDiagnostic Trouble CodeDiagnostic Trouble CodeDiagnostic Trouble CodeDiagnostic Trouble CodeDiagnostic Trouble CodeDiagnostic Trouble CodeDiagnostic Trouble CodeDiagnostic Trouble CodeDiagnostic Trouble Code";
CM_ SG_ 3221225472 DTC4 "Diagnostic Trouble CodeDiagnostic Trouble CodeDiagnostic Trouble CodeDiagnostic Trouble CodeDiagnostic Trouble CodeDiagnostic Trouble CodeDiagnostic Trouble CodeDiagnostic Trouble CodeDiagnostic Trouble CodeDiagnostic Trouble CodeDiagnostic Trouble CodeDiagnostic Trouble CodeDiagnostic Trouble CodeDiagnostic Trouble CodeDiagnostic Trouble CodeDiagnostic Trouble Code";
CM_ SG_ 3221225472 DTC3 "Diagnostic Trouble CodeDiagnostic Trouble CodeDiagnostic Trouble CodeDiagnostic Trouble CodeDiagnostic Trouble CodeDiagnostic Trouble CodeDiagnostic Trouble CodeDiagnostic Trouble CodeDiagnostic Trouble CodeDiagnostic Trouble CodeDiagnostic Trouble CodeDiagnostic Trouble CodeDiagnostic Trouble CodeDiagnostic Trouble CodeDiagnostic Trouble CodeDiagnostic Trouble Code";
CM_ SG_ 3221225472 DTC2 "Diagnostic Trouble CodeDiagnostic Trouble CodeDiagnostic Trouble CodeDiagnostic Trouble CodeDiagnostic Trouble CodeDiagnostic Trouble CodeDiagnostic Trouble CodeDiagnostic Trouble CodeDiagnostic Trouble CodeDiagnostic Trouble CodeDiagnostic Trouble CodeDiagnostic Trouble CodeDiagnostic Trouble CodeDiagnostic Trouble CodeDiagnostic Trouble CodeDiagnostic Trouble Code";
CM_ SG_ 3221225472 UtlityOverallPowerFactorLagging "Lead/lag status for utility incomer average power factor.";
CM_ SG_ 3221225472 UtilityOverallPowerFactor "The average power factor of the utility incomer.";
CM_ SG_ 3221225472 UtilityTotalReactivePower "The total reactive power delivered by the utility incomer";
CM_ SG_ 3221225472 UtilityTotalApparentPower "The total apparent power delivered by the utility incomer.";
CM_ SG_ 3221225472 UtilityTotalRealPower "Total real power delivered by the utility incomer.";
CM_ SG_ 3221225472 UtilityTotalKWHoursImport "The total kilowatt-hours that have been imported by the utility incomer.";
CM_ SG_ 3221225472 UtilityTotalKWHoursExport "The total kilowatt-hours that have been exported by the utility incomer.";
CM_ SG_ 3221225472 UtilityPhaseCPowerFactorLagging "Lead/lag status for utility incomer phase C power factor.";
CM_ SG_ 3221225472 UtilityPhaseCPowerFactor "The power factor of phases C of the utility incomer.";
CM_ SG_ 3221225472 UtilityPhaseCReactivePower "The reactive power delivered by phase C of the utility incomer";
CM_ SG_ 3221225472 UtilityPhaseCApparentPower "The apparent power delivered by phase C of the utility incomer.";
CM_ SG_ 3221225472 UtilityPhaseCRealPower "The real power delivered by phase C of the utility incomer.";
CM_ SG_ 3221225472 UtilityPhaseCACRMSCurrent "RMS current measured at the utility incomer phase C.";
CM_ SG_ 3221225472 UtilityPhaseCACFrequency "AC frequency measured at the utility incomer phase C.";
CM_ SG_ 3221225472 UtltyPhsCLneNeutralACRMSVoltage "Line to Neutral RMS voltage measured at the utility incomer phase C.";
CM_ SG_ 3221225472 UtltyPhseCALineLineACRMSVoltage "Line to Line RMS voltage measured at the utility incomer phase CA.";
CM_ SG_ 3221225472 UtilityPhaseBPowerFactorLagging "Lead/lag status for utility incomer phase B power factor.";
CM_ SG_ 3221225472 UtilityPhaseBPowerFactor "The power factor of phases B of the utility incomer.";
CM_ SG_ 3221225472 UtilityPhaseBReactivePower "The reactive power delivered by phase B of the utility incomer";
CM_ SG_ 3221225472 UtilityPhaseBApparentPower "The apparent power delivered by phase B of the utility incomer.";
CM_ SG_ 3221225472 UtilityPhaseBRealPower "The real power delivered by phase B of the utility incomer.";
CM_ SG_ 3221225472 UtilityPhaseBACRMSCurrent "RMS current measured at the utility incomer phase B.";
CM_ SG_ 3221225472 UtilityPhaseBACFrequency "AC frequency measured at the utility incomer phase B.";
CM_ SG_ 3221225472 UtltyPhsBLneNeutralACRMSVoltage "Line to Neutral RMS voltage measured at the utility incomer phase B.";
CM_ SG_ 3221225472 UtltyPhseBCLineLineACRMSVoltage "Line to Line RMS voltage measured at the utility incomer phase BC.";
CM_ SG_ 3221225472 UtilityPhaseAPowerFactorLagging "Lead/lag status for utility incomer phase A power factor.";
CM_ SG_ 3221225472 UtilityPhaseAPowerFactor "The power factor of phase A of the utility incomer.";
CM_ SG_ 3221225472 UtilityPhaseAReactivePower "The reactive power delivered by phase A of the utility incomer";
CM_ SG_ 3221225472 UtilityPhaseAApparentPower "The apparent power delivered by phase A of the utility incomer.";
CM_ SG_ 3221225472 UtilityPhaseARealPower "The real power delivered by phase A of the utility incomer.";
CM_ SG_ 3221225472 UtilityPhaseAACRMSCurrent "RMS current measured at the utility incomer phase A.";
CM_ SG_ 3221225472 UtilityPhaseAACFrequency "AC frequency measured at the utility incomer phase A.";
CM_ SG_ 3221225472 UtltyPhsALneNeutralACRMSVoltage "Line to Neutral RMS voltage measured at the utility incomer phase A.";
CM_ SG_ 3221225472 UtltyPhseABLineLineACRMSVoltage "Line to Line RMS voltage measured at the utility incomer phase AB.";
CM_ SG_ 3221225472 UtilityAverageACRMSCurrent "Average RMS current measured at the utility incomer.";
CM_ SG_ 3221225472 UtilityAverageACFrequency "Average AC frequency measured at the utility incomer.";
CM_ SG_ 3221225472 UtltyAvrgLneNeutralACRMSVoltage "The average Line to Neutral AC RMS voltage measured at the utility incomer .";
CM_ SG_ 3221225472 UtltyAvrageLineLineACRMSVoltage "Average Line to Line RMS voltage measured at the utility incomer .";
CM_ SG_ 3221225472 GnrtorOverallPowerFactorLagging "Lead/lag status for generator average power factor.";
CM_ SG_ 3221225472 GeneratorOverallPowerFactor "The average power factor of the generator.";
CM_ SG_ 3221225472 GeneratorTotalReactivePower "The total reactive power delivered by the generator";
CM_ SG_ 3221225472 GeneratorTotalApparentPower "The total apparent power delivered by the generator.";
CM_ SG_ 3221225472 GeneratorTotalRealPower "Total real power delivered by the generator.";
CM_ SG_ 3221225472 GeneratorTotalKWHoursImport "The total kilowatt-hours that have been imported by the generator.";
CM_ SG_ 3221225472 GeneratorTotalKWHoursExport "The total kilowatt-hours that have been exported by the generator.";
CM_ SG_ 3221225472 GnratorPhaseCPowerFactorLagging "Lead/lag status for generator phase C power factor.";
CM_ SG_ 3221225472 GeneratorPhaseCPowerFactor "The power factor of phases C of the generator.";
CM_ SG_ 3221225472 GeneratorPhaseCReactivePower "The reactive power delivered by phase C of the generator";
CM_ SG_ 3221225472 GeneratorPhaseCApparentPower "The apparent power delivered by phase C of the generator.";
CM_ SG_ 3221225472 GeneratorPhaseCRealPower "The real power delivered by phase C of the generator.";
CM_ SG_ 3221225472 GeneratorPhaseCACRMSCurrent "RMS current measured at the generator phase C output.";
CM_ SG_ 3221225472 GeneratorPhaseCACFrequency "AC frequency measured at the generator phase C output.";
CM_ SG_ 3221225472 GnrtrPhsCLneNeutralACRMSVoltage "Line to Neutral RMS voltage measured at the generator phase C output.";
CM_ SG_ 3221225472 GnrtrPhseCALineLineACRMSVoltage "Line to Line RMS voltage measured at the generator phase CA output.";
CM_ SG_ 3221225472 GnratorPhaseBPowerFactorLagging "Lead/lag status for generator phase B power factor.";
CM_ SG_ 3221225472 GeneratorPhaseBPowerFactor "The power factor of phases B of the generator.";
CM_ SG_ 3221225472 GeneratorPhaseBReactivePower "The reactive power delivered by phase B of the generator";
CM_ SG_ 3221225472 GeneratorPhaseBApparentPower "The apparent power delivered by phase B of the generator.";
CM_ SG_ 3221225472 GeneratorPhaseBRealPower "The real power delivered by phase B of the generator.";
CM_ SG_ 3221225472 GeneratorPhaseBACRMSCurrent "RMS current measured at the generator phase B output.";
CM_ SG_ 3221225472 GeneratorPhaseBACFrequency "AC frequency measured at the generator phase B output.";
CM_ SG_ 3221225472 GnrtrPhsBLneNeutralACRMSVoltage "Line to Neutral RMS voltage measured at the generator phase B output.";
CM_ SG_ 3221225472 GnrtrPhseBCLineLineACRMSVoltage "Line to Line RMS voltage measured at the generator phase BC output.";
CM_ SG_ 3221225472 GnratorPhaseAPowerFactorLagging "Lead/lag status for generator phase A power factor.";
CM_ SG_ 3221225472 GeneratorPhaseAPowerFactor "The power factor of phase A of the generator.";
CM_ SG_ 3221225472 GeneratorPhaseAReactivePower "The reactive power delivered by phase A of the generator";
CM_ SG_ 3221225472 GeneratorPhaseAApparentPower "The apparent power delivered by phase A of the generator.";
BA_DEF_ SG_  "SigType" ENUM  "Default","Range","RangeSigned","ASCII","Discrete","Control","ReferencePGN","DTC","StringDelimiter","StringLength","StringLengthControl";
BA_DEF_ SG_  "GenSigStartValue" INT 0 10000;
BA_DEF_ SG_  "GenSigSendType" ENUM  "Cyclic","OnWrite","reserved","OnChange","reserved","reserved","reserved","NoSigSendType";
BA_DEF_ SG_  "GenSigILSupport" ENUM  "Yes","No";
BA_DEF_ SG_  "GenSigEVName" STRING ;
BA_DEF_ SG_  "SPN" INT 0 524287;
BA_DEF_ BO_  "GenMsgILSupport" ENUM  "Yes","No";
BA_DEF_ BO_  "GenMsgRequestable" INT 0 1;
BA_DEF_ BO_  "GenMsgSendType" ENUM  "cyclic","reserved","cyclicIfActive","reserved","reserved","reserved","reserved","reserved","noMsgSendType";
BA_DEF_ BO_  "VFrameFormat" ENUM  "StandardCAN","ExtendedCAN","reserved","J1939PG";
BA_DEF_ BO_  "GenMsgCycleTime" INT 0 3600000;
BA_DEF_DEF_  "SigType" "Default";
BA_DEF_DEF_  "GenSigStartValue" 0;
BA_DEF_DEF_  "GenSigSendType" "NoSigSendType";
BA_DEF_DEF_  "GenSigILSupport" "Yes";
BA_DEF_DEF_  "GenSigEVName" "Env@Nodename_@Signame";
BA_DEF_DEF_  "SPN" 0;
BA_DEF_DEF_  "GenMsgILSupport" "Yes";
BA_DEF_DEF_  "GenMsgRequestable" 1;
BA_DEF_DEF_  "GenMsgSendType" "noMsgSendType";
BA_DEF_DEF_  "VFrameFormat" "J1939PG";
BA_DEF_DEF_  "GenMsgCycleTime" 0;
BA_ "SPN" SG_ 3221225472 EngStartEnableDevice1Config 2899;
BA_ "SigType" SG_ 3221225472 EngStartEnableDevice2 4;
BA_ "SPN" SG_ 3221225472 EngStartEnableDevice2 1804;
BA_ "SigType" SG_ 3221225472 EngStartEnableDevice1 4;
BA_ "SPN" SG_ 3221225472 EngStartEnableDevice1 626;
BA_ "SigType" SG_ 3221225472 PoweredVehicleWeight 1;
BA_ "SPN" SG_ 3221225472 PoweredVehicleWeight 1585;
BA_ "SigType" SG_ 3221225472 GrossCombinationVehicleWeight 1;
BA_ "SPN" SG_ 3221225472 GrossCombinationVehicleWeight 1760;
BA_ "SigType" SG_ 3221225472 MxCntnuousRetarderTorqueLimitRq 1;
BA_ "SPN" SG_ 3221225472 MxCntnuousRetarderTorqueLimitRq 1791;
BA_ "SigType" SG_ 3221225472 MnCntnuousRetarderTorqueLimitRq 1;
BA_ "SPN" SG_ 3221225472 MnCntnuousRetarderTorqueLimitRq 1790;
BA_ "SigType" SG_ 3221225472 MxCntinuousRetarderSpeedLimitRq 1;
BA_ "SPN" SG_ 3221225472 MxCntinuousRetarderSpeedLimitRq 1789;
BA_ "SigType" SG_ 3221225472 MnCntinuousRetarderSpeedLimitRq 1;
BA_ "SPN" SG_ 3221225472 MnCntinuousRetarderSpeedLimitRq 1788;
BA_ "SigType" SG_ 3221225472 EngTorqueLimitRqMaxContinuous 1;
BA_ "SPN" SG_ 3221225472 EngTorqueLimitRqMaxContinuous 1787;
BA_ "SigType" SG_ 3221225472 EngTorqueLimitRqMinContinuous 1;
BA_ "SPN" SG_ 3221225472 EngTorqueLimitRqMinContinuous 1786;
BA_ "SigType" SG_ 3221225472 EngSpeedLimitRqMaxContinuous 1;
BA_ "SPN" SG_ 3221225472 EngSpeedLimitRqMaxContinuous 1785;
BA_ "SigType" SG_ 3221225472 EngSpeedLimitRqMinContinuous 1;
BA_ "SPN" SG_ 3221225472 EngSpeedLimitRqMinContinuous 1784;
BA_ "SigType" SG_ 3221225472 EngAverageCombustionTime 1;
BA_ "SPN" SG_ 3221225472 EngAverageCombustionTime 1465;
BA_ "SigType" SG_ 3221225472 EngDesiredCombustionTime 1;
BA_ "SPN" SG_ 3221225472 EngDesiredCombustionTime 1464;
BA_ "SigType" SG_ 3221225472 EngCyl20CombustionTime 1;
BA_ "SPN" SG_ 3221225472 EngCyl20CombustionTime 1463;
BA_ "SigType" SG_ 3221225472 EngCyl19CombustionTime 1;
BA_ "SPN" SG_ 3221225472 EngCyl19CombustionTime 1462;
BA_ "SigType" SG_ 3221225472 EngCyl18CombustionTime 1;
BA_ "SPN" SG_ 3221225472 EngCyl18CombustionTime 1461;
BA_ "SigType" SG_ 3221225472 EngCyl17CombustionTime 1;
BA_ "SPN" SG_ 3221225472 EngCyl17CombustionTime 1460;
BA_ "SigType" SG_ 3221225472 EngCyl16CombustionTime 1;
BA_ "SPN" SG_ 3221225472 EngCyl16CombustionTime 1459;
BA_ "SigType" SG_ 3221225472 EngCyl15CombustionTime 1;
BA_ "SPN" SG_ 3221225472 EngCyl15CombustionTime 1458;
BA_ "SigType" SG_ 3221225472 EngCyl14CombustionTime 1;
BA_ "SPN" SG_ 3221225472 EngCyl14CombustionTime 1457;
BA_ "SigType" SG_ 3221225472 EngCyl13CombustionTime 1;
BA_ "SPN" SG_ 3221225472 EngCyl13CombustionTime 1456;
BA_ "SigType" SG_ 3221225472 EngCyl12CombustionTime 1;
BA_ "SPN" SG_ 3221225472 EngCyl12CombustionTime 1455;
BA_ "SigType" SG_ 3221225472 EngCyl11CombustionTime 1;
BA_ "SPN" SG_ 3221225472 EngCyl11CombustionTime 1454;
BA_ "SigType" SG_ 3221225472 EngCyl10CombustionTime 1;
BA_ "SPN" SG_ 3221225472 EngCyl10CombustionTime 1453;
BA_ "SigType" SG_ 3221225472 EngCyl9CombustionTime 1;
BA_ "SPN" SG_ 3221225472 EngCyl9CombustionTime 1452;
BA_ "SigType" SG_ 3221225472 EngCyl8CombustionTime 1;
BA_ "SPN" SG_ 3221225472 EngCyl8CombustionTime 1451;
BA_ "SigType" SG_ 3221225472 EngCyl7CombustionTime 1;
BA_ "SPN" SG_ 3221225472 EngCyl7CombustionTime 1450;
BA_ "SigType" SG_ 3221225472 EngCyl6CombustionTime 1;
BA_ "SPN" SG_ 3221225472 EngCyl6CombustionTime 1449;
BA_ "SigType" SG_ 3221225472 EngCyl5CombustionTime 1;
BA_ "SPN" SG_ 3221225472 EngCyl5CombustionTime 1448;
BA_ "SigType" SG_ 3221225472 EngCyl4CombustionTime 1;
BA_ "SPN" SG_ 3221225472 EngCyl4CombustionTime 1447;
BA_ "SigType" SG_ 3221225472 EngCyl3CombustionTime 1;
BA_ "SPN" SG_ 3221225472 EngCyl3CombustionTime 1446;
BA_ "SigType" SG_ 3221225472 EngCyl2CombustionTime 1;
BA_ "SPN" SG_ 3221225472 EngCyl2CombustionTime 1445;
BA_ "SigType" SG_ 3221225472 EngCyl1CombustionTime 1;
BA_ "SPN" SG_ 3221225472 EngCyl1CombustionTime 1444;
BA_ "SigType" SG_ 3221225472 TotalCountOfConfigChangesMade 1;
BA_ "SPN" SG_ 3221225472 TotalCountOfConfigChangesMade 2887;
BA_ "SigType" SG_ 3221225472 TransOilLevelRq 4;
BA_ "SPN" SG_ 3221225472 TransOilLevelRq 3809;
BA_ "SigType" SG_ 3221225472 FifthWheelReleaseCtrl 4;
BA_ "SPN" SG_ 3221225472 FifthWheelReleaseCtrl 3314;
BA_ "SigType" SG_ 3221225472 FfthWhlRlaseCtrlSecurityLockout 4;
BA_ "SPN" SG_ 3221225472 FfthWhlRlaseCtrlSecurityLockout 3315;
BA_ "SPN" SG_ 3221225472 TransferCaseSelectorSwitch 2796;
BA_ "SigType" SG_ 3221225472 SelectedMaxVehicleSpeedLimit 1;
BA_ "SPN" SG_ 3221225472 SelectedMaxVehicleSpeedLimit 2596;
BA_ "SigType" SG_ 3221225472 RqCabZoneHeating 4;
BA_ "SPN" SG_ 3221225472 RqCabZoneHeating 1686;
BA_ "SigType" SG_ 3221225472 RqEngZoneHeating 4;
BA_ "SPN" SG_ 3221225472 RqEngZoneHeating 1685;
BA_ "SPN" SG_ 3221225472 AuxHeaterModeRq 1683;
BA_ "SigType" SG_ 3221225472 EngAutomaticStartEnableSwitch 4;
BA_ "SPN" SG_ 3221225472 EngAutomaticStartEnableSwitch 1656;
BA_ "SigType" SG_ 3221225472 AtmaticGearShiftingEnableSwitch 4;
BA_ "SPN" SG_ 3221225472 AtmaticGearShiftingEnableSwitch 1666;
BA_ "SigType" SG_ 3221225472 VhclLmtngSpdGvernorEnableSwitch 4;
BA_ "SPN" SG_ 3221225472 VhclLmtngSpdGvernorEnableSwitch 1653;
BA_ "SigType" SG_ 3221225472 VhclLmtngSpdGvrnrIncrmentSwitch 4;
BA_ "SPN" SG_ 3221225472 VhclLmtngSpdGvrnrIncrmentSwitch 1654;
BA_ "SigType" SG_ 3221225472 VhclLmtngSpdGvrnrDcrementSwitch 4;
BA_ "SPN" SG_ 3221225472 VhclLmtngSpdGvrnrDcrementSwitch 1655;
BA_ "SigType" SG_ 3221225472 SeatBeltSwitch 4;
BA_ "SPN" SG_ 3221225472 SeatBeltSwitch 1856;
BA_ "SigType" SG_ 3221225472 OperatorSeatDirectionSwitch 4;
BA_ "SPN" SG_ 3221225472 OperatorSeatDirectionSwitch 1714;
BA_ "SigType" SG_ 3221225472 BatteryMainSwitchHoldRq 4;
BA_ "SPN" SG_ 3221225472 BatteryMainSwitchHoldRq 1682;
BA_ "SigType" SG_ 3221225472 AuxHeaterCoolantPumpRq 4;
BA_ "SPN" SG_ 3221225472 AuxHeaterCoolantPumpRq 1684;
BA_ "SigType" SG_ 3221225472 CabInteriorTempCmd 1;
BA_ "SPN" SG_ 3221225472 CabInteriorTempCmd 1691;
BA_ "SigType" SG_ 3221225472 RqedPercentFanSpeed 1;
BA_ "SPN" SG_ 3221225472 RqedPercentFanSpeed 986;
BA_ "SigType" SG_ 3221225472 IlluminationBrightnessPercent 1;
BA_ "SPN" SG_ 3221225472 IlluminationBrightnessPercent 1487;
BA_ "SigType" SG_ 3221225472 UnitNumber 8;
BA_ "SPN" SG_ 3221225472 UnitNumber 233;
BA_ "SigType" SG_ 3221225472 SerialNumber 8;
BA_ "SPN" SG_ 3221225472 SerialNumber 588;
BA_ "SigType" SG_ 3221225472 Model 8;
BA_ "SPN" SG_ 3221225472 Model 587;
BA_ "SigType" SG_ 3221225472 Make 8;
BA_ "SPN" SG_ 3221225472 Make 586;
BA_ "SigType" SG_ 3221225472 CruiseCtrlLowSetLimitSpeed 1;
BA_ "SPN" SG_ 3221225472 CruiseCtrlLowSetLimitSpeed 88;
BA_ "SigType" SG_ 3221225472 CruiseCtrlHighSetLimitSpeed 1;
BA_ "SPN" SG_ 3221225472 CruiseCtrlHighSetLimitSpeed 87;
BA_ "SigType" SG_ 3221225472 AuxHeaterMaxOutputPower 1;
BA_ "SPN" SG_ 3221225472 AuxHeaterMaxOutputPower 1690;
BA_ "SigType" SG_ 3221225472 TripServiceBrakeApps 1;
BA_ "SPN" SG_ 3221225472 TripServiceBrakeApps 993;
BA_ "SigType" SG_ 3221225472 TripServiceBrakeDistance 1;
BA_ "SPN" SG_ 3221225472 TripServiceBrakeDistance 992;
BA_ "SigType" SG_ 3221225472 TripCompressionBrakeDistance 1;
BA_ "SPN" SG_ 3221225472 TripCompressionBrakeDistance 991;
BA_ "SigType" SG_ 3221225472 TotalCompressionBrakeDistance 1;
BA_ "SPN" SG_ 3221225472 TotalCompressionBrakeDistance 990;
BA_ "SigType" SG_ 3221225472 CbA_CRfrgrntCmprssorOutletPress 1;
BA_ "SPN" SG_ 3221225472 CbA_CRfrgrntCmprssorOutletPress 2609;
BA_ "SigType" SG_ 3221225472 Battery2Temp 1;
BA_ "SPN" SG_ 3221225472 Battery2Temp 1801;
BA_ "SigType" SG_ 3221225472 Battery1Temp 1;
BA_ "SPN" SG_ 3221225472 Battery1Temp 1800;
BA_ "SigType" SG_ 3221225472 BatteryMainSwitchHoldState 4;
BA_ "SPN" SG_ 3221225472 BatteryMainSwitchHoldState 1681;
BA_ "SigType" SG_ 3221225472 Joystick3XAxisDetentPosStatus 4;
BA_ "SPN" SG_ 3221225472 Joystick3XAxisDetentPosStatus 2754;
BA_ "SigType" SG_ 3221225472 Joystick3Button9PressedStatus 4;
BA_ "SPN" SG_ 3221225472 Joystick3Button9PressedStatus 2767;
BA_ "SigType" SG_ 3221225472 Joystick3Button10PressedStatus 4;
BA_ "SPN" SG_ 3221225472 Joystick3Button10PressedStatus 2768;
BA_ "SigType" SG_ 3221225472 Joystick3Button11PressedStatus 4;
BA_ "SPN" SG_ 3221225472 Joystick3Button11PressedStatus 2769;
BA_ "SigType" SG_ 3221225472 Joystick3Button12PressedStatus 4;
BA_ "SPN" SG_ 3221225472 Joystick3Button12PressedStatus 2770;
BA_ "SigType" SG_ 3221225472 Joystick3YAxisDetentPosStatus 4;
BA_ "SPN" SG_ 3221225472 Joystick3YAxisDetentPosStatus 2755;
BA_ "SigType" SG_ 3221225472 Joystick3YAxisPos 1;
BA_ "SPN" SG_ 3221225472 Joystick3YAxisPos 2735;
BA_ "SigType" SG_ 3221225472 Jystck3YAxsLvrFrwrdPstvPsStatus 4;
BA_ "SPN" SG_ 3221225472 Jystck3YAxsLvrFrwrdPstvPsStatus 2740;
BA_ "SigType" SG_ 3221225472 Jystck3YAxsLvrBckNgtvePosStatus 4;
BA_ "SPN" SG_ 3221225472 Jystck3YAxsLvrBckNgtvePosStatus 2745;
BA_ "SigType" SG_ 3221225472 Joystick3YAxisNeutralPosStatus 4;
BA_ "SPN" SG_ 3221225472 Joystick3YAxisNeutralPosStatus 2750;
BA_ "SigType" SG_ 3221225472 Joystick3XAxisPos 1;
BA_ "SPN" SG_ 3221225472 Joystick3XAxisPos 2734;
BA_ "SigType" SG_ 3221225472 Jystck3XAxsLvrRghtPstvPosStatus 4;
BA_ "SPN" SG_ 3221225472 Jystck3XAxsLvrRghtPstvPosStatus 2739;
BA_ "SigType" SG_ 3221225472 Jystck3XAxsLvrLftNgtvePosStatus 4;
BA_ "SPN" SG_ 3221225472 Jystck3XAxsLvrLftNgtvePosStatus 2744;
BA_ "SigType" SG_ 3221225472 Joystick3XAxisNeutralPosStatus 4;
BA_ "SPN" SG_ 3221225472 Joystick3XAxisNeutralPosStatus 2749;
BA_ "SigType" SG_ 3221225472 Joystick3Button5PressedStatus 4;
BA_ "SPN" SG_ 3221225472 Joystick3Button5PressedStatus 2763;
BA_ "SigType" SG_ 3221225472 Joystick3Button6PressedStatus 4;
BA_ "SPN" SG_ 3221225472 Joystick3Button6PressedStatus 2764;
BA_ "SigType" SG_ 3221225472 Joystick3Button7PressedStatus 4;
BA_ "SPN" SG_ 3221225472 Joystick3Button7PressedStatus 2765;
BA_ "SigType" SG_ 3221225472 Joystick3Button8PressedStatus 4;
BA_ "SPN" SG_ 3221225472 Joystick3Button8PressedStatus 2766;
BA_ "SigType" SG_ 3221225472 Joystick3Button1PressedStatus 4;
BA_ "SPN" SG_ 3221225472 Joystick3Button1PressedStatus 2759;
BA_ "SigType" SG_ 3221225472 Joystick3Button2PressedStatus 4;
BA_ "SPN" SG_ 3221225472 Joystick3Button2PressedStatus 2760;
BA_ "SigType" SG_ 3221225472 Joystick3Button3PressedStatus 4;
BA_ "SPN" SG_ 3221225472 Joystick3Button3PressedStatus 2761;
BA_ "SigType" SG_ 3221225472 Joystick3Button4PressedStatus 4;
BA_ "SPN" SG_ 3221225472 Joystick3Button4PressedStatus 2762;
BA_ "SigType" SG_ 3221225472 Joystick2XAxisDetentPosStatus 4;
BA_ "SPN" SG_ 3221225472 Joystick2XAxisDetentPosStatus 2717;
BA_ "SigType" SG_ 3221225472 Joystick2YAxisDetentPosStatus 4;
BA_ "SPN" SG_ 3221225472 Joystick2YAxisDetentPosStatus 2718;
BA_ "SigType" SG_ 3221225472 Joystick2YAxisPos 1;
BA_ "SPN" SG_ 3221225472 Joystick2YAxisPos 2698;
BA_ "SigType" SG_ 3221225472 Jystck2YAxsLvrFrwrdPstvPsStatus 4;
BA_ "SPN" SG_ 3221225472 Jystck2YAxsLvrFrwrdPstvPsStatus 2703;
BA_ "SigType" SG_ 3221225472 Jystck2YAxsLvrBckNgtvePosStatus 4;
BA_ "SPN" SG_ 3221225472 Jystck2YAxsLvrBckNgtvePosStatus 2708;
BA_ "SigType" SG_ 3221225472 Joystick2YAxisNeutralPosStatus 4;
BA_ "SPN" SG_ 3221225472 Joystick2YAxisNeutralPosStatus 2713;
BA_ "SigType" SG_ 3221225472 Joystick2XAxisPos 1;
BA_ "SPN" SG_ 3221225472 Joystick2XAxisPos 2697;
BA_ "SigType" SG_ 3221225472 Jystck2XAxsLvrRghtPstvPosStatus 4;
BA_ "SPN" SG_ 3221225472 Jystck2XAxsLvrRghtPstvPosStatus 2702;
BA_ "SigType" SG_ 3221225472 Jystck2XAxsLvrLftNgtvePosStatus 4;
BA_ "SPN" SG_ 3221225472 Jystck2XAxsLvrLftNgtvePosStatus 2707;
BA_ "SigType" SG_ 3221225472 Joystick2XAxisNeutralPosStatus 4;
BA_ "SPN" SG_ 3221225472 Joystick2XAxisNeutralPosStatus 2712;
BA_ "SigType" SG_ 3221225472 Joystick2Button9PressedStatus 4;
BA_ "SPN" SG_ 3221225472 Joystick2Button9PressedStatus 2730;
BA_ "SigType" SG_ 3221225472 Joystick2Button10PressedStatus 4;
BA_ "SPN" SG_ 3221225472 Joystick2Button10PressedStatus 2731;
BA_ "SigType" SG_ 3221225472 Joystick2Button11PressedStatus 4;
BA_ "SPN" SG_ 3221225472 Joystick2Button11PressedStatus 2732;
BA_ "SigType" SG_ 3221225472 Joystick2Button12PressedStatus 4;
BA_ "SPN" SG_ 3221225472 Joystick2Button12PressedStatus 2733;
BA_ "SigType" SG_ 3221225472 Joystick2Button5PressedStatus 4;
BA_ "SPN" SG_ 3221225472 Joystick2Button5PressedStatus 2726;
BA_ "SigType" SG_ 3221225472 Joystick2Button6PressedStatus 4;
BA_ "SPN" SG_ 3221225472 Joystick2Button6PressedStatus 2727;
BA_ "SigType" SG_ 3221225472 Joystick2Button7PressedStatus 4;
BA_ "SPN" SG_ 3221225472 Joystick2Button7PressedStatus 2728;
BA_ "SigType" SG_ 3221225472 Joystick2Button8PressedStatus 4;
BA_ "SPN" SG_ 3221225472 Joystick2Button8PressedStatus 2729;
BA_ "SigType" SG_ 3221225472 Joystick2Button1PressedStatus 4;
BA_ "SPN" SG_ 3221225472 Joystick2Button1PressedStatus 2722;
BA_ "SigType" SG_ 3221225472 Joystick2Button2PressedStatus 4;
BA_ "SPN" SG_ 3221225472 Joystick2Button2PressedStatus 2723;
BA_ "SigType" SG_ 3221225472 Joystick2Button3PressedStatus 4;
BA_ "SPN" SG_ 3221225472 Joystick2Button3PressedStatus 2724;
BA_ "SigType" SG_ 3221225472 Joystick2Button4PressedStatus 4;
BA_ "SPN" SG_ 3221225472 Joystick2Button4PressedStatus 2725;
BA_ "SigType" SG_ 3221225472 Joystick1XAxisDetentPosStatus 4;
BA_ "SPN" SG_ 3221225472 Joystick1XAxisDetentPosStatus 2680;
BA_ "SigType" SG_ 3221225472 Joystick1YAxisDetentPosStatus 4;
BA_ "SPN" SG_ 3221225472 Joystick1YAxisDetentPosStatus 2681;
BA_ "SigType" SG_ 3221225472 Joystick1YAxisPos 1;
BA_ "SPN" SG_ 3221225472 Joystick1YAxisPos 2661;
BA_ "SigType" SG_ 3221225472 Jystck1YAxsLvrFrwrdPstvPsStatus 4;
BA_ "SPN" SG_ 3221225472 Jystck1YAxsLvrFrwrdPstvPsStatus 2666;
BA_ "SigType" SG_ 3221225472 Jystck1YAxsLvrBckNgtvePosStatus 4;
BA_ "SPN" SG_ 3221225472 Jystck1YAxsLvrBckNgtvePosStatus 2671;
BA_ "SigType" SG_ 3221225472 Joystick1YAxisNeutralPosStatus 4;
BA_ "SPN" SG_ 3221225472 Joystick1YAxisNeutralPosStatus 2676;
BA_ "SigType" SG_ 3221225472 Joystick1XAxisPos 1;
BA_ "SPN" SG_ 3221225472 Joystick1XAxisPos 2660;
BA_ "SigType" SG_ 3221225472 Joystick1Button9PressedStatus 4;
BA_ "SPN" SG_ 3221225472 Joystick1Button9PressedStatus 2693;
BA_ "SigType" SG_ 3221225472 Joystick1Button10PressedStatus 4;
BA_ "SPN" SG_ 3221225472 Joystick1Button10PressedStatus 2694;
BA_ "SigType" SG_ 3221225472 Joystick1Button11PressedStatus 4;
BA_ "SPN" SG_ 3221225472 Joystick1Button11PressedStatus 2695;
BA_ "SigType" SG_ 3221225472 Joystick1Button12PressedStatus 4;
BA_ "SPN" SG_ 3221225472 Joystick1Button12PressedStatus 2696;
BA_ "SigType" SG_ 3221225472 Joystick1Button5PressedStatus 4;
BA_ "SPN" SG_ 3221225472 Joystick1Button5PressedStatus 2689;
BA_ "SigType" SG_ 3221225472 Joystick1Button6PressedStatus 4;
BA_ "SPN" SG_ 3221225472 Joystick1Button6PressedStatus 2690;
BA_ "SigType" SG_ 3221225472 Joystick1Button7PressedStatus 4;
BA_ "SPN" SG_ 3221225472 Joystick1Button7PressedStatus 2691;
BA_ "SigType" SG_ 3221225472 Joystick1Button8PressedStatus 4;
BA_ "SPN" SG_ 3221225472 Joystick1Button8PressedStatus 2692;
BA_ "SigType" SG_ 3221225472 Joystick1Button1PressedStatus 4;
BA_ "SPN" SG_ 3221225472 Joystick1Button1PressedStatus 2685;
BA_ "SigType" SG_ 3221225472 Joystick1Button2PressedStatus 4;
BA_ "SPN" SG_ 3221225472 Joystick1Button2PressedStatus 2686;
BA_ "SigType" SG_ 3221225472 Joystick1Button3PressedStatus 4;
BA_ "SPN" SG_ 3221225472 Joystick1Button3PressedStatus 2687;
BA_ "SigType" SG_ 3221225472 Joystick1Button4PressedStatus 4;
BA_ "SPN" SG_ 3221225472 Joystick1Button4PressedStatus 2688;
BA_ "SigType" SG_ 3221225472 Jystck1XAxsLvrRghtPstvPosStatus 4;
BA_ "SPN" SG_ 3221225472 Jystck1XAxsLvrRghtPstvPosStatus 2665;
BA_ "SigType" SG_ 3221225472 Jystck1XAxsLvrLftNgtvePosStatus 4;
BA_ "SPN" SG_ 3221225472 Jystck1XAxsLvrLftNgtvePosStatus 2670;
BA_ "SigType" SG_ 3221225472 Joystick1XAxisNeutralPosStatus 4;
BA_ "SPN" SG_ 3221225472 Joystick1XAxisNeutralPosStatus 2675;
BA_ "SigType" SG_ 3221225472 ParkingBrakeRedWarningSignal 4;
BA_ "SPN" SG_ 3221225472 ParkingBrakeRedWarningSignal 3557;
BA_ "SigType" SG_ 3221225472 ParkBrakeReleaseInhibitStatus 4;
BA_ "SPN" SG_ 3221225472 ParkBrakeReleaseInhibitStatus 3808;
BA_ "SigType" SG_ 3221225472 ParkingBrakeActuator 4;
BA_ "SPN" SG_ 3221225472 ParkingBrakeActuator 619;
BA_ "SigType" SG_ 3221225472 BrakeSecondPress 1;
BA_ "SPN" SG_ 3221225472 BrakeSecondPress 118;
BA_ "SigType" SG_ 3221225472 BrakePrimaryPress 1;
BA_ "SPN" SG_ 3221225472 BrakePrimaryPress 117;
BA_ "SigType" SG_ 3221225472 BrakeAppPress 1;
BA_ "SPN" SG_ 3221225472 BrakeAppPress 116;
BA_ "SigType" SG_ 3221225472 AuxPumpPress 1;
BA_ "SPN" SG_ 3221225472 AuxPumpPress 73;
BA_ "SigType" SG_ 3221225472 DTC1 7;
BA_ "SPN" SG_ 3221225472 DataDictionaryMethod 4181;
BA_ "SPN" SG_ 3221225472 DataDictionaryManufacturerCode 4180;
BA_ "SPN" SG_ 3221225472 EngExhstGsOxygnSnsrClsdLpOprtnBn 4240;
BA_ "SPN" SG_ 3221225472 ShorttermFuelTrimBank2 4238;
BA_ "SPN" SG_ 3221225472 LongtermFuelTrimBank2 4239;
BA_ "SPN" SG_ 3221225472 ShorttermFuelTrimBank1 4236;
BA_ "SPN" SG_ 3221225472 LongtermFuelTrimBank1 4237;
BA_ "SigType" SG_ 3221225472 EngSpdSnsor1TimingPatternStatus 4;
BA_ "SPN" SG_ 3221225472 EngSpdSnsor1TimingPatternStatus 4203;
BA_ "SigType" SG_ 3221225472 EngSpdSnsor2TimingPatternStatus 4;
BA_ "SPN" SG_ 3221225472 EngSpdSnsor2TimingPatternStatus 4204;
BA_ "SigType" SG_ 3221225472 EngSpdSnsor3TimingPatternStatus 4;
BA_ "SPN" SG_ 3221225472 EngSpdSnsor3TimingPatternStatus 4205;
BA_ "SPN" SG_ 3221225472 EngSpeed3 4202;
BA_ "SPN" SG_ 3221225472 EngSpeed2 723;
BA_ "SPN" SG_ 3221225472 EngSpeed1 4201;
BA_ "SPN" SG_ 3221225472 DsrdEngCoolantThermostatOpening 4197;
BA_ "SPN" SG_ 3221225472 DesiredEngCoolantPumpOutletTemp 4196;
BA_ "SigType" SG_ 3221225472 EngCoolantThermostatMode 4;
BA_ "SPN" SG_ 3221225472 EngCoolantThermostatMode 4195;
BA_ "SPN" SG_ 3221225472 AuxI_OChannel19 4174;
BA_ "SPN" SG_ 3221225472 AuxI_OChannel20 4173;
BA_ "SPN" SG_ 3221225472 AuxI_OChannel21 4172;
BA_ "SPN" SG_ 3221225472 AuxI_OChannel22 4171;
BA_ "SPN" SG_ 3221225472 AuxI_OChannel15 4170;
BA_ "SPN" SG_ 3221225472 AuxI_OChannel16 4169;
BA_ "SPN" SG_ 3221225472 AuxI_OChannel17 4168;
BA_ "SPN" SG_ 3221225472 AuxI_OChannel18 4167;
BA_ "SPN" SG_ 3221225472 AuxI_OChannel11 4166;
BA_ "SPN" SG_ 3221225472 AuxI_OChannel12 4165;
BA_ "SPN" SG_ 3221225472 AuxI_OChannel13 4164;
BA_ "SPN" SG_ 3221225472 AuxI_OChannel14 4163;
BA_ "SPN" SG_ 3221225472 AuxI_OChannel7 4162;
BA_ "SPN" SG_ 3221225472 AuxI_OChannel8 4161;
BA_ "SPN" SG_ 3221225472 AuxI_OChannel9 4160;
BA_ "SPN" SG_ 3221225472 AuxI_OChannel10 4159;
BA_ "SPN" SG_ 3221225472 AuxI_OChannel3 4158;
BA_ "SPN" SG_ 3221225472 AuxI_OChannel4 4157;
BA_ "SPN" SG_ 3221225472 AuxI_OChannel5 4156;
BA_ "SPN" SG_ 3221225472 AuxI_OChannel6 4155;
BA_ "SigType" SG_ 3221225472 Aftrtreatment1AirEnableActuator 4;
BA_ "SPN" SG_ 3221225472 Aftrtreatment1AirEnableActuator 3489;
BA_ "SigType" SG_ 3221225472 Aftertreatment1PurgeAirActuator 4;
BA_ "SPN" SG_ 3221225472 Aftertreatment1PurgeAirActuator 3490;
BA_ "SigType" SG_ 3221225472 Aftrtrtmnt1AtmzationAirActuator 4;
BA_ "SPN" SG_ 3221225472 Aftrtrtmnt1AtmzationAirActuator 3491;
BA_ "SigType" SG_ 3221225472 Aftertreatment1AirSystemRelay 4;
BA_ "SPN" SG_ 3221225472 Aftertreatment1AirSystemRelay 3492;
BA_ "SigType" SG_ 3221225472 Aftrtrtment1AirPressActuatorPos 1;
BA_ "SPN" SG_ 3221225472 Aftrtrtment1AirPressActuatorPos 3488;
BA_ "SigType" SG_ 3221225472 Aftertreatment1AirPressCtrl 1;
BA_ "SPN" SG_ 3221225472 Aftertreatment1AirPressCtrl 3487;
BA_ "SigType" SG_ 3221225472 Aftertreatment1PurgeAirPress 1;
BA_ "SPN" SG_ 3221225472 Aftertreatment1PurgeAirPress 3486;
BA_ "SigType" SG_ 3221225472 Aftertreatment1SupplyAirPress 1;
BA_ "SPN" SG_ 3221225472 Aftertreatment1SupplyAirPress 3485;
BA_ "SigType" SG_ 3221225472 Aftertreatment1SecondAirPress 1;
BA_ "SPN" SG_ 3221225472 Aftertreatment1SecondAirPress 3837;
BA_ "SigType" SG_ 3221225472 Aftrtreatment1SecondAirMassFlow 1;
BA_ "SPN" SG_ 3221225472 Aftrtreatment1SecondAirMassFlow 3832;
BA_ "SigType" SG_ 3221225472 Aftertreatment1SecondAirTemp 1;
BA_ "SPN" SG_ 3221225472 Aftertreatment1SecondAirTemp 3831;
BA_ "SigType" SG_ 3221225472 Aftrtratment1SecondAirDiffPress 1;
BA_ "SPN" SG_ 3221225472 Aftrtratment1SecondAirDiffPress 3830;
BA_ "SigType" SG_ 3221225472 Aftrtratment1FuelEnableActuator 4;
BA_ "SPN" SG_ 3221225472 Aftrtratment1FuelEnableActuator 3482;
BA_ "SigType" SG_ 3221225472 Aftrtratment1RegenerationStatus 4;
BA_ "SPN" SG_ 3221225472 Aftrtratment1RegenerationStatus 3483;
BA_ "SigType" SG_ 3221225472 Aftertreatment1Ignt 4;
BA_ "SPN" SG_ 3221225472 Aftertreatment1Ignt 3484;
BA_ "SigType" SG_ 3221225472 Aftrtreatment1FuelDrainActuator 4;
BA_ "SPN" SG_ 3221225472 Aftrtreatment1FuelDrainActuator 4097;
BA_ "SigType" SG_ 3221225472 Aftertreatment1FuelPressCtrl 1;
BA_ "SPN" SG_ 3221225472 Aftertreatment1FuelPressCtrl 3479;
BA_ "SigType" SG_ 3221225472 Aftertreatment1FuelRate 1;
BA_ "SPN" SG_ 3221225472 Aftertreatment1FuelRate 3481;
BA_ "SigType" SG_ 3221225472 Aftertreatment1FuelPress1 1;
BA_ "SPN" SG_ 3221225472 Aftertreatment1FuelPress1 3480;
BA_ "SigType" SG_ 3221225472 Aftertreatment1FuelPress2 1;
BA_ "SPN" SG_ 3221225472 Aftertreatment1FuelPress2 4077;
BA_ "SigType" SG_ 3221225472 ParticulateTrapOutletPress1 1;
BA_ "SPN" SG_ 3221225472 ParticulateTrapOutletPress1 3610;
BA_ "SigType" SG_ 3221225472 ParticulateTrapIntakePress1 1;
BA_ "SPN" SG_ 3221225472 ParticulateTrapIntakePress1 3609;
BA_ "SigType" SG_ 3221225472 Aftrtrtmnt1TtlNmbrOfActvRgnrtnMn 1;
BA_ "SPN" SG_ 3221225472 Aftrtrtmnt1TtlNmbrOfActvRgnrtnMn 3728;
BA_ "SigType" SG_ 3221225472 Aftrtrtmnt1TtlNmbrOfActvRgnrtnIn 1;
BA_ "SPN" SG_ 3221225472 Aftrtrtmnt1TtlNmbrOfActvRgnrtnIn 3727;
BA_ "SigType" SG_ 3221225472 Aftrtrtmnt1TtlNmbrOfPssvRgnrtns 1;
BA_ "SPN" SG_ 3221225472 Aftrtrtmnt1TtlNmbrOfPssvRgnrtns 3726;
BA_ "SigType" SG_ 3221225472 Aftrtrtmnt1TtlPssvRgnrationTime 1;
BA_ "SPN" SG_ 3221225472 Aftrtrtmnt1TtlPssvRgnrationTime 3725;
BA_ "SigType" SG_ 3221225472 Aftrtrtmnt1TtlNmbrOfActvRgnrtns 1;
BA_ "SPN" SG_ 3221225472 Aftrtrtmnt1TtlNmbrOfActvRgnrtns 3525;
BA_ "SigType" SG_ 3221225472 Aftrtreatment1TotalDisabledTime 1;
BA_ "SPN" SG_ 3221225472 Aftrtreatment1TotalDisabledTime 3524;
BA_ "SigType" SG_ 3221225472 Aftrtrtmnt1TtalRegenerationTime 1;
BA_ "SPN" SG_ 3221225472 Aftrtrtmnt1TtalRegenerationTime 3523;
BA_ "SigType" SG_ 3221225472 Aftertreatment1TotalFuelUsed 1;
BA_ "SPN" SG_ 3221225472 Aftertreatment1TotalFuelUsed 3522;
BA_ "SPN" SG_ 3221225472 Aftrtrtmnt1IntkOxygnSnsrPrlmnryF 3225;
BA_ "SPN" SG_ 3221225472 Aftrtrtmnt1IntkNOxSnsrPrlmnryFMI 3224;
BA_ "SigType" SG_ 3221225472 Aftrtrtmnt1IntkGsSnsrHeaterCtrl 4;
BA_ "SPN" SG_ 3221225472 Aftrtrtmnt1IntkGsSnsrHeaterCtrl 3223;
BA_ "SPN" SG_ 3221225472 Aftrtrtmnt1IntkGsSnsrHtrPrlmnryF 3222;
BA_ "SigType" SG_ 3221225472 Aftrtrtmnt1IntkWdRngO2RdngStble 4;
BA_ "SPN" SG_ 3221225472 Aftrtrtmnt1IntkWdRngO2RdngStble 3221;
BA_ "SigType" SG_ 3221225472 Aftrtrtmnt1IntkNOxReadingStable 4;
BA_ "SPN" SG_ 3221225472 Aftrtrtmnt1IntkNOxReadingStable 3220;
BA_ "SigType" SG_ 3221225472 Aftrtrtmnt1IntkeGasSensorAtTemp 4;
BA_ "SPN" SG_ 3221225472 Aftrtrtmnt1IntkeGasSensorAtTemp 3219;
BA_ "SigType" SG_ 3221225472 Aftrtrtmnt1IntkGsSnsrPwrInRange 4;
BA_ "SPN" SG_ 3221225472 Aftrtrtmnt1IntkGsSnsrPwrInRange 3218;
BA_ "SigType" SG_ 3221225472 Aftertreatment1IntakeO2 1;
BA_ "SPN" SG_ 3221225472 Aftertreatment1IntakeO2 3217;
BA_ "SigType" SG_ 3221225472 Aftertreatment1IntakeNOx 1;
BA_ "SPN" SG_ 3221225472 Aftertreatment1IntakeNOx 3216;
BA_ "SPN" SG_ 3221225472 Aftrtrtmnt1PrtcltTrpIntkGsTmpPrl 3244;
BA_ "SPN" SG_ 3221225472 Aftrtrtmnt1ExhstGsTmp1PrlmnryFMI 3243;
BA_ "SigType" SG_ 3221225472 Aftrtrtmnt1PrtcltTrpIntkGasTemp 1;
BA_ "SPN" SG_ 3221225472 Aftrtrtmnt1PrtcltTrpIntkGasTemp 3242;
BA_ "SigType" SG_ 3221225472 Aftertreatment1ExhaustGasTemp1 1;
BA_ "SPN" SG_ 3221225472 Aftertreatment1ExhaustGasTemp1 3241;
BA_ "SigType" SG_ 3221225472 AntitheftRandomNumber 1;
BA_ "SPN" SG_ 3221225472 AntitheftRandomNumber 1198;
BA_ "SigType" SG_ 3221225472 AntitheftComponentStatusStates 4;
BA_ "SPN" SG_ 3221225472 AntitheftComponentStatusStates 1196;
BA_ "SigType" SG_ 3221225472 AntthftEncryptnSdPrsntIndicator 4;
BA_ "SPN" SG_ 3221225472 AntthftEncryptnSdPrsntIndicator 1194;
BA_ "SigType" SG_ 3221225472 AntitheftModifyPwdStates 4;
BA_ "SPN" SG_ 3221225472 AntitheftModifyPwdStates 1197;
BA_ "SigType" SG_ 3221225472 AntitheftPwdValidIndicator 4;
BA_ "SPN" SG_ 3221225472 AntitheftPwdValidIndicator 1195;
BA_ "SigType" SG_ 3221225472 AntitheftPasswordRepresentation 1;
BA_ "SPN" SG_ 3221225472 AntitheftPasswordRepresentation 1202;
BA_ "SPN" SG_ 3221225472 AntitheftCmdStates 1201;
BA_ "SigType" SG_ 3221225472 AntitheftDesiredExitModeStates 4;
BA_ "SPN" SG_ 3221225472 AntitheftDesiredExitModeStates 1200;
BA_ "SigType" SG_ 3221225472 AntthftEncryptonIndicatorStates 4;
BA_ "SPN" SG_ 3221225472 AntthftEncryptonIndicatorStates 1199;
BA_ "SigType" SG_ 3221225472 EngAltWinding3Temp 1;
BA_ "SPN" SG_ 3221225472 EngAltWinding3Temp 1126;
BA_ "SigType" SG_ 3221225472 EngAltWinding2Temp 1;
BA_ "SPN" SG_ 3221225472 EngAltWinding2Temp 1125;
BA_ "SigType" SG_ 3221225472 EngAltWinding1Temp 1;
BA_ "SPN" SG_ 3221225472 EngAltWinding1Temp 1124;
BA_ "SigType" SG_ 3221225472 EngAltBearing2Temp 1;
BA_ "SPN" SG_ 3221225472 EngAltBearing2Temp 1123;
BA_ "SigType" SG_ 3221225472 EngAltBearing1Temp 1;
BA_ "SPN" SG_ 3221225472 EngAltBearing1Temp 1122;
BA_ "SigType" SG_ 3221225472 LevelPresetRearAxleRight 1;
BA_ "SPN" SG_ 3221225472 LevelPresetRearAxleRight 1735;
BA_ "SigType" SG_ 3221225472 LevelPresetRearAxleLeft 1;
BA_ "SPN" SG_ 3221225472 LevelPresetRearAxleLeft 1758;
BA_ "SigType" SG_ 3221225472 LevelPresetFrontAxleRight 1;
BA_ "SPN" SG_ 3221225472 LevelPresetFrontAxleRight 1757;
BA_ "SigType" SG_ 3221225472 LevelPresetFrontAxleLeft 1;
BA_ "SPN" SG_ 3221225472 LevelPresetFrontAxleLeft 1732;
BA_ "SigType" SG_ 3221225472 ElctrncShckAbsrbrCtrlMdLft_TgAxl 4;
BA_ "SPN" SG_ 3221225472 ElctrncShckAbsrbrCtrlMdLft_TgAxl 1831;
BA_ "SigType" SG_ 3221225472 ElctrncShckAbsrbrCtrlMdRearAxle 4;
BA_ "SPN" SG_ 3221225472 ElctrncShckAbsrbrCtrlMdRearAxle 1832;
BA_ "SigType" SG_ 3221225472 ElctrncShckAbsrbrCtrlMdFrntAxle 4;
BA_ "SPN" SG_ 3221225472 ElctrncShckAbsrbrCtrlMdFrntAxle 1833;
BA_ "SigType" SG_ 3221225472 DamperStiffnessLift_TagAxle 1;
BA_ "SPN" SG_ 3221225472 DamperStiffnessLift_TagAxle 1731;
BA_ "SigType" SG_ 3221225472 DamperStiffnessRearAxle 1;
BA_ "SPN" SG_ 3221225472 DamperStiffnessRearAxle 1730;
BA_ "SigType" SG_ 3221225472 DamperStiffnessFrontAxle 1;
BA_ "SPN" SG_ 3221225472 DamperStiffnessFrontAxle 1729;
BA_ "SigType" SG_ 3221225472 TestLimitMinimum 1;
BA_ "SPN" SG_ 3221225472 TestLimitMinimum 1228;
BA_ "SigType" SG_ 3221225472 TestValue 1;
BA_ "SPN" SG_ 3221225472 TestValue 1226;
BA_ "SigType" SG_ 3221225472 TestIdentifier 1;
BA_ "GenSigStartValue" SG_ 3221225472 TestIdentifier 1;
BA_ "SPN" SG_ 3221225472 TestIdentifier 1224;
BA_ "SPN" SG_ 3221225472 Aftrtrtmnt1PrtcltTrpDltPrssPrlmn 3253;
BA_ "SPN" SG_ 3221225472 Aftrtrtmnt1ExhstGsTmp2PrlmnryFMI 3252;
BA_ "SigType" SG_ 3221225472 Aftrtrtmnt1PrtclteTrapDiffPress 1;
BA_ "SPN" SG_ 3221225472 Aftrtrtmnt1PrtclteTrapDiffPress 3251;
BA_ "SigType" SG_ 3221225472 Aftertreatment1ExhaustGasTemp2 1;
BA_ "SPN" SG_ 3221225472 Aftertreatment1ExhaustGasTemp2 3249;
BA_ "SPN" SG_ 3221225472 Aftrtrtmnt1OtltOxygnSnsrPrlmnryF 3235;
BA_ "SPN" SG_ 3221225472 Aftrtrtmnt1OtltNOxSnsrPrlmnryFMI 3234;
BA_ "SigType" SG_ 3221225472 Aftrtrtmnt1OtltGsSnsrHeaterCtrl 4;
BA_ "SPN" SG_ 3221225472 Aftrtrtmnt1OtltGsSnsrHeaterCtrl 3233;
BA_ "SPN" SG_ 3221225472 Aftrtrtmnt1OtltGsSnsrHtrPrlmnryF 3232;
BA_ "SigType" SG_ 3221225472 Aftrtrtmnt1OtltWdRngO2RdngStble 4;
BA_ "SPN" SG_ 3221225472 Aftrtrtmnt1OtltWdRngO2RdngStble 3231;
BA_ "SigType" SG_ 3221225472 Aftrtrtmnt1OtltNOxReadingStable 4;
BA_ "SPN" SG_ 3221225472 Aftrtrtmnt1OtltNOxReadingStable 3230;
BA_ "SigType" SG_ 3221225472 Aftrtrtmnt1OtletGasSensorAtTemp 4;
BA_ "SPN" SG_ 3221225472 Aftrtrtmnt1OtletGasSensorAtTemp 3229;
BA_ "SigType" SG_ 3221225472 Aftrtrtmnt1OtltGsSnsrPwrInRange 4;
BA_ "SPN" SG_ 3221225472 Aftrtrtmnt1OtltGsSnsrPwrInRange 3228;
BA_ "SigType" SG_ 3221225472 Aftertreatment1OutletO2 1;
BA_ "SPN" SG_ 3221225472 Aftertreatment1OutletO2 3227;
BA_ "SigType" SG_ 3221225472 Aftertreatment1OutletNOx 1;
BA_ "SPN" SG_ 3221225472 Aftertreatment1OutletNOx 3226;
BA_ "SPN" SG_ 3221225472 Aftrtrtmnt1PrtcltTrpOtltExhstGsT 3248;
BA_ "SPN" SG_ 3221225472 Aftrtrtmnt1ExhstGsTmp3PrlmnryFMI 3247;
BA_ "SigType" SG_ 3221225472 Aftrtrtmnt1PrtcltTrpOtltGasTemp 1;
BA_ "SPN" SG_ 3221225472 Aftrtrtmnt1PrtcltTrpOtltGasTemp 3246;
BA_ "SigType" SG_ 3221225472 Aftertreatment1ExhaustGasTemp3 1;
BA_ "SPN" SG_ 3221225472 Aftertreatment1ExhaustGasTemp3 3245;
BA_ "SigType" SG_ 3221225472 PrtcltTrp1TmSncLstActvRgnration 1;
BA_ "SPN" SG_ 3221225472 PrtcltTrp1TmSncLstActvRgnration 3721;
BA_ "SigType" SG_ 3221225472 ParticulateTrap1AshLoadPercent 1;
BA_ "SPN" SG_ 3221225472 ParticulateTrap1AshLoadPercent 3720;
BA_ "SigType" SG_ 3221225472 ParticulateTrap1SootLoadPercent 1;
BA_ "SPN" SG_ 3221225472 ParticulateTrap1SootLoadPercent 3719;
BA_ "SigType" SG_ 3221225472 Aftrtrtmnt1TrpNmbrOfActvRgnrtnMn 1;
BA_ "SPN" SG_ 3221225472 Aftrtrtmnt1TrpNmbrOfActvRgnrtnMn 3740;
BA_ "SigType" SG_ 3221225472 Aftrtrtmnt1TrpNmbrOfActvRgnrtnIn 1;
BA_ "SPN" SG_ 3221225472 Aftrtrtmnt1TrpNmbrOfActvRgnrtnIn 3739;
BA_ "SigType" SG_ 3221225472 Aftrtrtmnt1TrpNmbrOfPssvRgnrtns 1;
BA_ "SPN" SG_ 3221225472 Aftrtrtmnt1TrpNmbrOfPssvRgnrtns 3738;
BA_ "SigType" SG_ 3221225472 Aftrtrtmnt1TrpPssvRgnrationTime 1;
BA_ "SPN" SG_ 3221225472 Aftrtrtmnt1TrpPssvRgnrationTime 3737;
BA_ "SigType" SG_ 3221225472 Aftrtrtmnt1TrpNmbrOfActvRgnrtns 1;
BA_ "SPN" SG_ 3221225472 Aftrtrtmnt1TrpNmbrOfActvRgnrtns 3736;
BA_ "SigType" SG_ 3221225472 Aftertreatment1TripDisabledTime 1;
BA_ "SPN" SG_ 3221225472 Aftertreatment1TripDisabledTime 3735;
BA_ "SigType" SG_ 3221225472 Aftrtrtmnt1TrpActvRgnrationTime 1;
BA_ "SPN" SG_ 3221225472 Aftrtrtmnt1TrpActvRgnrationTime 3734;
BA_ "SigType" SG_ 3221225472 Aftertreatment1TripFuelUsed 1;
BA_ "SPN" SG_ 3221225472 Aftertreatment1TripFuelUsed 3733;
BA_ "SigType" SG_ 3221225472 Aftrtreatment2AirEnableActuator 4;
BA_ "SPN" SG_ 3221225472 Aftrtreatment2AirEnableActuator 3503;
BA_ "SigType" SG_ 3221225472 Aftertreatment2PurgeAirActuator 4;
BA_ "SPN" SG_ 3221225472 Aftertreatment2PurgeAirActuator 3504;
BA_ "SigType" SG_ 3221225472 Aftrtrtmnt2AtmzationAirActuator 4;
BA_ "SPN" SG_ 3221225472 Aftrtrtmnt2AtmzationAirActuator 3505;
BA_ "SigType" SG_ 3221225472 Aftertreatment2AirSystemRelay 4;
BA_ "SPN" SG_ 3221225472 Aftertreatment2AirSystemRelay 3506;
BA_ "SigType" SG_ 3221225472 Aftrtrtment2AirPressActuatorPos 1;
BA_ "SPN" SG_ 3221225472 Aftrtrtment2AirPressActuatorPos 3502;
BA_ "SigType" SG_ 3221225472 Aftertreatment2AirPressCtrl 1;
BA_ "SPN" SG_ 3221225472 Aftertreatment2AirPressCtrl 3501;
BA_ "SigType" SG_ 3221225472 Aftertreatment2PurgeAirPress 1;
BA_ "SPN" SG_ 3221225472 Aftertreatment2PurgeAirPress 3500;
BA_ "SigType" SG_ 3221225472 Aftertreatment2SupplyAirPress 1;
BA_ "SPN" SG_ 3221225472 Aftertreatment2SupplyAirPress 3499;
BA_ "SigType" SG_ 3221225472 Aftertreatment2SecondAirPress 1;
BA_ "SPN" SG_ 3221225472 Aftertreatment2SecondAirPress 3838;
BA_ "SigType" SG_ 3221225472 Aftrtreatment2SecondAirMassFlow 1;
BA_ "SPN" SG_ 3221225472 Aftrtreatment2SecondAirMassFlow 3835;
BA_ "SigType" SG_ 3221225472 Aftertreatment2SecondAirTemp 1;
BA_ "SPN" SG_ 3221225472 Aftertreatment2SecondAirTemp 3834;
BA_ "SigType" SG_ 3221225472 Aftrtratment2SecondAirDiffPress 1;
BA_ "SPN" SG_ 3221225472 Aftrtratment2SecondAirDiffPress 3833;
BA_ "SigType" SG_ 3221225472 Aftrtratment2FuelEnableActuator 4;
BA_ "SPN" SG_ 3221225472 Aftrtratment2FuelEnableActuator 3496;
BA_ "SigType" SG_ 3221225472 Aftrtratment2RegenerationStatus 4;
BA_ "SPN" SG_ 3221225472 Aftrtratment2RegenerationStatus 3497;
BA_ "SigType" SG_ 3221225472 Aftertreatment2Ignt 4;
BA_ "SPN" SG_ 3221225472 Aftertreatment2Ignt 3498;
BA_ "SigType" SG_ 3221225472 Aftrtreatment2FuelDrainActuator 4;
BA_ "SPN" SG_ 3221225472 Aftrtreatment2FuelDrainActuator 4098;
BA_ "SigType" SG_ 3221225472 Aftertreatment2FuelPressCtrl 1;
BA_ "SPN" SG_ 3221225472 Aftertreatment2FuelPressCtrl 3493;
BA_ "SigType" SG_ 3221225472 Aftertreatment2FuelRate 1;
BA_ "SPN" SG_ 3221225472 Aftertreatment2FuelRate 3495;
BA_ "SigType" SG_ 3221225472 Aftertreatment2FuelPress 1;
BA_ "SPN" SG_ 3221225472 Aftertreatment2FuelPress 3494;
BA_ "SigType" SG_ 3221225472 ParticulateTrapOutletPress2 1;
BA_ "SPN" SG_ 3221225472 ParticulateTrapOutletPress2 3612;
BA_ "SigType" SG_ 3221225472 ParticulateTrapIntakePress2 1;
BA_ "SPN" SG_ 3221225472 ParticulateTrapIntakePress2 3611;
BA_ "SigType" SG_ 3221225472 Aftrtrtmnt2TtlNmbrOfActvRgnrtnMn 1;
BA_ "SPN" SG_ 3221225472 Aftrtrtmnt2TtlNmbrOfActvRgnrtnMn 3732;
BA_ "SigType" SG_ 3221225472 Aftrtrtmnt2TtlNmbrOfActvRgnrtnIn 1;
BA_ "SPN" SG_ 3221225472 Aftrtrtmnt2TtlNmbrOfActvRgnrtnIn 3731;
BA_ "SigType" SG_ 3221225472 Aftrtrtmnt2TtlNmbrOfPssvRgnrtns 1;
BA_ "SPN" SG_ 3221225472 Aftrtrtmnt2TtlNmbrOfPssvRgnrtns 3730;
BA_ "SigType" SG_ 3221225472 Aftrtrtmnt2TtlPssvRgnrationTime 1;
BA_ "SPN" SG_ 3221225472 Aftrtrtmnt2TtlPssvRgnrationTime 3729;
BA_ "SigType" SG_ 3221225472 Aftrtrtmnt2TtlNmbrOfActvRgnrtns 1;
BA_ "SPN" SG_ 3221225472 Aftrtrtmnt2TtlNmbrOfActvRgnrtns 3529;
BA_ "SigType" SG_ 3221225472 Aftrtreatment2TotalDisabledTime 1;
BA_ "SPN" SG_ 3221225472 Aftrtreatment2TotalDisabledTime 3528;
BA_ "SigType" SG_ 3221225472 Aftrtrtmnt2TtalRegenerationTime 1;
BA_ "SPN" SG_ 3221225472 Aftrtrtmnt2TtalRegenerationTime 3527;
BA_ "SigType" SG_ 3221225472 Aftertreatment2TotalFuelUsed 1;
BA_ "SPN" SG_ 3221225472 Aftertreatment2TotalFuelUsed 3526;
BA_ "SPN" SG_ 3221225472 Aftrtrtmnt2IntkOxygnSnsrPrlmnryF 3264;
BA_ "SPN" SG_ 3221225472 Aftrtrtmnt2IntkNOxSnsrPrlmnryFMI 3263;
BA_ "SigType" SG_ 3221225472 Aftrtrtmnt2IntkGsSnsrHeaterCtrl 4;
BA_ "SPN" SG_ 3221225472 Aftrtrtmnt2IntkGsSnsrHeaterCtrl 3262;
BA_ "SPN" SG_ 3221225472 Aftrtrtmnt2IntkGsSnsrHtrPrlmnryF 3261;
BA_ "SigType" SG_ 3221225472 Aftrtrtmnt2IntkWdRngO2RdngStble 4;
BA_ "SPN" SG_ 3221225472 Aftrtrtmnt2IntkWdRngO2RdngStble 3260;
BA_ "SigType" SG_ 3221225472 Aftrtrtmnt2IntkNOxReadingStable 4;
BA_ "SPN" SG_ 3221225472 Aftrtrtmnt2IntkNOxReadingStable 3259;
BA_ "SigType" SG_ 3221225472 Aftrtrtmnt2IntkeGasSensorAtTemp 4;
BA_ "SPN" SG_ 3221225472 Aftrtrtmnt2IntkeGasSensorAtTemp 3258;
BA_ "SigType" SG_ 3221225472 Aftrtrtmnt2IntkGsSnsrPwrInRange 4;
BA_ "SPN" SG_ 3221225472 Aftrtrtmnt2IntkGsSnsrPwrInRange 3257;
BA_ "SigType" SG_ 3221225472 Aftertreatment2IntakeO2 1;
BA_ "SPN" SG_ 3221225472 Aftertreatment2IntakeO2 3256;
BA_ "SigType" SG_ 3221225472 Aftertreatment2IntakeNOx 1;
BA_ "SPN" SG_ 3221225472 Aftertreatment2IntakeNOx 3255;
BA_ "SPN" SG_ 3221225472 Aftrtrtmnt2PrtcltTrpIntkGsTmpPrl 3278;
BA_ "SPN" SG_ 3221225472 Aftrtrtmnt2ExhstGsTmp1PrlmnryFMI 3277;
BA_ "SigType" SG_ 3221225472 Aftrtrtmnt2PrtcltTrpIntkGasTemp 1;
BA_ "SPN" SG_ 3221225472 Aftrtrtmnt2PrtcltTrpIntkGasTemp 3276;
BA_ "SigType" SG_ 3221225472 Aftertreatment2ExhaustGasTemp1 1;
BA_ "SPN" SG_ 3221225472 Aftertreatment2ExhaustGasTemp1 3275;
BA_ "SPN" SG_ 3221225472 Aftrtrtmnt2PrtcltTrpDltPrssPrlmn 3287;
BA_ "SPN" SG_ 3221225472 Aftrtrtmnt2ExhstGsTmp2PrlmnryFMI 3286;
BA_ "SigType" SG_ 3221225472 Aftrtrtmnt2PrtclteTrapDiffPress 1;
BA_ "SPN" SG_ 3221225472 Aftrtrtmnt2PrtclteTrapDiffPress 3285;
BA_ "SigType" SG_ 3221225472 Aftertreatment2ExhaustGasTemp2 1;
BA_ "SPN" SG_ 3221225472 Aftertreatment2ExhaustGasTemp2 3283;
BA_ "SPN" SG_ 3221225472 Aftrtrtmnt2OtltOxygnSnsrPrlmnryF 3274;
BA_ "SPN" SG_ 3221225472 Aftrtrtmnt2OtltNOxSnsrPrlmnryFMI 3273;
BA_ "SigType" SG_ 3221225472 Aftrtrtmnt2OtltGsSnsrHeaterCtrl 4;
BA_ "SPN" SG_ 3221225472 Aftrtrtmnt2OtltGsSnsrHeaterCtrl 3272;
BA_ "SPN" SG_ 3221225472 Aftrtrtmnt2OtltGsSnsrHtrPrlmnryF 3271;
BA_ "SigType" SG_ 3221225472 Aftrtrtmnt2OtltWdRngO2RdngStble 4;
BA_ "SPN" SG_ 3221225472 Aftrtrtmnt2OtltWdRngO2RdngStble 3270;
BA_ "SigType" SG_ 3221225472 Aftrtrtmnt2OtltNOxReadingStable 4;
BA_ "SPN" SG_ 3221225472 Aftrtrtmnt2OtltNOxReadingStable 3269;
BA_ "SigType" SG_ 3221225472 Aftrtrtmnt2OtletGasSensorAtTemp 4;
BA_ "SPN" SG_ 3221225472 Aftrtrtmnt2OtletGasSensorAtTemp 3268;
BA_ "SigType" SG_ 3221225472 Aftrtrtmnt2OtltGsSnsrPwrInRange 4;
BA_ "SPN" SG_ 3221225472 Aftrtrtmnt2OtltGsSnsrPwrInRange 3267;
BA_ "SigType" SG_ 3221225472 Aftertreatment2OutletO2 1;
BA_ "SPN" SG_ 3221225472 Aftertreatment2OutletO2 3266;
BA_ "SigType" SG_ 3221225472 Aftertreatment2OutletNOx 1;
BA_ "SPN" SG_ 3221225472 Aftertreatment2OutletNOx 3265;
BA_ "SPN" SG_ 3221225472 Aftrtrtmnt2PrtcltTrpExhstGsTmpPr 3282;
BA_ "SPN" SG_ 3221225472 Aftrtrtmnt2ExhstGsTmp3PrlmnryFMI 3281;
BA_ "SigType" SG_ 3221225472 Aftrtrtmnt2PrtcltTrpOtltGasTemp 1;
BA_ "SPN" SG_ 3221225472 Aftrtrtmnt2PrtcltTrpOtltGasTemp 3280;
BA_ "SigType" SG_ 3221225472 Aftertreatment2ExhaustGasTemp3 1;
BA_ "SPN" SG_ 3221225472 Aftertreatment2ExhaustGasTemp3 3279;
BA_ "SigType" SG_ 3221225472 PrtcltTrp2TmSncLstActvRgnration 1;
BA_ "SPN" SG_ 3221225472 PrtcltTrp2TmSncLstActvRgnration 3724;
BA_ "SigType" SG_ 3221225472 ParticulateTrap2AshLoadPercent 1;
BA_ "SPN" SG_ 3221225472 ParticulateTrap2AshLoadPercent 3723;
BA_ "SigType" SG_ 3221225472 ParticulateTrap2SootLoadPercent 1;
BA_ "SPN" SG_ 3221225472 ParticulateTrap2SootLoadPercent 3722;
BA_ "SigType" SG_ 3221225472 Aftrtrtmnt2TrpNmbrOfActvRgnrtnMn 1;
BA_ "SPN" SG_ 3221225472 Aftrtrtmnt2TrpNmbrOfActvRgnrtnMn 3748;
BA_ "SigType" SG_ 3221225472 Aftrtrtmnt2TrpNmbrOfActvRgnrtnIn 1;
BA_ "SPN" SG_ 3221225472 Aftrtrtmnt2TrpNmbrOfActvRgnrtnIn 3747;
BA_ "SigType" SG_ 3221225472 Aftrtrtmnt2TrpNmbrOfPssvRgnrtns 1;
BA_ "SPN" SG_ 3221225472 Aftrtrtmnt2TrpNmbrOfPssvRgnrtns 3746;
BA_ "SigType" SG_ 3221225472 Aftrtrtmnt2TrpPssvRgnrationTime 1;
BA_ "SPN" SG_ 3221225472 Aftrtrtmnt2TrpPssvRgnrationTime 3745;
BA_ "SigType" SG_ 3221225472 Aftrtrtmnt2TrpNmbrOfActvRgnrtns 1;
BA_ "SPN" SG_ 3221225472 Aftrtrtmnt2TrpNmbrOfActvRgnrtns 3744;
BA_ "SigType" SG_ 3221225472 Aftertreatment2TripDisabledTime 1;
BA_ "SPN" SG_ 3221225472 Aftertreatment2TripDisabledTime 3743;
BA_ "SigType" SG_ 3221225472 Aftrtrtmnt2TrpActvRgnrationTime 1;
BA_ "SPN" SG_ 3221225472 Aftrtrtmnt2TrpActvRgnrationTime 3742;
BA_ "SigType" SG_ 3221225472 Aftertreatment2TripFuelUsed 1;
BA_ "SPN" SG_ 3221225472 Aftertreatment2TripFuelUsed 3741;
BA_ "SigType" SG_ 3221225472 EngDerateRq 1;
BA_ "SPN" SG_ 3221225472 EngDerateRq 3644;
BA_ "SigType" SG_ 3221225472 EngEmergencyShutdownIndication 4;
BA_ "SPN" SG_ 3221225472 EngEmergencyShutdownIndication 3607;
BA_ "SigType" SG_ 3221225472 EngCtrlledShutdownRq 4;
BA_ "SPN" SG_ 3221225472 EngCtrlledShutdownRq 3606;
BA_ "SigType" SG_ 3221225472 EngCoolantCirculatingPumpCtrl 4;
BA_ "SPN" SG_ 3221225472 EngCoolantCirculatingPumpCtrl 3605;
BA_ "SigType" SG_ 3221225472 EngBlock_CoolantPreheaterCtrl 4;
BA_ "SPN" SG_ 3221225472 EngBlock_CoolantPreheaterCtrl 3604;
BA_ "SigType" SG_ 3221225472 EngElctrclSystmPwrCnsrvtionCtrl 4;
BA_ "SPN" SG_ 3221225472 EngElctrclSystmPwrCnsrvtionCtrl 3603;
BA_ "SigType" SG_ 3221225472 EngOilPreheaterCtrl 4;
BA_ "SPN" SG_ 3221225472 EngOilPreheaterCtrl 3602;
BA_ "SigType" SG_ 3221225472 EngOilPrimingPumpCtrl 4;
BA_ "SPN" SG_ 3221225472 EngOilPrimingPumpCtrl 3589;
BA_ "SigType" SG_ 3221225472 EngFuelShutoffValveLeakTestCtrl 4;
BA_ "SPN" SG_ 3221225472 EngFuelShutoffValveLeakTestCtrl 3601;
BA_ "SigType" SG_ 3221225472 EngFuelShutoff2Ctrl 4;
BA_ "SPN" SG_ 3221225472 EngFuelShutoff2Ctrl 2807;
BA_ "SigType" SG_ 3221225472 EngFuelShutoff1Ctrl 4;
BA_ "SPN" SG_ 3221225472 EngFuelShutoff1Ctrl 632;
BA_ "SigType" SG_ 3221225472 EngFuelShutoffVentCtrl 4;
BA_ "SPN" SG_ 3221225472 EngFuelShutoffVentCtrl 3608;
BA_ "SigType" SG_ 3221225472 TmeRemainingInEngOperatingState 1;
BA_ "SPN" SG_ 3221225472 TmeRemainingInEngOperatingState 3544;
BA_ "SigType" SG_ 3221225472 FuelPumpPrimerCtrl 4;
BA_ "SPN" SG_ 3221225472 FuelPumpPrimerCtrl 4082;
BA_ "SPN" SG_ 3221225472 EngOperatingState 3543;
BA_ "SigType" SG_ 3221225472 EngCoolantTemp2 1;
BA_ "SPN" SG_ 3221225472 EngCoolantTemp2 4076;
BA_ "SigType" SG_ 3221225472 NetVehicleWeightChange 1;
BA_ "SPN" SG_ 3221225472 NetVehicleWeightChange 413;
BA_ "SigType" SG_ 3221225472 GrossCombinationWeight 1;
BA_ "SPN" SG_ 3221225472 GrossCombinationWeight 417;
BA_ "SigType" SG_ 3221225472 ValveAssemblySupplyPress 1;
BA_ "SPN" SG_ 3221225472 ValveAssemblySupplyPress 4089;
BA_ "SigType" SG_ 3221225472 ValveAssemblyLoadSensePress 1;
BA_ "SPN" SG_ 3221225472 ValveAssemblyLoadSensePress 4088;
BA_ "SigType" SG_ 3221225472 ValvePilotPress 1;
BA_ "SPN" SG_ 3221225472 ValvePilotPress 4087;
BA_ "SigType" SG_ 3221225472 ValveLoadSensePress 1;
BA_ "SPN" SG_ 3221225472 ValveLoadSensePress 4086;
BA_ "SigType" SG_ 3221225472 BellowPressRearAxleRight 1;
BA_ "SPN" SG_ 3221225472 BellowPressRearAxleRight 1728;
BA_ "SigType" SG_ 3221225472 BellowPressRearAxleLeft 1;
BA_ "SPN" SG_ 3221225472 BellowPressRearAxleLeft 1727;
BA_ "SigType" SG_ 3221225472 BellowPressFrontAxleRight 1;
BA_ "SPN" SG_ 3221225472 BellowPressFrontAxleRight 1726;
BA_ "SigType" SG_ 3221225472 BellowPressFrontAxleLeft 1;
BA_ "SPN" SG_ 3221225472 BellowPressFrontAxleLeft 1725;
BA_ "SigType" SG_ 3221225472 RelativeLevelRearAxleRight 1;
BA_ "SPN" SG_ 3221225472 RelativeLevelRearAxleRight 1723;
BA_ "SigType" SG_ 3221225472 RelativeLevelRearAxleLeft 1;
BA_ "SPN" SG_ 3221225472 RelativeLevelRearAxleLeft 1724;
BA_ "SigType" SG_ 3221225472 RelativeLevelFrontAxleRight 1;
BA_ "SPN" SG_ 3221225472 RelativeLevelFrontAxleRight 1722;
BA_ "SigType" SG_ 3221225472 RelativeLevelFrontAxleLeft 1;
BA_ "SPN" SG_ 3221225472 RelativeLevelFrontAxleLeft 1721;
BA_ "SigType" SG_ 3221225472 ProhibitAirSuspensionCtrl 4;
BA_ "SPN" SG_ 3221225472 ProhibitAirSuspensionCtrl 3215;
BA_ "SigType" SG_ 3221225472 KneelingCmdRearAxle 4;
BA_ "SPN" SG_ 3221225472 KneelingCmdRearAxle 1829;
BA_ "SigType" SG_ 3221225472 KneelingCmdFrontAxle 4;
BA_ "SPN" SG_ 3221225472 KneelingCmdFrontAxle 1830;
BA_ "SigType" SG_ 3221225472 DamperStiffnessRqLift_TagAxle 1;
BA_ "SPN" SG_ 3221225472 DamperStiffnessRqLift_TagAxle 1720;
BA_ "SigType" SG_ 3221225472 DamperStiffnessRqRearAxle 1;
BA_ "SPN" SG_ 3221225472 DamperStiffnessRqRearAxle 1719;
BA_ "SigType" SG_ 3221225472 DamperStiffnessRqFrontAxle 1;
BA_ "SPN" SG_ 3221225472 DamperStiffnessRqFrontAxle 1718;
BA_ "SPN" SG_ 3221225472 LevelCtrlModeRq 1753;
BA_ "SPN" SG_ 3221225472 NominalLevelRqRearAxle 1750;
BA_ "SPN" SG_ 3221225472 NominalLevelRqFrontAxle 1751;
BA_ "SigType" SG_ 3221225472 KneelingCtrlModeRq 4;
BA_ "SPN" SG_ 3221225472 KneelingCtrlModeRq 1747;
BA_ "SigType" SG_ 3221225472 KneelingRqRightSide 4;
BA_ "SPN" SG_ 3221225472 KneelingRqRightSide 1748;
BA_ "SigType" SG_ 3221225472 KneelingRqLeftSide 4;
BA_ "SPN" SG_ 3221225472 KneelingRqLeftSide 1749;
BA_ "SigType" SG_ 3221225472 AutomaticTractionHelp 4;
BA_ "SPN" SG_ 3221225472 AutomaticTractionHelp 2984;
BA_ "SigType" SG_ 3221225472 LiftAxle2PosCmd 4;
BA_ "SPN" SG_ 3221225472 LiftAxle2PosCmd 1828;
BA_ "SigType" SG_ 3221225472 LiftAxle1PosCmd 4;
BA_ "SPN" SG_ 3221225472 LiftAxle1PosCmd 1752;
BA_ "SPN" SG_ 3221225472 SspensionCtrlRefusalInformation 1827;
BA_ "SigType" SG_ 3221225472 SuspensionRemoteCtrl2 4;
BA_ "SPN" SG_ 3221225472 SuspensionRemoteCtrl2 1825;
BA_ "SigType" SG_ 3221225472 SuspensionRemoteCtrl1 4;
BA_ "SPN" SG_ 3221225472 SuspensionRemoteCtrl1 1826;
BA_ "SigType" SG_ 3221225472 RearAxleInBumperRange 4;
BA_ "SPN" SG_ 3221225472 RearAxleInBumperRange 1823;
BA_ "SigType" SG_ 3221225472 FrontAxleInBumperRange 4;
BA_ "SPN" SG_ 3221225472 FrontAxleInBumperRange 1824;
BA_ "SigType" SG_ 3221225472 DoorRelease 4;
BA_ "SPN" SG_ 3221225472 DoorRelease 1744;
BA_ "SigType" SG_ 3221225472 VehicleMotionInhibit 4;
BA_ "SPN" SG_ 3221225472 VehicleMotionInhibit 1745;
BA_ "SigType" SG_ 3221225472 SecurityDevice 4;
BA_ "SPN" SG_ 3221225472 SecurityDevice 1746;
BA_ "SPN" SG_ 3221225472 LevelCtrlMode 1741;
BA_ "SPN" SG_ 3221225472 KneelingInformation 1742;
BA_ "SigType" SG_ 3221225472 LiftingCtrlModeRearAxle 4;
BA_ "SPN" SG_ 3221225472 LiftingCtrlModeRearAxle 1756;
BA_ "SigType" SG_ 3221225472 LiftingCtrlModeFrontAxle 4;
BA_ "SPN" SG_ 3221225472 LiftingCtrlModeFrontAxle 1739;
BA_ "SigType" SG_ 3221225472 LoweringCtrlModeRearAxle 4;
BA_ "SPN" SG_ 3221225472 LoweringCtrlModeRearAxle 1755;
BA_ "SigType" SG_ 3221225472 LoweringCtrlModeFrontAxle 4;
BA_ "SPN" SG_ 3221225472 LoweringCtrlModeFrontAxle 1740;
BA_ "SigType" SG_ 3221225472 AboveNominalLevelRearAxle 4;
BA_ "SPN" SG_ 3221225472 AboveNominalLevelRearAxle 1736;
BA_ "SigType" SG_ 3221225472 AboveNominalLevelFrontAxle 4;
BA_ "SPN" SG_ 3221225472 AboveNominalLevelFrontAxle 1737;
BA_ "SigType" SG_ 3221225472 BelowNominalLevelRearAxle 4;
BA_ "SPN" SG_ 3221225472 BelowNominalLevelRearAxle 1754;
BA_ "SigType" SG_ 3221225472 BelowNominalLevelFrontAxle 4;
BA_ "SPN" SG_ 3221225472 BelowNominalLevelFrontAxle 1738;
BA_ "SPN" SG_ 3221225472 NominalLevelRearAxle 1733;
BA_ "SPN" SG_ 3221225472 NominalLevelFrontAxle 1734;
BA_ "SigType" SG_ 3221225472 Alt4Status 4;
BA_ "SPN" SG_ 3221225472 Alt4Status 3356;
BA_ "SigType" SG_ 3221225472 Alt3Status 4;
BA_ "SPN" SG_ 3221225472 Alt3Status 3355;
BA_ "SigType" SG_ 3221225472 Alt2Status 4;
BA_ "SPN" SG_ 3221225472 Alt2Status 3354;
BA_ "SigType" SG_ 3221225472 Alt1Status 4;
BA_ "SPN" SG_ 3221225472 Alt1Status 3353;
BA_ "SigType" SG_ 3221225472 AltSpeed 1;
BA_ "SPN" SG_ 3221225472 AltSpeed 589;
BA_ "SigType" SG_ 3221225472 AuxAbsPressReading 1;
BA_ "SPN" SG_ 3221225472 AuxAbsPressReading 138;
BA_ "SigType" SG_ 3221225472 AuxGagePressReading1 1;
BA_ "SPN" SG_ 3221225472 AuxGagePressReading1 137;
BA_ "SigType" SG_ 3221225472 AuxVacuumPressReading 1;
BA_ "SPN" SG_ 3221225472 AuxVacuumPressReading 136;
BA_ "SigType" SG_ 3221225472 SolarSensorMax 1;
BA_ "SPN" SG_ 3221225472 SolarSensorMax 2611;
BA_ "SigType" SG_ 3221225472 SolarIntensityPercent 1;
BA_ "SPN" SG_ 3221225472 SolarIntensityPercent 2610;
BA_ "SigType" SG_ 3221225472 FlashRedStopLamp 4;
BA_ "SPN" SG_ 3221225472 FlashRedStopLamp 3039;
BA_ "SigType" SG_ 3221225472 FlashProtectLamp 4;
BA_ "SPN" SG_ 3221225472 FlashProtectLamp 3041;
BA_ "SigType" SG_ 3221225472 FlashMalfuncIndicatorLamp 4;
BA_ "SPN" SG_ 3221225472 FlashMalfuncIndicatorLamp 3038;
BA_ "SigType" SG_ 3221225472 FlashAmberWarningLamp 4;
BA_ "SPN" SG_ 3221225472 FlashAmberWarningLamp 3040;
BA_ "SigType" SG_ 3221225472 MalfunctionIndicatorLampStatus 4;
BA_ "SPN" SG_ 3221225472 MalfunctionIndicatorLampStatus 1213;
BA_ "SigType" SG_ 3221225472 RedStopLampState 4;
BA_ "SPN" SG_ 3221225472 RedStopLampState 623;
BA_ "SigType" SG_ 3221225472 AmberWarningLampStatus 4;
BA_ "SPN" SG_ 3221225472 AmberWarningLampStatus 624;
BA_ "SigType" SG_ 3221225472 ProtectLampStatus 4;
BA_ "SPN" SG_ 3221225472 ProtectLampStatus 987;
BA_ "SigType" SG_ 3221225472 DTC5 7;
BA_ "SigType" SG_ 3221225472 DTC4 7;
BA_ "SigType" SG_ 3221225472 DTC3 7;
BA_ "SigType" SG_ 3221225472 DTC2 7;
BA_ "SigType" SG_ 3221225472 UtlityOverallPowerFactorLagging 4;
BA_ "SPN" SG_ 3221225472 UtlityOverallPowerFactorLagging 2522;
BA_ "SigType" SG_ 3221225472 UtilityOverallPowerFactor 1;
BA_ "SPN" SG_ 3221225472 UtilityOverallPowerFactor 2498;
BA_ "SigType" SG_ 3221225472 UtilityTotalReactivePower 1;
BA_ "SPN" SG_ 3221225472 UtilityTotalReactivePower 2490;
BA_ "SigType" SG_ 3221225472 UtilityTotalApparentPower 1;
BA_ "SPN" SG_ 3221225472 UtilityTotalApparentPower 2494;
BA_ "SigType" SG_ 3221225472 UtilityTotalRealPower 1;
BA_ "SPN" SG_ 3221225472 UtilityTotalRealPower 2486;
BA_ "SigType" SG_ 3221225472 UtilityTotalKWHoursImport 4;
BA_ "SPN" SG_ 3221225472 UtilityTotalKWHoursImport 2503;
BA_ "SigType" SG_ 3221225472 UtilityTotalKWHoursExport 4;
BA_ "SPN" SG_ 3221225472 UtilityTotalKWHoursExport 2502;
BA_ "SigType" SG_ 3221225472 UtilityPhaseCPowerFactorLagging 4;
BA_ "SPN" SG_ 3221225472 UtilityPhaseCPowerFactorLagging 2525;
BA_ "SigType" SG_ 3221225472 UtilityPhaseCPowerFactor 1;
BA_ "SPN" SG_ 3221225472 UtilityPhaseCPowerFactor 2501;
BA_ "SigType" SG_ 3221225472 UtilityPhaseCReactivePower 1;
BA_ "SPN" SG_ 3221225472 UtilityPhaseCReactivePower 2493;
BA_ "SigType" SG_ 3221225472 UtilityPhaseCApparentPower 1;
BA_ "SPN" SG_ 3221225472 UtilityPhaseCApparentPower 2497;
BA_ "SigType" SG_ 3221225472 UtilityPhaseCRealPower 1;
BA_ "SPN" SG_ 3221225472 UtilityPhaseCRealPower 2489;
BA_ "SigType" SG_ 3221225472 UtilityPhaseCACRMSCurrent 1;
BA_ "SPN" SG_ 3221225472 UtilityPhaseCACRMSCurrent 2485;
BA_ "SigType" SG_ 3221225472 UtilityPhaseCACFrequency 1;
BA_ "SPN" SG_ 3221225472 UtilityPhaseCACFrequency 2473;
BA_ "SigType" SG_ 3221225472 UtltyPhsCLneNeutralACRMSVoltage 1;
BA_ "SPN" SG_ 3221225472 UtltyPhsCLneNeutralACRMSVoltage 2481;
BA_ "SigType" SG_ 3221225472 UtltyPhseCALineLineACRMSVoltage 1;
BA_ "SPN" SG_ 3221225472 UtltyPhseCALineLineACRMSVoltage 2477;
BA_ "SigType" SG_ 3221225472 UtilityPhaseBPowerFactorLagging 4;
BA_ "SPN" SG_ 3221225472 UtilityPhaseBPowerFactorLagging 2524;
BA_ "SigType" SG_ 3221225472 UtilityPhaseBPowerFactor 1;
BA_ "SPN" SG_ 3221225472 UtilityPhaseBPowerFactor 2500;
BA_ "SigType" SG_ 3221225472 UtilityPhaseBReactivePower 1;
BA_ "SPN" SG_ 3221225472 UtilityPhaseBReactivePower 2492;
BA_ "SigType" SG_ 3221225472 UtilityPhaseBApparentPower 1;
BA_ "SPN" SG_ 3221225472 UtilityPhaseBApparentPower 2496;
BA_ "SigType" SG_ 3221225472 UtilityPhaseBRealPower 1;
BA_ "SPN" SG_ 3221225472 UtilityPhaseBRealPower 2488;
BA_ "SigType" SG_ 3221225472 UtilityPhaseBACRMSCurrent 1;
BA_ "SPN" SG_ 3221225472 UtilityPhaseBACRMSCurrent 2484;
BA_ "SigType" SG_ 3221225472 UtilityPhaseBACFrequency 1;
BA_ "SPN" SG_ 3221225472 UtilityPhaseBACFrequency 2472;
BA_ "SigType" SG_ 3221225472 UtltyPhsBLneNeutralACRMSVoltage 1;
BA_ "SPN" SG_ 3221225472 UtltyPhsBLneNeutralACRMSVoltage 2480;
BA_ "SigType" SG_ 3221225472 UtltyPhseBCLineLineACRMSVoltage 1;
BA_ "SPN" SG_ 3221225472 UtltyPhseBCLineLineACRMSVoltage 2476;
BA_ "SigType" SG_ 3221225472 UtilityPhaseAPowerFactorLagging 4;
BA_ "SPN" SG_ 3221225472 UtilityPhaseAPowerFactorLagging 2523;
BA_ "SigType" SG_ 3221225472 UtilityPhaseAPowerFactor 1;
BA_ "SPN" SG_ 3221225472 UtilityPhaseAPowerFactor 2499;
BA_ "SigType" SG_ 3221225472 UtilityPhaseAReactivePower 1;
BA_ "SPN" SG_ 3221225472 UtilityPhaseAReactivePower 2491;
BA_ "SigType" SG_ 3221225472 UtilityPhaseAApparentPower 1;
BA_ "SPN" SG_ 3221225472 UtilityPhaseAApparentPower 2495;
BA_ "SigType" SG_ 3221225472 UtilityPhaseARealPower 1;
BA_ "SPN" SG_ 3221225472 UtilityPhaseARealPower 2487;
BA_ "SigType" SG_ 3221225472 UtilityPhaseAACRMSCurrent 1;
BA_ "SPN" SG_ 3221225472 UtilityPhaseAACRMSCurrent 2483;
BA_ "SigType" SG_ 3221225472 UtilityPhaseAACFrequency 1;
BA_ "SPN" SG_ 3221225472 UtilityPhaseAACFrequency 2471;
BA_ "SigType" SG_ 3221225472 UtltyPhsALneNeutralACRMSVoltage 1;
BA_ "SPN" SG_ 3221225472 UtltyPhsALneNeutralACRMSVoltage 2479;
BA_ "SigType" SG_ 3221225472 UtltyPhseABLineLineACRMSVoltage 1;
BA_ "SPN" SG_ 3221225472 UtltyPhseABLineLineACRMSVoltage 2475;
BA_ "SigType" SG_ 3221225472 UtilityAverageACRMSCurrent 1;
BA_ "SPN" SG_ 3221225472 UtilityAverageACRMSCurrent 2482;
BA_ "SigType" SG_ 3221225472 UtilityAverageACFrequency 1;
BA_ "SPN" SG_ 3221225472 UtilityAverageACFrequency 2470;
BA_ "SigType" SG_ 3221225472 UtltyAvrgLneNeutralACRMSVoltage 1;
BA_ "SPN" SG_ 3221225472 UtltyAvrgLneNeutralACRMSVoltage 2478;
BA_ "SigType" SG_ 3221225472 UtltyAvrageLineLineACRMSVoltage 1;
BA_ "SPN" SG_ 3221225472 UtltyAvrageLineLineACRMSVoltage 2474;
BA_ "SigType" SG_ 3221225472 GnrtorOverallPowerFactorLagging 4;
BA_ "SPN" SG_ 3221225472 GnrtorOverallPowerFactorLagging 2518;
BA_ "SigType" SG_ 3221225472 GeneratorOverallPowerFactor 1;
BA_ "SPN" SG_ 3221225472 GeneratorOverallPowerFactor 2464;
BA_ "SigType" SG_ 3221225472 GeneratorTotalReactivePower 1;
BA_ "SPN" SG_ 3221225472 GeneratorTotalReactivePower 2456;
BA_ "SigType" SG_ 3221225472 GeneratorTotalApparentPower 1;
BA_ "SPN" SG_ 3221225472 GeneratorTotalApparentPower 2460;
BA_ "SigType" SG_ 3221225472 GeneratorTotalRealPower 1;
BA_ "SPN" SG_ 3221225472 GeneratorTotalRealPower 2452;
BA_ "SigType" SG_ 3221225472 GeneratorTotalKWHoursImport 4;
BA_ "SPN" SG_ 3221225472 GeneratorTotalKWHoursImport 2469;
BA_ "SigType" SG_ 3221225472 GeneratorTotalKWHoursExport 4;
BA_ "SPN" SG_ 3221225472 GeneratorTotalKWHoursExport 2468;
BA_ "SigType" SG_ 3221225472 GnratorPhaseCPowerFactorLagging 4;
BA_ "SPN" SG_ 3221225472 GnratorPhaseCPowerFactorLagging 2521;
BA_ "SigType" SG_ 3221225472 GeneratorPhaseCPowerFactor 1;
BA_ "SPN" SG_ 3221225472 GeneratorPhaseCPowerFactor 2467;
BA_ "SigType" SG_ 3221225472 GeneratorPhaseCReactivePower 1;
BA_ "SPN" SG_ 3221225472 GeneratorPhaseCReactivePower 2459;
BA_ "SigType" SG_ 3221225472 GeneratorPhaseCApparentPower 1;
BA_ "SPN" SG_ 3221225472 GeneratorPhaseCApparentPower 2463;
BA_ "SigType" SG_ 3221225472 GeneratorPhaseCRealPower 1;
BA_ "SPN" SG_ 3221225472 GeneratorPhaseCRealPower 2455;
BA_ "SigType" SG_ 3221225472 GeneratorPhaseCACRMSCurrent 1;
BA_ "SPN" SG_ 3221225472 GeneratorPhaseCACRMSCurrent 2451;
BA_ "SigType" SG_ 3221225472 GeneratorPhaseCACFrequency 1;
BA_ "SPN" SG_ 3221225472 GeneratorPhaseCACFrequency 2439;
BA_ "SigType" SG_ 3221225472 GnrtrPhsCLneNeutralACRMSVoltage 1;
BA_ "SPN" SG_ 3221225472 GnrtrPhsCLneNeutralACRMSVoltage 2447;
BA_ "SigType" SG_ 3221225472 GnrtrPhseCALineLineACRMSVoltage 1;
BA_ "SPN" SG_ 3221225472 GnrtrPhseCALineLineACRMSVoltage 2443;
BA_ "SigType" SG_ 3221225472 GnratorPhaseBPowerFactorLagging 4;
BA_ "SPN" SG_ 3221225472 GnratorPhaseBPowerFactorLagging 2520;
BA_ "SigType" SG_ 3221225472 GeneratorPhaseBPowerFactor 1;
BA_ "SPN" SG_ 3221225472 GeneratorPhaseBPowerFactor 2466;
BA_ "SigType" SG_ 3221225472 GeneratorPhaseBReactivePower 1;
BA_ "SPN" SG_ 3221225472 GeneratorPhaseBReactivePower 2458;
BA_ "SigType" SG_ 3221225472 GeneratorPhaseBApparentPower 1;
BA_ "SPN" SG_ 3221225472 GeneratorPhaseBApparentPower 2462;
BA_ "SigType" SG_ 3221225472 GeneratorPhaseBRealPower 1;
BA_ "SPN" SG_ 3221225472 GeneratorPhaseBRealPower 2454;
BA_ "SigType" SG_ 3221225472 GeneratorPhaseBACRMSCurrent 1;
BA_ "SPN" SG_ 3221225472 GeneratorPhaseBACRMSCurrent 2450;
BA_ "SigType" SG_ 3221225472 GeneratorPhaseBACFrequency 1;
BA_ "SPN" SG_ 3221225472 GeneratorPhaseBACFrequency 2438;
BA_ "SigType" SG_ 3221225472 GnrtrPhsBLneNeutralACRMSVoltage 1;
BA_ "SPN" SG_ 3221225472 GnrtrPhsBLneNeutralACRMSVoltage 2446;
BA_ "SigType" SG_ 3221225472 GnrtrPhseBCLineLineACRMSVoltage 1;
BA_ "SPN" SG_ 3221225472 GnrtrPhseBCLineLineACRMSVoltage 2442;
BA_ "SigType" SG_ 3221225472 GnratorPhaseAPowerFactorLagging 4;
BA_ "SPN" SG_ 3221225472 GnratorPhaseAPowerFactorLagging 2519;
BA_ "SigType" SG_ 3221225472 GeneratorPhaseAPowerFactor 1;
BA_ "SPN" SG_ 3221225472 GeneratorPhaseAPowerFactor 2465;
BA_ "SigType" SG_ 3221225472 GeneratorPhaseAReactivePower 1;
BA_ "SPN" SG_ 3221225472 GeneratorPhaseAReactivePower 2457;
BA_ "SigType" SG_ 3221225472 GeneratorPhaseAApparentPower 1;
BA_ "SPN" SG_ 3221225472 GeneratorPhaseAApparentPower 2461;
VAL_ 3221225472 EngStartEnableDevice1Config 15 "NotAvailable" 5 "1110Reserved" 4 "ElectricInletAirHeaterInstalled" 3 "EtherInjectionInstalled" 2 "FuelledStartInstalled" 1 "GlowPlugsInstalled" 0 "NoStartEnableDevice1Installed" ;
VAL_ 3221225472 EngStartEnableDevice2 2 "Reserved" 1 "StartEnableON" 0 "StartEnableOFF" ;
VAL_ 3221225472 EngStartEnableDevice1 3 "NotAvailible" 2 "Reserved" 1 "StartEnableON" 0 "StartEnableOFF" ;
VAL_ 3221225472 TransOilLevelRq 3 "DontCare_TakeNoAction" 2 "Reserved" 1 "TransOilLevelReadingDesired" 0 "NoTransOilLevelReadingDesired" ;
VAL_ 3221225472 FifthWheelReleaseCtrl 3 "NotAvailable" 2 "Error" 1 "CplrUnlckdTrlrCnBUnhtchdHitched" 0 "CouplerLocked" ;
VAL_ 3221225472 FfthWhlRlaseCtrlSecurityLockout 3 "NotAvailable" 2 "Error" 1 "FifthWheelReleaseEnabled" 0 "FifthWheelReleaseDisabled" ;
VAL_ 3221225472 TransferCaseSelectorSwitch 6 "ErrorIndicator" 3 "101ReservedForSAEAssignment" 2 "Neutral" 1 "Wheel" ;
VAL_ 3221225472 RqCabZoneHeating 3 "DontCare_TakeNoAction" 2 "Reserved" 1 "HeatCabZone" 0 "DoNotCabEngZone" ;
VAL_ 3221225472 RqEngZoneHeating 3 "DontCare_TakeNoAction" 2 "Reserved" 1 "HeatEngZone" 0 "DoNotHeatEngZone" ;
VAL_ 3221225472 AuxHeaterModeRq 15 "DontCare_TakeNoAction" 14 "Reserved" 4 "1101NotDefined" 3 "NormalMode" 2 "EconomyMode" 1 "OffDTADRPrErpnRgltnsFrTrnsprtOf" 0 "DeactivateAuxHeater" ;
VAL_ 3221225472 SeatBeltSwitch 3 "NotAvailable" 2 "ErrrSwtchStteCannotBeDetermined" 1 "OKSeatBeltIsBuckled" 0 "NOTBuckled" ;
VAL_ 3221225472 OperatorSeatDirectionSwitch 3 "NotAvailable" 2 "Error" 1 "OperatorSeatIsFacingForward" 0 "OperatorSeatNotFacingForward" ;
VAL_ 3221225472 BatteryMainSwitchHoldRq 3 "DontCare_TakeNoAction" 2 "undefined" 1 "HoldBatteryMainSwitch" 0 "ReleaseBatteryMainSwitch" ;
VAL_ 3221225472 AuxHeaterCoolantPumpRq 3 "DontCare_TakeNoAction" 2 "Reserved" 1 "ActivateWaterPump" 0 "DeactivateWaterPump" ;
VAL_ 3221225472 BatteryMainSwitchHoldState 3 "DontCare_TakeNoAction" 2 "Reserved" 1 "BatteryMainSwitchHeld" 0 "BatteryMainSwitchNotHeld" ;
VAL_ 3221225472 Joystick3XAxisDetentPosStatus 3 "NotAvailable" 2 "ErrorIndicator" 1 "InDetentPos" 0 "NotInDetentPos" ;
VAL_ 3221225472 Joystick3Button9PressedStatus 3 "NotAvailable" 2 "ErrorIndicator" 1 "ButtonPressed" 0 "ButtonNotPressed" ;
VAL_ 3221225472 Joystick3Button10PressedStatus 3 "NotAvailable" 2 "ErrorIndicator" 1 "ButtonPressed" 0 "ButtonNotPressed" ;
VAL_ 3221225472 Joystick3Button11PressedStatus 3 "NotAvailable" 2 "ErrorIndicator" 1 "ButtonPressed" 0 "ButtonNotPressed" ;
VAL_ 3221225472 Joystick3Button12PressedStatus 3 "NotAvailable" 2 "ErrorIndicator" 1 "ButtonPressed" 0 "ButtonNotPressed" ;
VAL_ 3221225472 Joystick3YAxisDetentPosStatus 3 "NotAvailable" 2 "ErrorIndicator" 1 "InDetentPos" 0 "NotInDetentPos" ;
VAL_ 3221225472 Jystck3YAxsLvrFrwrdPstvPsStatus 3 "NotAvailable" 2 "ErrorIndicator" 1 "OnPositiveSideOfNeutral" 0 "NotOnPositiveSideOfNeutral" ;
VAL_ 3221225472 Jystck3YAxsLvrBckNgtvePosStatus 3 "NotAvailable" 2 "ErrorIndicator" 1 "OnNegativeSideOfNeutral" 0 "NotOnNegativeSideOfNeutral" ;
VAL_ 3221225472 Joystick3YAxisNeutralPosStatus 3 "NotAvailable" 2 "ErrorIndicator" 1 "InNeutralPos" 0 "NotInNeutralPos" ;
VAL_ 3221225472 Jystck3XAxsLvrRghtPstvPosStatus 3 "NotAvailable" 2 "ErrorIndicator" 1 "OnPositiveSideOfNeutral" 0 "NotOnPositiveSideOfNeutral" ;
VAL_ 3221225472 Jystck3XAxsLvrLftNgtvePosStatus 2 "ErrorIndicator" 1 "OnNegativeSideOfNeutral" 0 "NotOnNegativeSideOfNeutral" 3 "NotAvailable" ;
VAL_ 3221225472 Joystick3XAxisNeutralPosStatus 3 "NotAvailable" 2 "ErrorIndicator" 1 "InNeutralPos" 0 "NotInNeutralPos" ;
VAL_ 3221225472 Joystick3Button5PressedStatus 3 "NotAvailable" 2 "ErrorIndicator" 1 "ButtonPressed" 0 "ButtonNotPressed" ;
VAL_ 3221225472 Joystick3Button6PressedStatus 3 "NotAvailable" 2 "ErrorIndicator" 1 "ButtonPressed" 0 "ButtonNotPressed" ;
VAL_ 3221225472 Joystick3Button7PressedStatus 3 "NotAvailable" 2 "ErrorIndicator" 1 "ButtonPressed" 0 "ButtonNotPressed" ;
VAL_ 3221225472 Joystick3Button8PressedStatus 3 "NotAvailable" 2 "ErrorIndicator" 1 "ButtonPressed" 0 "ButtonNotPressed" ;
VAL_ 3221225472 Joystick3Button1PressedStatus 3 "NotAvailable" 2 "ErrorIndicator" 1 "ButtonPressed" 0 "ButtonNotPressed" ;
VAL_ 3221225472 Joystick3Button2PressedStatus 3 "NotAvailable" 2 "ErrorIndicator" 1 "ButtonPressed" 0 "ButtonNotPressed" ;
VAL_ 3221225472 Joystick3Button3PressedStatus 3 "NotAvailable" 2 "ErrorIndicator" 1 "ButtonPressed" 0 "ButtonNotPressed" ;
VAL_ 3221225472 Joystick3Button4PressedStatus 3 "NotAvailable" 2 "ErrorIndicator" 1 "ButtonPressed" 0 "ButtonNotPressed" ;
VAL_ 3221225472 Joystick2XAxisDetentPosStatus 3 "NotAvailable" 2 "ErrorIndicator" 1 "InDetentPos" 0 "NotInDetentPos" ;
VAL_ 3221225472 Joystick2YAxisDetentPosStatus 3 "NotAvailable" 2 "ErrorIndicator" 1 "InDetentPos" 0 "NotInDetentPos" ;
VAL_ 3221225472 Jystck2YAxsLvrFrwrdPstvPsStatus 3 "NotAvailable" 2 "ErrorIndicator" 1 "OnPositiveSideOfNeutral" 0 "NotOnPositiveSideOfNeutral" ;
VAL_ 3221225472 Jystck2YAxsLvrBckNgtvePosStatus 3 "NotAvailable" 2 "ErrorIndicator" 1 "OnNegativeSideOfNeutral" 0 "NotOnNegativeSideOfNeutral" ;
VAL_ 3221225472 Joystick2YAxisNeutralPosStatus 3 "NotAvailable" 2 "ErrorIndicator" 1 "InNeutralPos" 0 "NotInNeutralPos" ;
VAL_ 3221225472 Jystck2XAxsLvrRghtPstvPosStatus 3 "NotAvailable" 2 "ErrorIndicator" 1 "OnPositiveSideOfNeutral" 0 "NotOnPositiveSideOfNeutral" ;
VAL_ 3221225472 Jystck2XAxsLvrLftNgtvePosStatus 3 "NotAvailable" 2 "ErrorIndicator" 1 "OnNegativeSideOfNeutral" 0 "NotOnNegativeSideOfNeutral" ;
VAL_ 3221225472 Joystick2XAxisNeutralPosStatus 3 "NotAvailable" 2 "ErrorIndicator" 1 "InNeutralPos" 0 "NotInNeutralPos" ;
VAL_ 3221225472 Joystick2Button9PressedStatus 3 "NotAvailable" 2 "ErrorIndicator" 1 "ButtonPressed" 0 "ButtonNotPressed" ;
VAL_ 3221225472 Joystick2Button10PressedStatus 3 "NotAvailable" 2 "ErrorIndicator" 1 "ButtonPressed" 0 "ButtonNotPressed" ;
VAL_ 3221225472 Joystick2Button11PressedStatus 3 "NotAvailable" 2 "ErrorIndicator" 1 "ButtonPressed" 0 "ButtonNotPressed" ;
VAL_ 3221225472 Joystick2Button12PressedStatus 3 "NotAvailable" 2 "ErrorIndicator" 1 "ButtonPressed" 0 "ButtonNotPressed" ;
VAL_ 3221225472 Joystick2Button5PressedStatus 3 "NotAvailable" 2 "ErrorIndicator" 1 "ButtonPressed" 0 "ButtonNotPressed" ;
VAL_ 3221225472 Joystick2Button6PressedStatus 3 "NotAvailable" 2 "ErrorIndicator" 1 "ButtonPressed" 0 "ButtonNotPressed" ;
VAL_ 3221225472 Joystick2Button7PressedStatus 3 "NotAvailable" 2 "ErrorIndicator" 1 "ButtonPressed" 0 "ButtonNotPressed" ;
VAL_ 3221225472 Joystick2Button8PressedStatus 3 "NotAvailable" 2 "ErrorIndicator" 1 "ButtonPressed" 0 "ButtonNotPressed" ;
VAL_ 3221225472 Joystick2Button1PressedStatus 3 "NotAvailable" 2 "ErrorIndicator" 1 "ButtonPressed" 0 "ButtonNotPressed" ;
VAL_ 3221225472 Joystick2Button2PressedStatus 3 "NotAvailable" 2 "ErrorIndicator" 1 "ButtonPressed" 0 "ButtonNotPressed" ;
VAL_ 3221225472 Joystick2Button3PressedStatus 3 "NotAvailable" 2 "ErrorIndicator" 1 "ButtonPressed" 0 "ButtonNotPressed" ;
VAL_ 3221225472 Joystick2Button4PressedStatus 3 "NotAvailable" 2 "ErrorIndicator" 1 "ButtonPressed" 0 "ButtonNotPressed" ;
VAL_ 3221225472 Joystick1XAxisDetentPosStatus 3 "NotAvailable" 2 "ErrorIndicator" 1 "InDetentPos" 0 "NotInDetentPos" ;
VAL_ 3221225472 Joystick1YAxisDetentPosStatus 3 "NotAvailable" 2 "ErrorIndicator" 1 "InDetentPos" 0 "NotInDetentPos" ;
VAL_ 3221225472 Jystck1YAxsLvrFrwrdPstvPsStatus 1 "OnPositiveSideOfNeutral" 0 "NotOnPositiveSideOfNeutral" 3 "NotAvailable" 2 "ErrorIndicator" ;
VAL_ 3221225472 Jystck1YAxsLvrBckNgtvePosStatus 3 "NotAvailable" 2 "ErrorIndicator" 1 "OnNegativeSideOfNeutral" 0 "NotOnNegativeSideOfNeutral" ;
VAL_ 3221225472 Joystick1YAxisNeutralPosStatus 3 "NotAvailable" 2 "ErrorIndicator" 1 "InNeutralPos" 0 "NotInNeutralPos" ;
VAL_ 3221225472 Joystick1Button9PressedStatus 3 "NotAvailable" 2 "ErrorIndicator" 1 "ButtonPressed" 0 "ButtonNotPressed" ;
VAL_ 3221225472 Joystick1Button10PressedStatus 3 "NotAvailable" 2 "ErrorIndicator" 1 "ButtonPressed" 0 "ButtonNotPressed" ;
VAL_ 3221225472 Joystick1Button11PressedStatus 3 "NotAvailable" 2 "ErrorIndicator" 1 "ButtonPressed" 0 "ButtonNotPressed" ;
VAL_ 3221225472 Joystick1Button12PressedStatus 3 "NotAvailable" 2 "ErrorIndicator" 1 "ButtonPressed" 0 "ButtonNotPressed" ;
VAL_ 3221225472 Joystick1Button5PressedStatus 3 "NotAvailable" 2 "ErrorIndicator" 1 "ButtonPressed" 0 "ButtonNotPressed" ;
VAL_ 3221225472 Joystick1Button6PressedStatus 3 "NotAvailable" 2 "ErrorIndicator" 1 "ButtonPressed" 0 "ButtonNotPressed" ;
VAL_ 3221225472 Joystick1Button7PressedStatus 3 "NotAvailable" 2 "ErrorIndicator" 1 "ButtonPressed" 0 "ButtonNotPressed" ;
VAL_ 3221225472 Joystick1Button8PressedStatus 3 "NotAvailable" 2 "ErrorIndicator" 1 "ButtonPressed" 0 "ButtonNotPressed" ;
VAL_ 3221225472 Joystick1Button1PressedStatus 3 "NotAvailable" 2 "ErrorIndicator" 1 "ButtonPressed" 0 "ButtonNotPressed" ;
VAL_ 3221225472 Joystick1Button2PressedStatus 3 "NotAvailable" 2 "ErrorIndicator" 1 "ButtonPressed" 0 "ButtonNotPressed" ;
VAL_ 3221225472 Joystick1Button3PressedStatus 3 "NotAvailable" 2 "ErrorIndicator" 1 "ButtonPressed" 0 "ButtonNotPressed" ;
VAL_ 3221225472 Joystick1Button4PressedStatus 3 "NotAvailable" 2 "ErrorIndicator" 1 "ButtonPressed" 0 "ButtonNotPressed" ;
VAL_ 3221225472 Jystck1XAxsLvrRghtPstvPosStatus 3 "NotAvailable" 2 "ErrorIndicator" 1 "OnPositiveSideOfNeutral" 0 "NotOnPositiveSideOfNeutral" ;
VAL_ 3221225472 Jystck1XAxsLvrLftNgtvePosStatus 3 "NotAvailable" 2 "ErrorIndicator" 1 "OnNegativeSideOfNeutral" 0 "NotOnNegativeSideOfNeutral" ;
VAL_ 3221225472 Joystick1XAxisNeutralPosStatus 3 "NotAvailable" 2 "ErrorIndicator" 1 "InNeutralPos" 0 "NotInNeutralPos" ;
VAL_ 3221225472 ParkingBrakeRedWarningSignal 3 "TakeNoAction" 2 "Reserved" 1 "On" 0 "Off" ;
VAL_ 3221225472 ParkBrakeReleaseInhibitStatus 3 "Unavailable" 2 "Error" 1 "ParkBrakeReleaseIsInhibited" 0 "ParkBrakeReleaseIsNotInhibited" ;
VAL_ 3221225472 ParkingBrakeActuator 3 "NotAvailable" 2 "Error" 1 "ParkingBrakeActuatorActive" 0 "ParkingBrakeActuatorInactive" ;
VAL_ 3221225472 EngExhstGsOxygnSnsrClsdLpOprtnBn 15 "NotSupported" 5 "1110Reserved" 4 "ClsdLpBtFltWthAtLstOnOxygnSnsrM" 3 "OpnLoopDueToDetectedSystemFault" 2 "OpenLoopDueToDrivingConditions" 1 "ClsdLpUsngOxygnSnsrAsFdbckFrFlC" 0 "OpnLpHsNtYtStsfdCndtnsTGClsdLop" ;
VAL_ 3221225472 EngSpdSnsor1TimingPatternStatus 3 "NotAvailable" 2 "Error" 1 "OK" 0 "NotOK" ;
VAL_ 3221225472 EngSpdSnsor2TimingPatternStatus 3 "NotAvailable" 2 "Error" 1 "OK" 0 "NotOK" ;
VAL_ 3221225472 EngSpdSnsor3TimingPatternStatus 3 "NotAvailable" 2 "Error" 1 "OK" 0 "NotOK" ;
VAL_ 3221225472 EngCoolantThermostatMode 3 "DontCare_Reserved" 2 "Reserved" 1 "PosCtrlMode" 0 "TempCtrlMode" ;
VAL_ 3221225472 Aftrtreatment1AirEnableActuator 3 "notAvailable" 2 "reservedForSAEAssignment" 1 "active" 0 "notActive" ;
VAL_ 3221225472 Aftertreatment1PurgeAirActuator 3 "notAvailable" 2 "reservedForSAEAssignment" 1 "active" 0 "notActive" ;
VAL_ 3221225472 Aftrtrtmnt1AtmzationAirActuator 3 "notAvailable" 2 "reservedForSAEAssignment" 1 "active" 0 "notActive" ;
VAL_ 3221225472 Aftertreatment1AirSystemRelay 3 "notAvailable" 2 "reservedForSAEAssignment" 1 "active" 0 "notActive" ;
VAL_ 3221225472 Aftrtratment1FuelEnableActuator 3 "notAvailable" 2 "reservedForSAEAssignment" 1 "active" 0 "notActive" ;
VAL_ 3221225472 Aftrtratment1RegenerationStatus 3 "notAvailable" 2 "reservedForSAEAssignment" 1 "active" 0 "notActive" ;
VAL_ 3221225472 Aftertreatment1Ignt 3 "notAvailable" 2 "reservedForSAEAssignment" 1 "active" 0 "notActive" ;
VAL_ 3221225472 Aftrtreatment1FuelDrainActuator 3 "notAvailable" 2 "reservedForSAEAssignment" 1 "active" 0 "notActive" ;
VAL_ 3221225472 Aftrtrtmnt1IntkGsSnsrHeaterCtrl 3 "HeaterOff" 2 "Preheat1" 1 "Preheat2" 0 "Automatic" ;
VAL_ 3221225472 Aftrtrtmnt1IntkWdRngO2RdngStble 3 "NotAvailable" 2 "Error" 1 "Stable" 0 "NotStable" ;
VAL_ 3221225472 Aftrtrtmnt1IntkNOxReadingStable 3 "NotAvailable" 2 "Error" 1 "Stable" 0 "NotStable" ;
VAL_ 3221225472 Aftrtrtmnt1IntkGsSnsrPwrInRange 3 "NotAvailable" 2 "Error" 1 "InRange" 0 "NotInRange" ;
VAL_ 3221225472 AntitheftComponentStatusStates 3 "NotDefined" 2 "BlckdThsSttIndctsThtALckUnlckCm" 1 "Locked" 0 "UnlckdThsSttIndctsThtCmpnntCnBS" ;
VAL_ 3221225472 AntthftEncryptnSdPrsntIndicator 3 "NotAvailable" 2 "Error" 1 "RandomNumberIsPresent" 0 "RandomNumberIsNotPresent" ;
VAL_ 3221225472 AntitheftModifyPwdStates 3 "Notvalid" 2 "EmptyOfPwdsThsSttIndctsThtCmpnn" 1 "FullofPwds" 0 "OkThsSttIndctsThtRqWsSccssfllyP" ;
VAL_ 3221225472 AntitheftPwdValidIndicator 3 "NotAvailable" 2 "Error" 1 "PwdIsAValidatedPassword" 0 "PwdIsNotAValidatedPassword" ;
VAL_ 3221225472 AntitheftCmdStates 6 "111NotDefined" 5 "Login" 4 "ChckSttsThsSttRprsntsARqTChckTS" 3 "LockorUnlock" 2 "ChngPwdThsSttRprsntsARqTCmpnntT" 1 "DeletePwd" 0 "AddPwdThsSttRprsntsARqTCmpnntTA" ;
VAL_ 3221225472 AntitheftDesiredExitModeStates 3 "NotAvailable" 2 "NotDefined" 1 "LockWhenKeyOff" 0 "LckUpnOprtrRqThsSttIsUsdTIndctT" ;
VAL_ 3221225472 AntthftEncryptonIndicatorStates 3 "NotAvailable" 2 "NotDefined" 1 "EncryptedCodePresent" 0 "EncryptnSdRqThsSttRprsntsARqstT" ;
VAL_ 3221225472 ElctrncShckAbsrbrCtrlMdLft_TgAxl 3 "NotAvailable" 2 "Error" 1 "NormalOperationDampersActive" 0 "NormalOperationDampersPassive" ;
VAL_ 3221225472 ElctrncShckAbsrbrCtrlMdRearAxle 3 "NotAvailable" 2 "Error" 1 "NormalOperationDampersActive" 0 "NormalOperationDampersPassive" ;
VAL_ 3221225472 ElctrncShckAbsrbrCtrlMdFrntAxle 3 "NotAvailable" 2 "Error" 1 "NormalOperationDampersActive" 0 "NormalOperationDampersPassive" ;
VAL_ 3221225472 Aftrtrtmnt1OtltGsSnsrHeaterCtrl 3 "HeaterOff" 2 "Preheat1" 1 "Preheat2" 0 "Automatic" ;
VAL_ 3221225472 Aftrtrtmnt1OtltWdRngO2RdngStble 3 "NotAvailable" 2 "Error" 1 "Stable" 0 "NotStable" ;
VAL_ 3221225472 Aftrtrtmnt1OtltNOxReadingStable 3 "NotAvailable" 2 "Error" 1 "Stable" 0 "NotStable" ;
VAL_ 3221225472 Aftrtrtmnt1OtletGasSensorAtTemp 3 "NotAvailable" 2 "Error" 1 "InRange" 0 "NotInRange" ;
VAL_ 3221225472 Aftrtrtmnt1OtltGsSnsrPwrInRange 3 "NotAvailable" 2 "Error" 1 "InRange" 0 "NotInRange" ;
VAL_ 3221225472 ParticulateTrap1AshLoadPercent 4 "LevelIsTargetAshServiceInterval" ;
VAL_ 3221225472 ParticulateTrap1SootLoadPercent 4 "LvlIsActvRgnerationTriggerLevel" ;
VAL_ 3221225472 Aftrtreatment2AirEnableActuator 3 "notAvailable" 2 "reservedForSAEAssignment" 1 "active" 0 "notActive" ;
VAL_ 3221225472 Aftertreatment2PurgeAirActuator 3 "notAvailable" 2 "reservedForSAEAssignment" 1 "active" 0 "notActive" ;
VAL_ 3221225472 Aftrtrtmnt2AtmzationAirActuator 3 "notAvailable" 2 "reservedForSAEAssignment" 1 "active" 0 "notActive" ;
VAL_ 3221225472 Aftertreatment2AirSystemRelay 3 "notAvailable" 2 "reservedForSAEAssignment" 1 "active" 0 "notActive" ;
VAL_ 3221225472 Aftrtratment2FuelEnableActuator 3 "notAvailable" 2 "reservedForSAEAssignment" 1 "active" 0 "notActive" ;
VAL_ 3221225472 Aftrtratment2RegenerationStatus 3 "notAvailable" 2 "reservedForSAEAssignment" 1 "active" 0 "notActive" ;
VAL_ 3221225472 Aftertreatment2Ignt 3 "notAvailable" 2 "reservedForSAEAssignment" 1 "active" 0 "notActive" ;
VAL_ 3221225472 Aftrtreatment2FuelDrainActuator 3 "notAvailable" 2 "reservedForSAEAssignment" 1 "active" 0 "notActive" ;
VAL_ 3221225472 Aftrtrtmnt2IntkGsSnsrHeaterCtrl 3 "HeaterOff" 2 "Preheat1" 1 "Preheat2" 0 "Automatic" ;
VAL_ 3221225472 Aftrtrtmnt2IntkWdRngO2RdngStble 3 "NotAvailable" 2 "Error" 1 "Stable" 0 "NotStable" ;
VAL_ 3221225472 Aftrtrtmnt2IntkNOxReadingStable 3 "NotAvailable" 2 "Error" 1 "Stable" 0 "NotStable" ;
VAL_ 3221225472 Aftrtrtmnt2IntkeGasSensorAtTemp 3 "NotAvailable" 2 "Error" 1 "InRange" 0 "NotInRange" ;
VAL_ 3221225472 Aftrtrtmnt2IntkGsSnsrPwrInRange 3 "NotAvailable" 2 "Error" 1 "InRange" 0 "NotInRange" ;
VAL_ 3221225472 Aftrtrtmnt2OtltGsSnsrHeaterCtrl 3 "HeaterOff" 2 "Preheat1" 1 "Preheat2" 0 "Automatic" ;
VAL_ 3221225472 Aftrtrtmnt2OtltWdRngO2RdngStble 3 "NotAvailable" 2 "Error" 1 "Stable" 0 "NotStable" ;
VAL_ 3221225472 Aftrtrtmnt2OtltNOxReadingStable 3 "NotAvailable" 2 "Error" 1 "Stable" 0 "NotStable" ;
VAL_ 3221225472 Aftrtrtmnt2OtletGasSensorAtTemp 3 "NotAvailable" 2 "Error" 1 "InRange" 0 "NotInRange" ;
VAL_ 3221225472 Aftrtrtmnt2OtltGsSnsrPwrInRange 3 "NotAvailable" 2 "Error" 1 "InRange" 0 "NotInRange" ;
VAL_ 3221225472 ParticulateTrap2AshLoadPercent 4 "LevelIsTargetAshServiceInterval" ;
VAL_ 3221225472 ParticulateTrap2SootLoadPercent 4 "LvlIsActvRgnerationTriggerLevel" ;
VAL_ 3221225472 EngEmergencyShutdownIndication 3 "DontCare_TakeNoAction" 2 "Reserved" 1 "On" 0 "Off" ;
VAL_ 3221225472 EngCtrlledShutdownRq 3 "DontCare_TakeNoAction" 2 "Reserved" 1 "On" 0 "Off" ;
VAL_ 3221225472 EngCoolantCirculatingPumpCtrl 3 "DontCare_TakeNoAction" 2 "Reserved" 1 "On" 0 "Off" ;
VAL_ 3221225472 EngBlock_CoolantPreheaterCtrl 3 "Unavailable" 2 "Reserved" 1 "On" 0 "Off" ;
VAL_ 3221225472 EngElctrclSystmPwrCnsrvtionCtrl 3 "Unavailable" 2 "Reserved" 1 "On" 0 "Off" ;
VAL_ 3221225472 EngOilPreheaterCtrl 3 "DontCare_TakeNoAction" 2 "Reserved" 1 "On" 0 "Off" ;
VAL_ 3221225472 EngOilPrimingPumpCtrl 3 "Unavailable" 2 "Reserved" 1 "On" 0 "Off" ;
VAL_ 3221225472 EngFuelShutoffValveLeakTestCtrl 3 "DontCare_TakeNoAction" 2 "Reserved" 1 "On" 0 "Off" ;
VAL_ 3221225472 EngFuelShutoff2Ctrl 3 "DontCare_TakeNoAction" 2 "Reserved" 1 "Closed" 0 "Open" ;
VAL_ 3221225472 EngFuelShutoff1Ctrl 3 "DontCare_TakeNoAction" 2 "Reserved" 1 "Closed" 0 "Open" ;
VAL_ 3221225472 EngFuelShutoffVentCtrl 3 "DontCare_TakeNoAction" 2 "Reserved" 1 "Open" 0 "Closed" ;
VAL_ 3221225472 FuelPumpPrimerCtrl 3 "Unavailable" 2 "Reserved" 1 "Activate" 0 "Deactivate" ;
VAL_ 3221225472 ProhibitAirSuspensionCtrl 3 "NotAvailable" 2 "ErrorIndicator" 1 "RqProhibitAirSuspensionCtrl" 0 "NoRq" ;
VAL_ 3221225472 KneelingCmdRearAxle 3 "DontCare_TakeNoAction" 2 "Reserved" 1 "ActivateKneeling" 0 "DeactivateKneeling" ;
VAL_ 3221225472 KneelingCmdFrontAxle 3 "DontCare_TakeNoAction" 2 "Reserved" 1 "ActivateKneeling" 0 "DeactivateKneeling" ;
VAL_ 3221225472 LevelCtrlModeRq 15 "DontCare_TakeNoAction" 14 "Reserved" 9 "1101NotDefined" 8 "ExhaustBellows" 7 "TractionHelpLoadReduce" 6 "OptmmTrctn2IPrssAtThDrvnAxlIsCt" 5 "OptmmTrctn1IPrssAtThDrvnAxlIsCt" 4 "PrssRt2IRtBtwnThPrssrsAtThDrvnA" 3 "PrssRt1IRtBtwnThPrssrsAtThDrvnA" 2 "LdFxngIDrvnAxlnIsLddTAVlDfndByT" 1 "TrctnHlpIDrvnAxlIsLddTAMxVlGvnB" 0 "NrmlOprtnISystmPrfrmsAPrCtrlOfT" ;
VAL_ 3221225472 NominalLevelRqRearAxle 15 "DontCare_TakeNoAction" 14 "Reserved" 9 "1101NotDefined" 8 "StopLevelChange" 7 "LowerLevel" 6 "UpperLevel" 5 "CustomerLevel" 4 "PresetLevel" 3 "NormalLevel3" 2 "NormalLevel2" 1 "NormalLevel1" 0 "NoLevelRq" ;
VAL_ 3221225472 NominalLevelRqFrontAxle 15 "DontCare_TakeNoAction" 14 "Reserved" 9 "1101NotDefined" 8 "StopLevelChange" 7 "LowerLevel" 6 "UpperLevel" 5 "CustomerLevel" 4 "PresetLevel" 3 "NormalLevel3" 2 "NormalLevel2" 1 "NormalLevel1" 0 "NoLevelRq" ;
VAL_ 3221225472 KneelingCtrlModeRq 3 "DontCare_TakeNoAction" 2 "Reserved" 1 "ManuallyActuated" 0 "AutomaticallyActuated" ;
VAL_ 3221225472 KneelingRqRightSide 3 "DontCare_TakeNoAction" 2 "Reserved" 1 "KneelingRq" 0 "NoKneelingRq" ;
VAL_ 3221225472 KneelingRqLeftSide 3 "DontCare_TakeNoAction" 2 "Reserved" 1 "KneelingRq" 0 "NoKneelingRq" ;
VAL_ 3221225472 AutomaticTractionHelp 3 "DontCare" 2 "Reserved" 1 "EnableAutomaticTractionHelp" 0 "DisableAutomaticTractionHelp" ;
VAL_ 3221225472 LiftAxle2PosCmd 3 "DontCare_TakeNoAction" 2 "Reserved" 1 "LiftAxlePosUp_TagAxleUnladen" 0 "LiftAxlePosDown_TagAxleLaden" ;
VAL_ 3221225472 LiftAxle1PosCmd 3 "DontCare_TakeNoAction" 2 "Reserved" 1 "LiftAxlePosUp_TagAxleUnladen" 0 "LiftAxlePosDown_TagAxleLaden" ;
VAL_ 3221225472 SspensionCtrlRefusalInformation 7 "1101NotDefined" 15 "NotAvailable" 14 "Error" 6 "GnrlRjctINSpcifiedReasonApplies" 5 "BelowSpeedLimit" 4 "AboveSpeedLimit" 3 "BogieDiffNotLocked" 2 "WouldExceedAxleLoadLimit" 1 "AxleLoadLimitReached" 0 "ActualRqNotRefused" ;
VAL_ 3221225472 SuspensionRemoteCtrl2 3 "NotAvailable" 2 "Error" 1 "Active" 0 "NotActive" ;
VAL_ 3221225472 SuspensionRemoteCtrl1 3 "NotAvailable" 2 "Error" 1 "Active" 0 "NotActive" ;
VAL_ 3221225472 RearAxleInBumperRange 3 "NotAvailable" 2 "Error" 1 "ActualLevelWithinBumperRange" 0 "ActualLevelOutOfBumperRange" ;
VAL_ 3221225472 FrontAxleInBumperRange 3 "NotAvailable" 2 "Error" 1 "ActualLevelWithinBumperRange" 0 "ActualLevelOutOfBumperRange" ;
VAL_ 3221225472 DoorRelease 3 "NotAvailable" 2 "Error" 1 "DoorsMayBeOpened" 0 "DoorsMayNotBeOpened" ;
VAL_ 3221225472 VehicleMotionInhibit 3 "NotAvailable" 2 "Error" 1 "VehicleMotionIsInhibited" 0 "VehicleMayBeMoved" ;
VAL_ 3221225472 SecurityDevice 3 "NotAvailable" 2 "Error" 1 "Active" 0 "NotActive" ;
VAL_ 3221225472 LevelCtrlMode 10 "1101NotDefined" 15 "NotAvailable" 14 "Error" 9 "AirSuspensionCtrlProhibited" 8 "ExhstngBllwFnctnIBllwsArExhstdT" 7 "TractionHelpLoadReduce" 6 "OptmmTrctn2IPrssAtThDrvnAxlIsCt" 5 "OptmmTrctn1IPrssAtThDrvnAxlIsCt" 4 "PrssRt2IRtBtwnThPrssrsAtThDrvnA" 3 "PrssRt1IRtBtwnThPrssrsAtThDrvnA" 2 "LdFxngIDrvnAxlnIsLddTAVlDfndByT" 1 "TrctnHlpIDrvnAxlIsLddTAMxVlGvnB" 0 "NrmlOprtnISystmPrfrmsAPrCtrlOfT" ;
VAL_ 3221225472 KneelingInformation 15 "NotAvailable" 14 "Error" 5 "1101NotDefined" 4 "KneelingAborted" 3 "LiftingActive" 2 "KneelingLevelReached" 0 "NotActive" ;
VAL_ 3221225472 LiftingCtrlModeRearAxle 3 "NotAvailable" 2 "Error" 1 "LiftingActive" 0 "LiftingNotActive" ;
VAL_ 3221225472 LiftingCtrlModeFrontAxle 3 "NotAvailable" 2 "Error" 1 "LiftingActive" 0 "LiftingNotActive" ;
VAL_ 3221225472 LoweringCtrlModeRearAxle 3 "NotAvailable" 2 "Error" 1 "LoweringActive" 0 "LoweringNotActive" ;
VAL_ 3221225472 LoweringCtrlModeFrontAxle 3 "NotAvailable" 2 "Error" 1 "LoweringActive" 0 "LoweringNotActive" ;
VAL_ 3221225472 AboveNominalLevelRearAxle 3 "NotAvailable" 2 "Error" 1 "Above" 0 "NotAbove" ;
VAL_ 3221225472 AboveNominalLevelFrontAxle 3 "NotAvailable" 2 "Error" 1 "Above" 0 "NotAbove" ;
VAL_ 3221225472 BelowNominalLevelRearAxle 3 "NotAvailable" 2 "Error" 1 "Below" 0 "NotBelow" ;
VAL_ 3221225472 BelowNominalLevelFrontAxle 3 "NotAvailable" 2 "Error" 1 "Below" 0 "NotBelow" ;
VAL_ 3221225472 NominalLevelRearAxle 15 "NotAvailable" 14 "Error" 8 "1101NotDefined" 7 "LowerLevel" 6 "UpperLevel" 5 "CustomerLevel" 4 "PresetLevel" 3 "NormalLevel3" 2 "NormalLevel2" 1 "NormalLevel1" 0 "LevelNotSpecified" ;
VAL_ 3221225472 NominalLevelFrontAxle 15 "NotAvailable" 14 "Error" 8 "1101NotDefined" 7 "LowerLevel" 6 "UpperLevel" 5 "CustomerLevel" 4 "PresetLevel" 3 "NormalLevel3" 2 "NormalLevel2" 1 "NormalLevel1" 0 "LevelNotSpecified" ;
VAL_ 3221225472 Alt4Status 3 "notAvailable" 2 "error" 1 "Alt4Charging" 0 "Alt4NotCharging" ;
VAL_ 3221225472 Alt3Status 3 "notAvailable" 2 "error" 1 "Alt3Charging" 0 "Alt3NotCharging" ;
VAL_ 3221225472 Alt2Status 3 "notAvailable" 2 "error" 1 "Alt2Charging" 0 "Alt2NotCharging" ;
VAL_ 3221225472 Alt1Status 3 "notAvailable" 2 "error" 1 "Alt1Charging" 0 "Alt1NotCharging" ;
VAL_ 3221225472 FlashRedStopLamp 3 "Unavailable / Do Not Flash" 2 "Reserved" 1 "Fast Flash" 0 "Slow Flash" ;
VAL_ 3221225472 FlashProtectLamp 3 "Unavailable / Do Not Flash" 2 "Reserved" 1 "Fast Flash" 0 "Slow Flash" ;
VAL_ 3221225472 FlashMalfuncIndicatorLamp 3 "Unavailable / Do Not Flash" 2 "Reserved" 1 "Fast Flash" 0 "Slow Flash" ;
VAL_ 3221225472 FlashAmberWarningLamp 3 "Unavailable / Do Not Flash" 2 "Reserved" 1 "Fast Flash" 0 "Slow Flash" ;
VAL_ 3221225472 MalfunctionIndicatorLampStatus 3 "Not available" 2 "Reserved" 1 "Lamp on" 0 "Lamp off" ;
VAL_ 3221225472 RedStopLampState 3 "Not available" 2 "Reserved" 1 "Lamp on" 0 "Lamp off" ;
VAL_ 3221225472 AmberWarningLampStatus 3 "Not available" 2 "Reserved" 1 "Lamp on" 0 "Lamp off" ;
VAL_ 3221225472 ProtectLampStatus 3 "Not available" 2 "Reserved" 1 "Lamp on" 0 "Lamp off" ;
