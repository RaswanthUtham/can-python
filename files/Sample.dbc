VERSION ""

NS_ :

BS_:

BU_: EBS EMS

BO_ 3221225472 VECTOR__INDEPENDENT_SIG_MSG: 0 Vector__XXX
 SG_ TrailerWeight : 0|16@1+ (2,0) [0|128510] "kg" Vector__XXX
 SG_ AxleWeight : 0|16@1+ (0.5,0) [0|32127.5] "kg" Vector__XXX
 SG_ AxleLocation : 0|8@1+ (1,0) [0|255] "" Vector__XXX
 SG_ NetBatteryCurrentHiRes : 0|16@1+ (0.05,-1600) [-1600|1676.75] "A" Vector__XXX
 SG_ AltCurrentHiRes : 0|16@1+ (0.05,-1600) [-1600|1676.75] "A" Vector__XXX
 SG_ Battery2Potential : 0|16@1+ (0.05,0) [0|3212.75] "V" Vector__XXX
 SG_ ECUPowerOutputSupplyVoltage3 : 0|16@1+ (0.05,0) [0|3212.75] "V" Vector__XXX
 SG_ ECUPowerOutputSupplyVoltage2 : 0|16@1+ (0.05,0) [0|3212.75] "V" Vector__XXX
 SG_ ECUPowerOutputSupplyVoltage1 : 0|16@1+ (0.05,0) [0|3212.75] "V" Vector__XXX
 SG_ BatteryPotential_PowerInput2 : 0|16@1+ (0.05,0) [0|3212.75] "V" Vector__XXX
 SG_ Longitude : 0|32@1+ (1E-007,-210) [-210|211.1008122] "deg" Vector__XXX
 SG_ Latitude : 0|32@1+ (1E-007,-210) [-210|211.1008122] "deg" Vector__XXX
 SG_ TotalPowerTakeoffHours : 0|32@1+ (0.05,0) [0|210554060.75] "hr" Vector__XXX
 SG_ TotalVehicleHours : 0|32@1+ (0.05,0) [0|210554060.75] "hr" Vector__XXX
 SG_ WinchOilPressSwitch : 0|2@1+ (1,0) [0|3] "" Vector__XXX
 SG_ HydOilLevel : 0|8@1+ (0.4,0) [0|100] "%" Vector__XXX
 SG_ HydOilFilterRestrictionSwitch : 0|2@1+ (1,0) [0|3] "" Vector__XXX
 SG_ HydTemp : 0|8@1+ (1,-40) [-40|210] "°C" Vector__XXX
 SG_ Altitude : 0|16@1+ (0.125,-2500) [-2500|5531.875] "m" Vector__XXX
 SG_ Pitch : 0|16@1+ (0.0078125,-200) [-200|301.99] "deg" Vector__XXX
 SG_ NavigationBasedVehicleSpeed : 0|16@1+ (0.00390625,0) [0|250.996] "km/h" Vector__XXX
 SG_ CompassBearing : 0|16@1+ (0.0078125,0) [0|501.99] "deg" Vector__XXX
 SG_ TripCruiseDistance : 0|32@1+ (0.125,0) [0|526385151.9] "km" Vector__XXX
 SG_ TripMaxVehicleSpeed : 0|16@1+ (0.00390625,0) [0|250.996] "km/h" Vector__XXX
 SG_ TripAirCompressorOnTime : 0|32@1+ (0.05,0) [0|210554060.75] "hr" Vector__XXX
 SG_ TripIdleTime : 0|32@1+ (0.05,0) [0|210554060.75] "hr" Vector__XXX
 SG_ TripEngRunningTime : 0|32@1+ (0.05,0) [0|210554060.75] "hr" Vector__XXX
 SG_ TripPTOTime : 0|32@1+ (0.05,0) [0|210554060.75] "hr" Vector__XXX
 SG_ TripCruiseTime : 0|32@1+ (0.05,0) [0|210554060.75] "hr" Vector__XXX
 SG_ TripTimeInDerateByEng : 0|32@1+ (0.05,0) [0|210554060.75] "hr" Vector__XXX
 SG_ TripTimeInGearDown : 0|32@1+ (0.05,0) [0|210554060.75] "hr" Vector__XXX
 SG_ TripTimeInTopGear : 0|32@1+ (0.05,0) [0|210554060.75] "hr" Vector__XXX
 SG_ TripTimeInVSL : 0|32@1+ (0.05,0) [0|210554060.75] "hr" Vector__XXX
 SG_ TripSuddenDecelerations : 0|16@1+ (1,0) [0|64255] "counts" Vector__XXX
 SG_ TrpNmberOfIdleShutdownOverrides : 0|16@1+ (1,0) [0|64255] "counts" Vector__XXX
 SG_ TripNumberOfIdleShutdowns : 0|16@1+ (1,0) [0|64255] "counts" Vector__XXX
 SG_ TripNumberOfHotShutdowns : 0|16@1+ (1,0) [0|64255] "counts" Vector__XXX
 SG_ TransitRunStatus : 0|2@1+ (1,0) [0|3] "" Vector__XXX
 SG_ VehicleUseStatus : 0|2@1+ (1,0) [0|3] "" Vector__XXX
 SG_ SilentAlarmStatus : 0|2@1+ (1,0) [0|3] "" Vector__XXX
 SG_ PatronCount : 0|8@1+ (1,0) [0|250] "" Vector__XXX
 SG_ TypeOfPassengerCount : 0|8@1+ (1,0) [0|255] "" Vector__XXX
 SG_ FareboxAlarmIdentifier : 0|7@1+ (1,0) [0|127] "" Vector__XXX
 SG_ FareboxEmergencyStatus : 0|2@1+ (1,0) [0|3] "" Vector__XXX
 SG_ TransferSold : 0|8@1+ (1,0) [0|255] "" Vector__XXX
 SG_ RouteNumber : 0|12@1+ (1,0) [0|4095] "" Vector__XXX
 SG_ TransferType : 0|5@1+ (1,0) [0|31] "" Vector__XXX
 SG_ TypeOfService : 0|3@1+ (1,0) [0|7] "" Vector__XXX
 SG_ InitialFareAgency : 0|5@1+ (1,0) [0|31] "" Vector__XXX
 SG_ PassCategory : 0|4@1+ (1,0) [0|15] "" Vector__XXX
 SG_ FareValidity : 0|4@1+ (1,0) [0|15] "" Vector__XXX
 SG_ PaymentDetails : 0|4@1+ (1,0) [0|15] "" Vector__XXX
 SG_ TypeOfFare : 0|4@1+ (1,0) [0|15] "" Vector__XXX
 SG_ PassengerType : 0|4@1+ (1,0) [0|15] "" Vector__XXX
 SG_ TransactionType : 0|4@1+ (1,0) [0|15] "" Vector__XXX
 SG_ DriversFareboxSecurityCode : 0|16@1+ (1,0) [0|65535] "counts" Vector__XXX
 SG_ AssignedBlock : 0|16@1+ (1,0) [0|65535] "counts" Vector__XXX
 SG_ AssignedRun : 0|16@1+ (1,0) [0|65535] "counts" Vector__XXX
 SG_ AssignedRoute : 0|16@1+ (1,0) [0|65535] "counts" Vector__XXX
 SG_ PatternNumber : 0|16@1+ (1,0) [0|65535] "counts" Vector__XXX
 SG_ TripNumber : 0|16@1+ (1,0) [0|65535] "counts" Vector__XXX
 SG_ FarePresets : 0|8@1+ (1,0) [0|255] "" Vector__XXX
 SG_ TripDirection : 0|4@1+ (1,0) [0|15] "" Vector__XXX
 SG_ TripStatus : 0|3@1+ (1,0) [0|7] "" Vector__XXX
 SG_ FareboxServiceStatus : 0|2@1+ (1,0) [0|3] "" Vector__XXX
 SG_ VehicleID : 0|16@1+ (1,0) [0|65535] "counts" Vector__XXX
 SG_ StrobeActivationCtrlStatus : 0|2@1+ (1,0) [0|3] "" Vector__XXX
 SG_ TransitDoorEnable : 0|2@1+ (1,0) [0|3] "" Vector__XXX
 SG_ PriorityOfRespSentByEmitter : 0|4@1+ (1,0) [0|15] "" Vector__XXX
 SG_ IntersectionPreemptionRq_Resp : 0|2@1+ (1,0) [0|3] "" Vector__XXX
 SG_ TransitRouteIDUsage : 0|2@1+ (1,0) [0|3] "" Vector__XXX
 SG_ RangeCodeEnable : 0|2@1+ (1,0) [0|3] "" Vector__XXX
 SG_ NmbrOfBytsInMlpstIdentification : 0|8@1+ (1,0) [0|250] "" Vector__XXX
 SG_ Agency : 0|8@1+ (1,0) [0|255] "" Vector__XXX
 SG_ NmbrOfBytsInTrnstAssgndBlckIdntt : 0|8@1+ (1,0) [0|250] "" Vector__XXX
 SG_ NmbrOfBytsInTrnstAssgndRnIdntty : 0|8@1+ (1,0) [0|250] "" Vector__XXX
 SG_ NmbrOfBytsInTrnstAssgndRtIdntty : 0|8@1+ (1,0) [0|250] "" Vector__XXX
 SG_ ReferenceTirePressSetting : 0|8@1+ (8,0) [0|2000] "kPa" Vector__XXX
 SG_ TireLocation : 0|8@1+ (1,0) [0|255] "" Vector__XXX
 SG_ ReferenceTirePress : 0|8@1+ (8,0) [0|2000] "kPa" Vector__XXX
 SG_ TireLocation : 0|8@1+ (1,0) [0|255] "" Vector__XXX
 SG_ SteerChannelTirePress : 0|16@1+ (0.5,0) [0|32127.5] "kPa" Vector__XXX
 SG_ DriveChannelTirePress : 0|16@1+ (0.5,0) [0|32127.5] "kPa" Vector__XXX
 SG_ TrailerTagPushChannelTirePress : 0|16@1+ (0.5,0) [0|32127.5] "kPa" Vector__XXX
 SG_ SteerChannelTirePressTarget : 0|16@1+ (0.5,0) [0|32127.5] "kPa" Vector__XXX
 SG_ DriveChannelTirePressTarget : 0|16@1+ (0.5,0) [0|32127.5] "kPa" Vector__XXX
 SG_ TrlrTgPshChannelTirePressTarget : 0|16@1+ (0.5,0) [0|32127.5] "kPa" Vector__XXX
 SG_ PCUSupplySolenoidStatus : 0|2@1+ (1,0) [0|3] "" Vector__XXX
 SG_ PCUCtrlSolenoidStatus : 0|2@1+ (1,0) [0|3] "" Vector__XXX
 SG_ PCUDeflateSolenoidStatus : 0|2@1+ (1,0) [0|3] "" Vector__XXX
 SG_ TirePressSupplySwitchStatus : 0|2@1+ (1,0) [0|3] "" Vector__XXX
 SG_ PCUSteerSolenoidStatus : 0|2@1+ (1,0) [0|3] "" Vector__XXX
 SG_ PCUDriveSolenoidStatus : 0|2@1+ (1,0) [0|3] "" Vector__XXX
 SG_ DriveChannelMode : 0|4@1+ (1,0) [0|15] "" Vector__XXX
 SG_ Trailer_TagChannelMode : 0|4@1+ (1,0) [0|15] "" Vector__XXX
 SG_ SteerChannelMode : 0|4@1+ (1,0) [0|15] "" Vector__XXX
 SG_ TirePressCheckInterval : 0|8@1+ (1,0) [0|250] "mins" Vector__XXX
 SG_ PCUTrailerTagPushSolenoidStatus : 0|2@1+ (1,0) [0|3] "" Vector__XXX
 SG_ TirePressThresholdDetection : 0|3@1+ (1,0) [0|7] "" Vector__XXX
 SG_ TireAirLeakageRate : 0|16@1+ (0.1,0) [0|6425.5] "Pa/s" Vector__XXX
 SG_ CTIWheelEndElectricalFault : 0|2@1+ (1,0) [0|3] "" Vector__XXX
 SG_ CTITireStatus : 0|2@1+ (1,0) [0|3] "" Vector__XXX
 SG_ CTIWheelSensorStatus : 0|2@1+ (1,0) [0|3] "" Vector__XXX
 SG_ TireTemp : 0|16@1+ (0.03125,-273) [-273|1735] "°C" Vector__XXX
 SG_ TirePress : 0|8@1+ (4,0) [0|1000] "kPa" Vector__XXX
 SG_ TireLocation : 0|8@1+ (1,0) [0|255] "" Vector__XXX
 SG_ CatalystTankTemp : 0|8@1+ (1,-40) [-40|210] "°C" Vector__XXX
 SG_ CatalystTankLevel : 0|8@1+ (0.4,0) [0|100] "%" Vector__XXX
 SG_ CatalystTankLevelPreliminaryFMI : 0|5@1+ (1,0) [0|31] "" Vector__XXX
 SG_ CatalystTankLevel2 : 0|16@1+ (0.1,0) [0|6425.5] "mm" Vector__XXX
 SG_ TripFanOnTimeDueToAManualSwitch : 0|32@1+ (0.05,0) [0|210554060.75] "hr" Vector__XXX
 SG_ TripFanOnTime : 0|32@1+ (0.05,0) [0|210554060.75] "hr" Vector__XXX
 SG_ TripFanOnTimeDueToA_CSystem : 0|32@1+ (0.05,0) [0|210554060.75] "hr" Vector__XXX
 SG_ TripFanOnTimeDueToEngSystem : 0|32@1+ (0.05,0) [0|210554060.75] "hr" Vector__XXX
 SG_ TripDistanceInTopGear : 0|32@1+ (0.125,0) [0|526385151.9] "km" Vector__XXX
 SG_ TripGearDownDistance : 0|32@1+ (0.125,0) [0|526385151.9] "km" Vector__XXX
 SG_ TripDistanceOnVSL : 0|32@1+ (0.125,0) [0|526385151.9] "km" Vector__XXX
 SG_ AdjustLocalHourOffset : 0|8@1+ (1,-125) [-125|125] "hr" Vector__XXX
 SG_ AdjustLocalMinuteOffset : 0|8@1+ (1,-125) [-125|125] "mins" Vector__XXX
 SG_ AdjustYear : 0|8@1+ (1,1985) [1985|2235] "years" Vector__XXX
 SG_ AdjustDay : 0|8@1+ (0.25,0) [0|62.5] "days" Vector__XXX
 SG_ AdjustMonth : 0|8@1+ (1,0) [0|250] "months" Vector__XXX
 SG_ AdjustHours : 0|8@1+ (1,0) [0|250] "hr" Vector__XXX
 SG_ AdjustMinutes : 0|8@1+ (1,0) [0|250] "mins" Vector__XXX
 SG_ AdjustSeconds : 0|8@1+ (0.25,0) [0|62.5] "sec" Vector__XXX
 SG_ LocalHourOffset : 0|8@1+ (1,-125) [-125|125] "hr" Vector__XXX
 SG_ LocalMinuteOffset : 0|8@1+ (1,-125) [-125|125] "mins" Vector__XXX
 SG_ Year : 0|8@1+ (1,1985) [1985|2235] "years" Vector__XXX
 SG_ Day : 0|8@1+ (0.25,0) [0|62.5] "days" Vector__XXX
 SG_ Month : 0|8@1+ (1,0) [0|250] "months" Vector__XXX
 SG_ Hours : 0|8@1+ (1,0) [0|250] "hr" Vector__XXX
 SG_ Minutes : 0|8@1+ (1,0) [0|250] "mins" Vector__XXX
 SG_ Seconds : 0|8@1+ (0.25,0) [0|62.5] "sec" Vector__XXX
 SG_ EngTrbWstgtActuatorCtrlAirPress : 0|8@1+ (4,0) [0|1000] "kPa" Vector__XXX
 SG_ EngTurbo4WastegateDrive : 0|8@1+ (0.4,0) [0|100] "%" Vector__XXX
 SG_ EngTurbo3WastegateDrive : 0|8@1+ (0.4,0) [0|100] "%" Vector__XXX
 SG_ EngTurbo2WastegateDrive : 0|8@1+ (0.4,0) [0|100] "%" Vector__XXX
 SG_ EngTurbo1WastegateDrive : 0|8@1+ (0.4,0) [0|100] "%" Vector__XXX
 SG_ TachographVehicleSpeed : 0|16@1+ (0.00390625,0) [0|250.996] "km/h" Vector__XXX
 SG_ TachographOutputShaftSpeed : 0|16@1+ (0.125,0) [0|8031.875] "RPM" Vector__XXX
 SG_ DirectionIndicator : 0|2@1+ (1,0) [0|3] "" Vector__XXX
 SG_ TachographPerformance : 0|2@1+ (1,0) [0|3] "" Vector__XXX
 SG_ HandlingInformation : 0|2@1+ (1,0) [0|3] "" Vector__XXX
 SG_ SystemEvent : 0|2@1+ (1,0) [0|3] "" Vector__XXX
 SG_ DriverCardDriver2 : 0|2@1+ (1,0) [0|3] "" Vector__XXX
 SG_ Driver2TimeRelatedStates : 0|4@1+ (1,0) [0|15] "" Vector__XXX
 SG_ Overspeed : 0|2@1+ (1,0) [0|3] "" Vector__XXX
 SG_ DriverCardDriver1 : 0|2@1+ (1,0) [0|3] "" Vector__XXX
 SG_ Driver1TimeRelatedStates : 0|4@1+ (1,0) [0|15] "" Vector__XXX
 SG_ DriveRecognize : 0|2@1+ (1,0) [0|3] "" Vector__XXX
 SG_ Driver2WorkingState : 0|3@1+ (1,0) [0|7] "" Vector__XXX
 SG_ Driver1WorkingState : 0|3@1+ (1,0) [0|7] "" Vector__XXX
 SG_ EngTurbo4CompressorOutletTemp : 0|16@1+ (0.03125,-273) [-273|1735] "°C" Vector__XXX
 SG_ EngTurbo3CompressorOutletTemp : 0|16@1+ (0.03125,-273) [-273|1735] "°C" Vector__XXX
 SG_ EngTurbo2CompressorOutletTemp : 0|16@1+ (0.03125,-273) [-273|1735] "°C" Vector__XXX
 SG_ EngTurbo1CompressorOutletTemp : 0|16@1+ (0.03125,-273) [-273|1735] "°C" Vector__XXX
 SG_ EngTurbo4TurbineOutletTemp : 0|16@1+ (0.03125,-273) [-273|1735] "°C" Vector__XXX
 SG_ EngTurbo3TurbineOutletTemp : 0|16@1+ (0.03125,-273) [-273|1735] "°C" Vector__XXX
 SG_ EngTurbo2TurbineOutletTemp : 0|16@1+ (0.03125,-273) [-273|1735] "°C" Vector__XXX
 SG_ EngTurbo1TurbineOutletTemp : 0|16@1+ (0.03125,-273) [-273|1735] "°C" Vector__XXX
 SG_ EngTurbo4TurbineInletTemp : 0|16@1+ (0.03125,-273) [-273|1735] "°C" Vector__XXX
 SG_ EngTurbo3TurbineInletTemp : 0|16@1+ (0.03125,-273) [-273|1735] "°C" Vector__XXX
 SG_ EngTurbo2TurbineInletTemp : 0|16@1+ (0.03125,-273) [-273|1735] "°C" Vector__XXX
 SG_ EngTurbo1TurbineInletTemp : 0|16@1+ (0.03125,-273) [-273|1735] "°C" Vector__XXX
 SG_ EngTurbo4CompressorInletPress : 0|16@1+ (0.0078125,-250) [-250|251.99] "kPa" Vector__XXX
 SG_ EngTurbo3CompressorInletPress : 0|16@1+ (0.0078125,-250) [-250|251.99] "kPa" Vector__XXX
 SG_ EngTurbo2CompressorInletPress : 0|16@1+ (0.0078125,-250) [-250|251.99] "kPa" Vector__XXX
 SG_ EngTurbo1CompressorInletPress : 0|16@1+ (0.0078125,-250) [-250|251.99] "kPa" Vector__XXX
 SG_ EngTurbo4CompressorInletTemp : 0|16@1+ (0.03125,-273) [-273|1735] "°C" Vector__XXX
 SG_ EngTurbo3CompressorInletTemp : 0|16@1+ (0.03125,-273) [-273|1735] "°C" Vector__XXX
 SG_ EngTurbo2CompressorInletTemp : 0|16@1+ (0.03125,-273) [-273|1735] "°C" Vector__XXX
 SG_ EngTurbo1CompressorInletTemp : 0|16@1+ (0.03125,-273) [-273|1735] "°C" Vector__XXX
 SG_ EngTurbo4Speed : 0|16@1+ (4,0) [0|257020] "RPM" Vector__XXX
 SG_ EngTurbo3Speed : 0|16@1+ (4,0) [0|257020] "RPM" Vector__XXX
 SG_ EngTurbo2Speed : 0|16@1+ (4,0) [0|257020] "RPM" Vector__XXX
 SG_ EngTurboLubeOilPress2 : 0|8@1+ (4,0) [0|1000] "kPa" Vector__XXX
 SG_ TransTorqueLimit : 0|16@1+ (1,0) [0|64255] "Nm" Vector__XXX
 SG_ TransGearRatio : 0|16@1+ (0.001,0) [0|64.255] "" Vector__XXX
 SG_ NumberOfForwardGearRatios : 0|8@1+ (1,0) [0|250] "" Vector__XXX
 SG_ NumberOfReverseGearRatios : 0|8@1+ (1,0) [0|250] "" Vector__XXX
 SG_ TrnsShftSlctorDisplayModeSwitch : 0|2@1+ (1,0) [0|3] "" Vector__XXX
 SG_ TransMode4 : 0|2@1+ (1,0) [0|3] "" Vector__XXX
 SG_ TransMode3 : 0|2@1+ (1,0) [0|3] "" Vector__XXX
 SG_ TransMode2 : 0|2@1+ (1,0) [0|3] "" Vector__XXX
 SG_ TransMode1 : 0|2@1+ (1,0) [0|3] "" Vector__XXX
 SG_ DisengageDiffLockRqCentralRear : 0|2@1+ (1,0) [0|3] "" Vector__XXX
 SG_ DisengageDiffLockRqCentralFront : 0|2@1+ (1,0) [0|3] "" Vector__XXX
 SG_ DisengageDiffLockRqCentral : 0|2@1+ (1,0) [0|3] "" Vector__XXX
 SG_ DisengageDiffLockRqRearAxle2 : 0|2@1+ (1,0) [0|3] "" Vector__XXX
 SG_ DisengageDiffLockRqRearAxle1 : 0|2@1+ (1,0) [0|3] "" Vector__XXX
 SG_ DisengageDiffLockRqFrontAxle2 : 0|2@1+ (1,0) [0|3] "" Vector__XXX
 SG_ DisengageDiffLockRqFrontAxle1 : 0|2@1+ (1,0) [0|3] "" Vector__XXX
 SG_ TransRqedGear : 0|8@1+ (1,-125) [-125|125] "" Vector__XXX
 SG_ RqedPercentClutchSlip : 0|8@1+ (0.4,0) [0|100] "%" Vector__XXX
 SG_ DisengageDrivelineRq : 0|2@1+ (1,0) [0|3] "" Vector__XXX
 SG_ TorqueConverterLockupDisableRq : 0|2@1+ (1,0) [0|3] "" Vector__XXX
 SG_ TransGearShiftInhibitRq : 0|2@1+ (1,0) [0|3] "" Vector__XXX
 SG_ EngTotalAverageFuelEconomy : 0|16@1+ (0.00195313,0) [0|125.5] "km/L" Vector__XXX
 SG_ EngTotalAverageFuelRate : 0|16@1+ (0.05,0) [0|3212.75] "L/hr" Vector__XXX
 SG_ AirSuspensionSupplyPressRq : 0|8@1+ (8,0) [0|2000] "kPa" Vector__XXX
 SG_ AuxEquipmentSupplyPressRq : 0|8@1+ (8,0) [0|2000] "kPa" Vector__XXX
 SG_ ServiceBrakeAirPressRqCircuit2 : 0|8@1+ (8,0) [0|2000] "kPa" Vector__XXX
 SG_ ServiceBrakeAirPressRqCircuit1 : 0|8@1+ (8,0) [0|2000] "kPa" Vector__XXX
 SG_ ParkingAnd_OrTrailerAirPressRq : 0|8@1+ (8,0) [0|2000] "kPa" Vector__XXX
 SG_ PneumaticSupplyPressRq : 0|8@1+ (8,0) [0|2000] "kPa" Vector__XXX
 SG_ EngExtlShutdownAirSupplyPress : 0|16@1+ (0.5,0) [0|32127.5] "kPa" Vector__XXX
 SG_ ServiceComponentIdentificationB : 0|8@1+ (1,0) [0|250] "ID" Vector__XXX
 SG_ ServiceComponentIdentificationA : 0|8@1+ (1,0) [0|250] "ID" Vector__XXX
 SG_ SrvceDelay_OperationalTimeBased : 0|16@1+ (1,-31873) [-31873|32128] "hr" Vector__XXX
 SG_ ServiceDelay_CalendarTimeBased : 0|8@1+ (1,-125) [-125|125] "weeks" Vector__XXX
 SG_ ServiceDistance : 0|16@1+ (5,-159365) [-159365|160640] "km" Vector__XXX
 SG_ ServiceComponentIdentification : 0|8@1+ (1,0) [0|250] "ID" Vector__XXX
 SG_ TimeSinceLastService : 0|16@1+ (1,-32127) [-32127|32128] "hr" Vector__XXX
 SG_ ServiceComponentIdentification : 0|8@1+ (1,0) [0|250] "ID" Vector__XXX
 SG_ MaxContinuousRetarderTorque : 0|8@1+ (1,-125) [-125|125] "%" Vector__XXX
 SG_ MinContinuousRetarderSpeed : 0|8@1+ (32,0) [0|8000] "RPM" Vector__XXX
 SG_ MaxContinuousRetarderSpeed : 0|8@1+ (32,0) [0|8000] "RPM" Vector__XXX
 SG_ HghLmtThrshhldFrMnCntnsTrqFrmRtr : 0|8@1+ (1,-125) [-125|125] "%" Vector__XXX
 SG_ LwLmtThrshhldFrMxTrqFrmRetarder : 0|8@1+ (1,-125) [-125|125] "%" Vector__XXX
 SG_ HghLmtThrshhldFrMnCntnsRPMFrmRtr : 0|8@1+ (32,0) [0|8000] "RPM" Vector__XXX
 SG_ LwLmtThrshhldFrMxRPMFrmRetarder : 0|8@1+ (32,0) [0|8000] "RPM" Vector__XXX
 SG_ MinContinuousRetarderTorque : 0|8@1+ (1,-125) [-125|125] "%" Vector__XXX
 SG_ HydRetarderOilTemp : 0|8@1+ (1,-40) [-40|210] "°C" Vector__XXX
 SG_ HydRetarderPress : 0|8@1+ (16,0) [0|4000] "kPa" Vector__XXX
 SG_ EngBuildHoursReset : 0|2@1+ (1,0) [0|3] "" Vector__XXX
 SG_ ServiceComponentIdentification : 0|8@1+ (1,0) [0|250] "ID" Vector__XXX
 SG_ TripGroup2Proprietary : 0|2@1+ (1,0) [0|3] "" Vector__XXX
 SG_ TripGroup1 : 0|2@1+ (1,0) [0|3] "" Vector__XXX
 SG_ PercentTorqueAtPeakTorquePoint5 : 0|8@1+ (1,-125) [-125|125] "%" Vector__XXX
 SG_ RetarderSpeedAtPeakTorquePoint5 : 0|16@1+ (0.125,0) [0|8031.875] "RPM" Vector__XXX
 SG_ PercentTorqueAtPoint4 : 0|8@1+ (1,-125) [-125|125] "%" Vector__XXX
 SG_ RetarderSpeedAtPoint4 : 0|16@1+ (0.125,0) [0|8031.875] "RPM" Vector__XXX
 SG_ PercentTorqueAtPoint3 : 0|8@1+ (1,-125) [-125|125] "%" Vector__XXX
 SG_ RetarderSpeedAtPoint3 : 0|16@1+ (0.125,0) [0|8031.875] "RPM" Vector__XXX
 SG_ PercentTorqueAtMaxSpeedPoint2 : 0|8@1+ (1,-125) [-125|125] "%" Vector__XXX
 SG_ MaxRetarderSpeedPoint2 : 0|16@1+ (0.125,0) [0|8031.875] "RPM" Vector__XXX
 SG_ PercentTorqueAtIdlePoint1 : 0|8@1+ (1,-125) [-125|125] "%" Vector__XXX
 SG_ RetarderSpeedAtIdlePoint1 : 0|16@1+ (0.125,0) [0|8031.875] "RPM" Vector__XXX
 SG_ RetarderCtrlMethod : 0|8@1+ (1,0) [0|250] "steps" Vector__XXX
 SG_ RetarderLocation : 0|4@1+ (1,0) [0|15] "" Vector__XXX
 SG_ RetarderType : 0|4@1+ (1,0) [0|15] "" Vector__XXX
 SG_ EngOperationTimeSinceRebuild : 0|32@1+ (1,0) [0|4211081215] "sec" Vector__XXX
 SG_ RearWasherFunction : 0|3@1+ (1,0) [0|7] "" Vector__XXX
 SG_ FrontOperatorWasherSwitch : 0|3@1+ (1,0) [0|7] "" Vector__XXX
 SG_ FrontNonoperatorWasherSwitch : 0|3@1+ (1,0) [0|7] "" Vector__XXX
 SG_ RearWiperDelayCtrl : 0|8@1+ (0.4,0) [0|100] "%" Vector__XXX
 SG_ FrontNonoperatorWiperDelayCtrl : 0|8@1+ (0.4,0) [0|100] "%" Vector__XXX
 SG_ FrontOperatorWiperDelayCtrl : 0|8@1+ (0.4,0) [0|100] "%" Vector__XXX
 SG_ RearWiperSwitch : 0|4@1+ (1,0) [0|15] "" Vector__XXX
 SG_ FrontOperatorWiperSwitch : 0|4@1+ (1,0) [0|15] "" Vector__XXX
 SG_ FrontNonoperatorWiperSwitch : 0|4@1+ (1,0) [0|15] "" Vector__XXX
 SG_ EngAltDroopAuxInputSelect : 0|4@1+ (1,0) [0|15] "" Vector__XXX
 SG_ EngAltDroopRemoteAccelSelect : 0|4@1+ (1,0) [0|15] "" Vector__XXX
 SG_ EngAltDroopAccel2Select : 0|4@1+ (1,0) [0|15] "" Vector__XXX
 SG_ EngAltDroopAccel1Select : 0|4@1+ (1,0) [0|15] "" Vector__XXX
 SG_ EngAltRatingSelect : 0|8@1+ (1,0) [0|255] "" Vector__XXX
 SG_ EngAltLowIdleSwitch : 0|2@1+ (1,0) [0|3] "" Vector__XXX
 SG_ EngSynchronizationSwitch : 0|2@1+ (1,0) [0|3] "" Vector__XXX
 SG_ EngAuxGovernorSwitch : 0|2@1+ (1,0) [0|3] "" Vector__XXX
 SG_ EngAltDroopAuxInputSelectState : 0|4@1+ (1,0) [0|15] "" Vector__XXX
 SG_ EngAltDrpRemoteAccelSelectState : 0|4@1+ (1,0) [0|15] "" Vector__XXX
 SG_ EngAltDroopAccel2SelectState : 0|4@1+ (1,0) [0|15] "" Vector__XXX
 SG_ EngAltDroopAccel1SelectState : 0|4@1+ (1,0) [0|15] "" Vector__XXX
 SG_ EngAltRatingSelectState : 0|8@1+ (1,0) [0|255] "" Vector__XXX
 SG_ EngAltLowIdleSelectState : 0|2@1+ (1,0) [0|3] "" Vector__XXX
 SG_ EngMultiUnitSyncState : 0|2@1+ (1,0) [0|3] "" Vector__XXX
 SG_ EngAuxGovernorState : 0|2@1+ (1,0) [0|3] "" Vector__XXX
 SG_ OprtrsDesiredDelayedLampOffTime : 0|16@1+ (1,0) [0|64255] "sec" Vector__XXX
 SG_ OperatorsDesiredBacklight : 0|8@1+ (0.4,0) [0|100] "%" Vector__XXX
 SG_ HighLowBeamSwitch : 0|2@1+ (1,0) [0|3] "" Vector__XXX
 SG_ HazardLightSwitch : 0|2@1+ (1,0) [0|3] "" Vector__XXX
 SG_ TurnSignalSwitch : 0|4@1+ (1,0) [0|15] "" Vector__XXX
 SG_ MainLightSwitch : 0|4@1+ (1,0) [0|15] "" Vector__XXX
 SG_ WorkLightSwitch : 0|4@1+ (1,0) [0|15] "" Vector__XXX
 SG_ AppliedVehicleSpeedLimit : 0|8@1+ (1,0) [0|250] "km/h" Vector__XXX
 SG_ MaxVehicleSpeedLimit7 : 0|8@1+ (1,0) [0|250] "km/h" Vector__XXX
 SG_ MaxVehicleSpeedLimit6 : 0|8@1+ (1,0) [0|250] "km/h" Vector__XXX
 SG_ MaxVehicleSpeedLimit5 : 0|8@1+ (1,0) [0|250] "km/h" Vector__XXX
 SG_ MaxVehicleSpeedLimit4 : 0|8@1+ (1,0) [0|250] "km/h" Vector__XXX
 SG_ MaxVehicleSpeedLimit3 : 0|8@1+ (1,0) [0|250] "km/h" Vector__XXX
 SG_ MaxVehicleSpeedLimit2 : 0|8@1+ (1,0) [0|250] "km/h" Vector__XXX
 SG_ MaxVehicleSpeedLimit1 : 0|8@1+ (1,0) [0|250] "km/h" Vector__XXX
 SG_ OprtrsBlckOutIntensitySelection : 0|8@1+ (0.4,0) [0|100] "%" Vector__XXX
 SG_ BlackOutWorkLampSelect : 0|2@1+ (1,0) [0|3] "" Vector__XXX
 SG_ NightVisionIlluminatorSelect : 0|2@1+ (1,0) [0|3] "" Vector__XXX
 SG_ BlackOutBrake_StopLampSelect : 0|2@1+ (1,0) [0|3] "" Vector__XXX
 SG_ ConvoyDrivingLampSelect : 0|2@1+ (1,0) [0|3] "" Vector__XXX
 SG_ ConvoyLampSelect : 0|2@1+ (1,0) [0|3] "" Vector__XXX
 SG_ FrontBlackOutMarkerLampSelect : 0|2@1+ (1,0) [0|3] "" Vector__XXX
 SG_ RearBlackOutMarkerSelect : 0|2@1+ (1,0) [0|3] "" Vector__XXX
 SG_ SlowVesselModeStatus : 0|2@1+ (1,0) [0|3] "" Vector__XXX
 SG_ TrollingModeStatus : 0|2@1+ (1,0) [0|3] "" Vector__XXX
 SG_ EngThrttlSynchrnztionModeStatus : 0|4@1+ (1,0) [0|15] "" Vector__XXX
 SG_ EngMainBearing11Temp : 0|16@1+ (0.03125,-273) [-273|1735] "°C" Vector__XXX
 SG_ EngMainBearing10Temp : 0|16@1+ (0.03125,-273) [-273|1735] "°C" Vector__XXX
 SG_ EngMainBearing9Temp : 0|16@1+ (0.03125,-273) [-273|1735] "°C" Vector__XXX
 SG_ EngMainBearing8Temp : 0|16@1+ (0.03125,-273) [-273|1735] "°C" Vector__XXX
 SG_ EngMainBearing7Temp : 0|16@1+ (0.03125,-273) [-273|1735] "°C" Vector__XXX
 SG_ EngMainBearing6Temp : 0|16@1+ (0.03125,-273) [-273|1735] "°C" Vector__XXX
 SG_ EngMainBearing5Temp : 0|16@1+ (0.03125,-273) [-273|1735] "°C" Vector__XXX
 SG_ EngMainBearing4Temp : 0|16@1+ (0.03125,-273) [-273|1735] "°C" Vector__XXX
 SG_ EngMainBearing3Temp : 0|16@1+ (0.03125,-273) [-273|1735] "°C" Vector__XXX
 SG_ EngMainBearing2Temp : 0|16@1+ (0.03125,-273) [-273|1735] "°C" Vector__XXX
 SG_ EngMainBearing1Temp : 0|16@1+ (0.03125,-273) [-273|1735] "°C" Vector__XXX
 SG_ DisplayDeadbands : 0|4@1+ (1,0) [0|15] "" Vector__XXX
 SG_ LEDPatternCtrl : 0|4@1+ (1,0) [0|15] "" Vector__XXX
 SG_ LEDDisplayDeadbandCtrl : 0|4@1+ (1,0) [0|15] "" Vector__XXX
 SG_ LEDDisplayModeCtrl : 0|4@1+ (1,0) [0|15] "" Vector__XXX
 SG_ LEDDisplayData1 : 0|8@1+ (1,0) [0|255] "" Vector__XXX
 SG_ AbsLaserStrikePosition : 0|16@1+ (0.1,0) [0|6425.5] "mm" Vector__XXX
 SG_ LaserStrikeDataLatency : 0|16@1+ (51.2,0) [0|3.289856] "sec" Vector__XXX
 SG_ LaserReceiverType : 0|8@1+ (1,0) [0|250] "" Vector__XXX
 SG_ LaserStrikeVerticalDeviation : 0|16@1+ (0.1,-3200) [-3200|3225.5] "mm" Vector__XXX
 SG_ LaserTracerInformation : 0|8@1+ (1,0) [0|255] "" Vector__XXX
 SG_ LEDDisplayData2 : 0|8@1+ (1,0) [0|255] "" Vector__XXX
 SG_ LaserTracerHorizontalDeviation : 0|8@1+ (1,0) [0|250] "%" Vector__XXX
 SG_ LaserTracerVerticalDistance : 0|16@1+ (0.1,0) [0|6425.5] "mm" Vector__XXX
 SG_ LaserTracerTargetDeviation : 0|16@1+ (0.1,-3200) [-3200|3225.5] "mm" Vector__XXX
 SG_ BldHeightSetPointHighResolution : 0|32@1+ (0.1,-209.7152) [-209.7152|211.3929215] "m" Vector__XXX
 SG_ ModifySetPoint : 0|16@1+ (0.1,-2800) [-2800|3225.5] "mm" Vector__XXX
 SG_ SdshftDsrdBldOffsetOperatorCtrl : 0|4@1+ (1,0) [0|15] "" Vector__XXX
 SG_ SdshftBldCtrlMdeOperatorControl : 0|4@1+ (1,0) [0|15] "" Vector__XXX
 SG_ RghtDsrdBladeOffsetOperatorCtrl : 0|4@1+ (1,0) [0|15] "" Vector__XXX
 SG_ RghtBldeCtrlModeOperatorControl : 0|4@1+ (1,0) [0|15] "" Vector__XXX
 SG_ LftDsredBladeOffsetOperatorCtrl : 0|4@1+ (1,0) [0|15] "" Vector__XXX
 SG_ LftBladeCtrlModeOperatorControl : 0|4@1+ (1,0) [0|15] "" Vector__XXX
 SG_ BladeAutoModeCmd : 0|4@1+ (1,0) [0|15] "" Vector__XXX
 SG_ DesiredGradeOffsetSwitch : 0|4@1+ (1,0) [0|15] "" Vector__XXX
 SG_ BladeCtrlModeSwitch : 0|4@1+ (1,0) [0|15] "" Vector__XXX
 SG_ MastPos : 0|16@1+ (0.1,-3200) [-3200|3225.5] "mm" Vector__XXX
 SG_ FrontWheelDriveActuatorStatus : 0|2@1+ (1,0) [0|3] "" Vector__XXX
 SG_ FMSstandardSWversionSupported : 0|32@1+ (1,0) [0|255] "" Vector__XXX
 SG_ FMSstandardRqsSupported : 0|2@1+ (1,0) [0|3] "" Vector__XXX
 SG_ FMSstandardDiagnosticsSupported : 0|2@1+ (1,0) [0|3] "" Vector__XXX
 SG_ LnDprtureIndicationEnableStatus : 0|2@1+ (1,0) [0|3] "" Vector__XXX
 SG_ LaneTrackingStatusLeftSide : 0|2@1+ (1,0) [0|3] "" Vector__XXX
 SG_ LaneTrackingStatusRightSide : 0|2@1+ (1,0) [0|3] "" Vector__XXX
 SG_ LaneDepartureImminentLeftSide : 0|2@1+ (1,0) [0|3] "" Vector__XXX
 SG_ LaneDepartureImminentRightSide : 0|2@1+ (1,0) [0|3] "" Vector__XXX
 SG_ EngFuelLeakage2 : 0|2@1+ (1,0) [0|3] "" Vector__XXX
 SG_ EngFuelLeakage1 : 0|2@1+ (1,0) [0|3] "" Vector__XXX
 SG_ EngTorqueLimit6AxleInput : 0|16@1+ (2,0) [0|128510] "Nm" Vector__XXX
 SG_ EngTorqueLimit5Switch : 0|16@1+ (1,0) [0|64255] "Nm" Vector__XXX
 SG_ EngTorqueLimit4Trans : 0|16@1+ (1,0) [0|64255] "Nm" Vector__XXX
 SG_ EngTorqueLimit3Trans : 0|16@1+ (1,0) [0|64255] "Nm" Vector__XXX
 SG_ TransGearRatio3 : 0|16@1+ (0.01,0) [0|642.55] "" Vector__XXX
 SG_ EngTorqueLimit2Trans : 0|16@1+ (1,0) [0|64255] "Nm" Vector__XXX
 SG_ TransGearRatio2 : 0|16@1+ (0.01,0) [0|642.55] "" Vector__XXX
 SG_ EngTorqueLimit1Trans : 0|16@1+ (1,0) [0|64255] "Nm" Vector__XXX
 SG_ TransGearRatio1 : 0|16@1+ (0.01,0) [0|642.55] "" Vector__XXX
 SG_ EngTorqueLimitFeature : 0|3@1+ (1,0) [0|7] "" Vector__XXX
 SG_ TorqueLimitingFeatureStatus : 0|2@1+ (1,0) [0|3] "" Vector__XXX
 SG_ CalibRecordDurationTime : 0|32@1+ (0.05,0) [0|210554060.75] "hr" Vector__XXX
 SG_ CalibRecordStartYear : 0|8@1+ (1,1985) [1985|2235] "years" Vector__XXX
 SG_ CalibRecordStartDay : 0|8@1+ (0.25,0) [0|62.5] "days" Vector__XXX
 SG_ CalibRecordStartMonth : 0|8@1+ (1,0) [0|250] "months" Vector__XXX
 SG_ EngPeakTorque2 : 0|16@1+ (1,0) [0|64255] "Nm" Vector__XXX
 SG_ EngPeakTorque1 : 0|16@1+ (1,0) [0|64255] "Nm" Vector__XXX
 SG_ EngPower : 0|16@1+ (0.5,0) [0|32127.5] "kW" Vector__XXX
 SG_ NumberOfEngTorqueHistoryRecords : 0|8@1+ (1,0) [0|250] "records" Vector__XXX
 SG_ TransTorqueConverterRatio : 0|16@1+ (0.001,0) [0|64.255] "" Vector__XXX
 SG_ TransRqedGearFeedback : 0|8@1+ (1,-125) [-125|125] "" Vector__XXX
 SG_ TransMode1Indicator : 0|2@1+ (1,0) [0|3] "" Vector__XXX
 SG_ TransMode2Indicator : 0|2@1+ (1,0) [0|3] "" Vector__XXX
 SG_ TransMode3Indicator : 0|2@1+ (1,0) [0|3] "" Vector__XXX
 SG_ TransMode4Indicator : 0|2@1+ (1,0) [0|3] "" Vector__XXX
 SG_ TransShiftInhibitIndicator : 0|2@1+ (1,0) [0|3] "" Vector__XXX
 SG_ TransEngCrankEnable : 0|2@1+ (1,0) [0|3] "" Vector__XXX
 SG_ ActiveShiftConsoleIndicator : 0|2@1+ (1,0) [0|3] "" Vector__XXX
 SG_ TransReadyForBrakeRelease : 0|2@1+ (1,0) [0|3] "" Vector__XXX
 SG_ TransRqedRangeDisplayFlashState : 0|2@1+ (1,0) [0|3] "" Vector__XXX
 SG_ TransRqedRangeDisplayBlankState : 0|2@1+ (1,0) [0|3] "" Vector__XXX
 SG_ TransServiceIndicator : 0|2@1+ (1,0) [0|3] "" Vector__XXX
 SG_ TransCurrRangeDisplayBlankState : 0|2@1+ (1,0) [0|3] "" Vector__XXX
 SG_ ClutchLifeRemaining : 0|8@1+ (0.4,0) [0|100] "%" Vector__XXX
 SG_ LowestPossibleGear : 0|8@1+ (1,-125) [-125|125] "" Vector__XXX
 SG_ HighestPossibleGear : 0|8@1+ (1,-125) [-125|125] "" Vector__XXX
 SG_ RecommendedGear : 0|8@1+ (1,-125) [-125|125] "" Vector__XXX
 SG_ TransForwardDirectionSwitch : 0|2@1+ (1,0) [0|3] "" Vector__XXX
 SG_ TransNeutralSwitch : 0|2@1+ (1,0) [0|3] "" Vector__XXX
 SG_ TransReverseDirectionSwitch : 0|2@1+ (1,0) [0|3] "" Vector__XXX
 SG_ TransLowRangeSenseSwitch : 0|2@1+ (1,0) [0|3] "" Vector__XXX
 SG_ TransHighRangeSenseSwitch : 0|2@1+ (1,0) [0|3] "" Vector__XXX
 SG_ TransSynchronizerBrakeValue : 0|8@1+ (0.4,0) [0|100] "%" Vector__XXX
 SG_ TransSynchronizerClutchValue : 0|8@1+ (0.4,0) [0|100] "%" Vector__XXX
 SG_ TransInertiaBrakeActuator : 0|2@1+ (1,0) [0|3] "" Vector__XXX
 SG_ TransDefuelActuator : 0|2@1+ (1,0) [0|3] "" Vector__XXX
 SG_ TransLockupClutchActuator : 0|2@1+ (1,0) [0|3] "" Vector__XXX
 SG_ TransClutchActuator : 0|2@1+ (1,0) [0|3] "" Vector__XXX
 SG_ TransSplitterIndirectActuator : 0|2@1+ (1,0) [0|3] "" Vector__XXX
 SG_ TransSplitterDirectActuator : 0|2@1+ (1,0) [0|3] "" Vector__XXX
 SG_ TransRangeLowActuator : 0|2@1+ (1,0) [0|3] "" Vector__XXX
 SG_ TransRangeHighActuator : 0|2@1+ (1,0) [0|3] "" Vector__XXX
 SG_ TransShiftFingerGearActuator2 : 0|2@1+ (1,0) [0|3] "" Vector__XXX
 SG_ TransShiftFingerRailActuator2 : 0|2@1+ (1,0) [0|3] "" Vector__XXX
 SG_ TransShiftFingerGearActuator1 : 0|2@1+ (1,0) [0|3] "" Vector__XXX
 SG_ TransShiftFingerRailActuator1 : 0|2@1+ (1,0) [0|3] "" Vector__XXX
 SG_ TrnsShftFngrCenterRailIndicator : 0|2@1+ (1,0) [0|3] "" Vector__XXX
 SG_ TrnsShftFngrEngagementIndicator : 0|2@1+ (1,0) [0|3] "" Vector__XXX
 SG_ TrnsShiftFingerNeutralIndicator : 0|2@1+ (1,0) [0|3] "" Vector__XXX
 SG_ TransShiftFingerRailPos : 0|8@1+ (0.4,0) [0|100] "%" Vector__XXX
 SG_ TransShiftFingerGearPos : 0|8@1+ (0.4,0) [0|100] "%" Vector__XXX
 SG_ TransCurrentRange : 0|16@1+ (1,0) [0|255] "" Vector__XXX
 SG_ TransRqedRange : 0|16@1+ (1,0) [0|255] "" Vector__XXX
 SG_ TransCurrentGear : 0|8@1+ (1,-125) [-125|125] "" Vector__XXX
 SG_ TransActualGearRatio : 0|16@1+ (0.001,0) [0|64.255] "" Vector__XXX
 SG_ TransSelectedGear : 0|8@1+ (1,-125) [-125|125] "" Vector__XXX
 SG_ SrcAddrssOfCtrllngDvcFrTrnsCtrl : 0|8@1+ (1,0) [0|255] "" Vector__XXX
 SG_ TransInputShaftSpeed : 0|16@1+ (0.125,0) [0|8031.875] "RPM" Vector__XXX
 SG_ ProgressiveShiftDisable : 0|2@1+ (1,0) [0|3] "" Vector__XXX
 SG_ EngMomentaryOverspeedEnable : 0|2@1+ (1,0) [0|3] "" Vector__XXX
 SG_ TransOutputShaftSpeed : 0|16@1+ (0.125,0) [0|8031.875] "RPM" Vector__XXX
 SG_ TransShiftInProcess : 0|2@1+ (1,0) [0|3] "" Vector__XXX
 SG_ TorqueConverterLockupEngaged : 0|2@1+ (1,0) [0|3] "" Vector__XXX
 SG_ TransDrivelineEngaged : 0|2@1+ (1,0) [0|3] "" Vector__XXX
 SG_ EngChargeAirCoolerOutletTemp : 0|16@1+ (0.03125,-273) [-273|1735] "°C" Vector__XXX
 SG_ EngCoolantTempHiRes : 0|16@1+ (0.03125,-273) [-273|1735] "°C" Vector__XXX
 SG_ EngIntkVlvActationSystemOilTemp : 0|16@1+ (0.03125,-273) [-273|1735] "°C" Vector__XXX
 SG_ EngIntakeManifold1AirTemp : 0|16@1+ (0.03125,-273) [-273|1735] "°C" Vector__XXX
 SG_ EngExhstExhstGsTempLeftManifold : 0|16@1+ (0.03125,-273) [-273|1735] "°C" Vector__XXX
 SG_ EngExhstExhstGsTmpRightManifold : 0|16@1+ (0.03125,-273) [-273|1735] "°C" Vector__XXX
 SG_ SterableLiftAxleLoweringInhibit : 0|2@1+ (1,0) [0|3] "" Vector__XXX
 SG_ AxleLocation : 0|8@1+ (1,0) [0|255] "" Vector__XXX
 SG_ TypeOfSteerTrans : 0|4@1+ (1,0) [0|15] "" Vector__XXX
 SG_ TypeOfSteerForces : 0|4@1+ (1,0) [0|15] "" Vector__XXX
 SG_ SteerType : 0|4@1+ (1,0) [0|15] "" Vector__XXX
 SG_ StatusOfSteerAxle : 0|4@1+ (1,0) [0|15] "" Vector__XXX
 SG_ ActualInnerWheelSteerAngle : 0|16@1+ (0.00390625,-125) [-125|125] "deg" Vector__XXX
 SG_ TransOutputRetarder : 0|2@1+ (1,0) [0|3] "" Vector__XXX
 SG_ RetarderSelectionNonEng : 0|8@1+ (0.4,0) [0|100] "%" Vector__XXX
 SG_ ActlMxAvlblRtarderPercentTorque : 0|8@1+ (1,-125) [-125|125] "%" Vector__XXX
 SG_ DrvrsDmandRetarderPercentTorque : 0|8@1+ (1,-125) [-125|125] "%" Vector__XXX
 SG_ SrcAddrssOfCtrllngDvcFrRtrdrCtrl : 0|8@1+ (1,0) [0|255] "" Vector__XXX
 SG_ RetarderRqingBrakeLight : 0|2@1+ (1,0) [0|3] "" Vector__XXX
 SG_ EngCoolantLoadIncrease : 0|2@1+ (1,0) [0|3] "" Vector__XXX
 SG_ IntendedRetarderPercentTorque : 0|8@1+ (1,-125) [-125|125] "%" Vector__XXX
 SG_ ActualRetarderPercentTorque : 0|8@1+ (1,-125) [-125|125] "%" Vector__XXX
 SG_ RetarderEnableShiftAssistSwitch : 0|2@1+ (1,0) [0|3] "" Vector__XXX
 SG_ RetarderEnableBrakeAssistSwitch : 0|2@1+ (1,0) [0|3] "" Vector__XXX
 SG_ RetarderTorqueMode : 0|4@1+ (1,0) [0|15] "" Vector__XXX
 SG_ EngExhaustGasPort20Temp : 0|16@1+ (0.03125,-273) [-273|1735] "°C" Vector__XXX
 SG_ EngExhaustGasPort19Temp : 0|16@1+ (0.03125,-273) [-273|1735] "°C" Vector__XXX
 SG_ EngExhaustGasPort18Temp : 0|16@1+ (0.03125,-273) [-273|1735] "°C" Vector__XXX
 SG_ EngExhaustGasPort17Temp : 0|16@1+ (0.03125,-273) [-273|1735] "°C" Vector__XXX
 SG_ EngExhaustGasPort16Temp : 0|16@1+ (0.03125,-273) [-273|1735] "°C" Vector__XXX
 SG_ EngExhaustGasPort15Temp : 0|16@1+ (0.03125,-273) [-273|1735] "°C" Vector__XXX
 SG_ EngExhaustGasPort14Temp : 0|16@1+ (0.03125,-273) [-273|1735] "°C" Vector__XXX
 SG_ EngExhaustGasPort13Temp : 0|16@1+ (0.03125,-273) [-273|1735] "°C" Vector__XXX
 SG_ EngExhaustGasPort12Temp : 0|16@1+ (0.03125,-273) [-273|1735] "°C" Vector__XXX
 SG_ EngExhaustGasPort11Temp : 0|16@1+ (0.03125,-273) [-273|1735] "°C" Vector__XXX
 SG_ EngExhaustGasPort10Temp : 0|16@1+ (0.03125,-273) [-273|1735] "°C" Vector__XXX
 SG_ EngExhaustGasPort9Temp : 0|16@1+ (0.03125,-273) [-273|1735] "°C" Vector__XXX
 SG_ EngExhaustGasPort8Temp : 0|16@1+ (0.03125,-273) [-273|1735] "°C" Vector__XXX
 SG_ EngExhaustGasPort7Temp : 0|16@1+ (0.03125,-273) [-273|1735] "°C" Vector__XXX
 SG_ EngExhaustGasPort6Temp : 0|16@1+ (0.03125,-273) [-273|1735] "°C" Vector__XXX
 SG_ EngExhaustGasPort5Temp : 0|16@1+ (0.03125,-273) [-273|1735] "°C" Vector__XXX
 SG_ EngExhaustGasPort4Temp : 0|16@1+ (0.03125,-273) [-273|1735] "°C" Vector__XXX
 SG_ EngExhaustGasPort3Temp : 0|16@1+ (0.03125,-273) [-273|1735] "°C" Vector__XXX
 SG_ EngExhaustGasPort2Temp : 0|16@1+ (0.03125,-273) [-273|1735] "°C" Vector__XXX
 SG_ EngExhaustGasPort1Temp : 0|16@1+ (0.03125,-273) [-273|1735] "°C" Vector__XXX
 SG_ PayloadPercentage : 0|8@1+ (1,0) [0|250] "%" Vector__XXX
 SG_ DataMemoryUsage : 0|8@1+ (0.4,0) [0|100] "%" Vector__XXX
 SG_ KeepAliveBatteryConsumption : 0|16@1+ (1,0) [0|64255] "mAhr" Vector__XXX
 SG_ TravelVelocityCtrlPos : 0|8@1+ (1,-125) [-125|125] "%" Vector__XXX
 SG_ Jystck3GripXAxisDetentPosStatus : 0|2@1+ (1,0) [0|3] "" Vector__XXX
 SG_ Jystck3GripYAxisDetentPosStatus : 0|2@1+ (1,0) [0|3] "" Vector__XXX
 SG_ Jystck3ThetaAxisDetentPosStatus : 0|2@1+ (1,0) [0|3] "" Vector__XXX
 SG_ Joystick3ThetaAxisPos : 0|10@1+ (0.1,0) [0|102] "%" Vector__XXX
 SG_ Jystck3ThtAxsClckwsPstvPsStatus : 0|2@1+ (1,0) [0|3] "" Vector__XXX
 SG_ Jystck3ThtAxsCntrClckwsNgtvPsStt : 0|2@1+ (1,0) [0|3] "" Vector__XXX
 SG_ Jystck3ThtaAxisNeutralPosStatus : 0|2@1+ (1,0) [0|3] "" Vector__XXX
 SG_ Joystick3GripYAxisPos : 0|10@1+ (0.1,0) [0|102] "%" Vector__XXX
 SG_ Jystck3GrpYAxsLvrFrwrdPstvPsStts : 0|2@1+ (1,0) [0|3] "" Vector__XXX
 SG_ Jystck3GrpYAxsLvrBckNgtvPsSttus : 0|2@1+ (1,0) [0|3] "" Vector__XXX
 SG_ Jystck3GrpYAxisNeutralPosStatus : 0|2@1+ (1,0) [0|3] "" Vector__XXX
 SG_ Joystick3GripXAxisPos : 0|10@1+ (0.1,0) [0|102] "%" Vector__XXX
 SG_ Jystck3GrpXAxsLvrRghtPstvPsStts : 0|2@1+ (1,0) [0|3] "" Vector__XXX
 SG_ Jystck3GrpXAxsLvrLftNgtvPsSttus : 0|2@1+ (1,0) [0|3] "" Vector__XXX
 SG_ Jystck3GrpXAxisNeutralPosStatus : 0|2@1+ (1,0) [0|3] "" Vector__XXX
 SG_ Jystck2GripXAxisDetentPosStatus : 0|2@1+ (1,0) [0|3] "" Vector__XXX
 SG_ Jystck2GripYAxisDetentPosStatus : 0|2@1+ (1,0) [0|3] "" Vector__XXX
 SG_ Jystck2ThetaAxisDetentPosStatus : 0|2@1+ (1,0) [0|3] "" Vector__XXX
 SG_ Joystick2ThetaAxisPos : 0|10@1+ (0.1,0) [0|102] "%" Vector__XXX
 SG_ Jystck2ThtAxsClckwsPstvPsStatus : 0|2@1+ (1,0) [0|3] "" Vector__XXX
 SG_ Jystck2ThtAxsCntrClckwsNgtvPsStt : 0|2@1+ (1,0) [0|3] "" Vector__XXX
 SG_ Jystck2ThtaAxisNeutralPosStatus : 0|2@1+ (1,0) [0|3] "" Vector__XXX
 SG_ Joystick2GripYAxisPos : 0|10@1+ (0.1,0) [0|102] "%" Vector__XXX
 SG_ Jystck2GrpYAxsLvrFrwrdPstvPsStts : 0|2@1+ (1,0) [0|3] "" Vector__XXX
 SG_ Jystck2GrpYAxsLvrBckNgtvPsSttus : 0|2@1+ (1,0) [0|3] "" Vector__XXX
 SG_ Jystck2GrpYAxisNeutralPosStatus : 0|2@1+ (1,0) [0|3] "" Vector__XXX
 SG_ Joystick2GripXAxisPos : 0|10@1+ (0.1,0) [0|102] "%" Vector__XXX
 SG_ Jystck2GrpXAxsLvrRghtPstvPsStts : 0|2@1+ (1,0) [0|3] "" Vector__XXX
 SG_ Jystck2GrpXAxsLvrLftNgtvPsSttus : 0|2@1+ (1,0) [0|3] "" Vector__XXX
 SG_ Jystck2GrpXAxisNeutralPosStatus : 0|2@1+ (1,0) [0|3] "" Vector__XXX
 SG_ Jystck1GripXAxisDetentPosStatus : 0|2@1+ (1,0) [0|3] "" Vector__XXX
 SG_ Jystck1GripYAxisDetentPosStatus : 0|2@1+ (1,0) [0|3] "" Vector__XXX
 SG_ Jystck1ThetaAxisDetentPosStatus : 0|2@1+ (1,0) [0|3] "" Vector__XXX
 SG_ Joystick1ThetaAxisPos : 0|10@1+ (0.1,0) [0|102] "%" Vector__XXX
 SG_ Jystck1ThtAxsClckwsPstvPsStatus : 0|2@1+ (1,0) [0|3] "" Vector__XXX
 SG_ Jystck1ThtAxsCntrClckwsNgtvPsStt : 0|2@1+ (1,0) [0|3] "" Vector__XXX
 SG_ Jystck1ThtaAxisNeutralPosStatus : 0|2@1+ (1,0) [0|3] "" Vector__XXX
 SG_ Joystick1GripYAxisPos : 0|10@1+ (0.1,0) [0|102] "%" Vector__XXX
 SG_ Jystck1GrpYAxsLvrFrwrdPstvPsStts : 0|2@1+ (1,0) [0|3] "" Vector__XXX
 SG_ Jystck1GrpYAxsLvrBckNgtvPsSttus : 0|2@1+ (1,0) [0|3] "" Vector__XXX
 SG_ Jystck1GrpYAxisNeutralPosStatus : 0|2@1+ (1,0) [0|3] "" Vector__XXX
 SG_ Joystick1GripXAxisPos : 0|10@1+ (0.1,0) [0|102] "%" Vector__XXX
 SG_ Jystck1GrpXAxsLvrRghtPstvPsStts : 0|2@1+ (1,0) [0|3] "" Vector__XXX
 SG_ Jystck1GrpXAxsLvrLftNgtvPsSttus : 0|2@1+ (1,0) [0|3] "" Vector__XXX
 SG_ Jystck1GrpXAxisNeutralPosStatus : 0|2@1+ (1,0) [0|3] "" Vector__XXX
 SG_ EngFuelRackPos : 0|8@1+ (0.4,0) [0|100] "%" Vector__XXX
 SG_ InstantaneousEstBrakePower : 0|16@1+ (0.5,0) [0|32127.5] "kW" Vector__XXX
 SG_ EngMassFlow : 0|16@1+ (0.05,0) [0|3212.75] "kg/hr" Vector__XXX
 SG_ EngExhaustGasPress : 0|16@1+ (0.0078125,-250) [-250|251.99] "kPa" Vector__XXX
 SG_ EngPrefilterOilPress : 0|8@1+ (4,0) [0|1000] "kPa" Vector__XXX
 SG_ TotalECURunTime : 0|32@1+ (0.05,0) [0|210554060.75] "hr" Vector__XXX
 SG_ TotalECUDistance : 0|32@1+ (0.125,0) [0|526385151.9] "km" Vector__XXX
 SG_ EngInletAirMassFlowRate : 0|16@1+ (0.05,0) [0|3212.75] "kg/hr" Vector__XXX
 SG_ EngExhstGsRcrcltionMassFlowRate : 0|16@1+ (0.05,0) [0|3212.75] "kg/hr" Vector__XXX
 SG_ EngFuelFilterSucSideDiffPress : 0|8@1+ (2,0) [0|500] "kPa" Vector__XXX
 SG_ EngFuelSupplyPumpInletPress : 0|8@1+ (2,0) [0|500] "kPa" Vector__XXX
 SG_ EngOilLevelRemoteReservoir : 0|8@1+ (0.4,0) [0|100] "%" Vector__XXX
 SG_ EngWasteOilReservoirLevel : 0|8@1+ (0.4,0) [0|100] "%" Vector__XXX
 SG_ EngVentilationStatus : 0|3@1+ (1,0) [0|7] "" Vector__XXX
 SG_ EngOilPrimingState : 0|2@1+ (1,0) [0|3] "" Vector__XXX
 SG_ EngOilPrimingPumpSwitch : 0|2@1+ (1,0) [0|3] "" Vector__XXX
 SG_ EngOilPreHeatedState : 0|2@1+ (1,0) [0|3] "" Vector__XXX
 SG_ EngOilFilterOutletPress : 0|8@1+ (4,0) [0|1000] "kPa" Vector__XXX
 SG_ EngCoolantPreheatedState : 0|2@1+ (1,0) [0|3] "" Vector__XXX
 SG_ EngExhstGsRcrculationInletPress : 0|8@1+ (2,0) [0|500] "kPa" Vector__XXX
 SG_ EngIntkVlvActtionSystemOilPress : 0|16@1+ (0.00390625,0) [0|251] "Mpa" Vector__XXX
 SG_ EngInjectorMeteringRail2Press : 0|16@1+ (0.00390625,0) [0|251] "MPa" Vector__XXX
 SG_ EngInjectorTimingRail1Press : 0|16@1+ (0.00390625,0) [0|251] "Mpa" Vector__XXX
 SG_ EngInjectorMeteringRail1Press : 0|16@1+ (0.00390625,0) [0|251] "MPa" Vector__XXX
 SG_ EngInjectionCtrlPress : 0|16@1+ (0.00390625,0) [0|251] "MPa" Vector__XXX
 SG_ TurningGearEngaged : 0|2@1+ (1,0) [0|3] "" Vector__XXX
 SG_ SafetyWireStatus : 0|2@1+ (1,0) [0|3] "" Vector__XXX
 SG_ ElectricalLoad : 0|16@1+ (0.5,0) [0|32127.5] "kW" Vector__XXX
 SG_ EngVrblGometryTurbo1ActuatorPos : 0|8@1+ (0.4,0) [0|100] "%" Vector__XXX
 SG_ EngVrblGmtryTrbArCtrlShtffValve : 0|2@1+ (1,0) [0|3] "" Vector__XXX
 SG_ EngExhstGsRcirculationValveCtrl : 0|16@1+ (0.0025,0) [0|160.6375] "%" Vector__XXX
 SG_ EngTrb1ClcltedTurbineOutletTemp : 0|16@1+ (0.03125,-273) [-273|1735] "°C" Vector__XXX
 SG_ EngTrb1ClclatedTurbineInletTemp : 0|16@1+ (0.03125,-273) [-273|1735] "°C" Vector__XXX
 SG_ EngRotationDirection : 0|2@1+ (1,0) [0|3] "" Vector__XXX
 SG_ CrnkAttmptCntOnPrsntStrtAttempt : 0|8@1+ (1,0) [0|250] "" Vector__XXX
 SG_ EngRatedSpeed : 0|16@1+ (0.125,0) [0|8031.875] "RPM" Vector__XXX
 SG_ EngRatedPower : 0|16@1+ (0.5,0) [0|32127.5] "kW" Vector__XXX
 SG_ EngMinContinuousTorque : 0|8@1+ (1,-125) [-125|125] "%" Vector__XXX
 SG_ EngMaxContinuousTorque : 0|8@1+ (1,-125) [-125|125] "%" Vector__XXX
 SG_ EngMinContinuousRPM : 0|8@1+ (32,0) [0|8000] "RPM" Vector__XXX
 SG_ EngMaxContinuousRPM : 0|8@1+ (32,0) [0|8000] "RPM" Vector__XXX
 SG_ EngHghLmtThrshhldFrMnCntnsTrqFrm : 0|8@1+ (1,-125) [-125|125] "%" Vector__XXX
 SG_ EngLwLmtThrshldFrMxTrqueFromEng : 0|8@1+ (1,-125) [-125|125] "%" Vector__XXX
 SG_ EngHghLmtThrshhldFrMnCntnsEngRPM : 0|8@1+ (32,0) [0|8000] "RPM" Vector__XXX
 SG_ EngLwLmtThrshhldFrMaxRPMFromEng : 0|8@1+ (32,0) [0|8000] "RPM" Vector__XXX
 SG_ RearAxleGroupEngagementStatus : 0|2@1+ (1,0) [0|3] "" Vector__XXX
 SG_ FrontAxleGroupEngagementStatus : 0|2@1+ (1,0) [0|3] "" Vector__XXX
 SG_ DiffLockStateCentralRear : 0|2@1+ (1,0) [0|3] "" Vector__XXX
 SG_ DiffLockStateCentralFront : 0|2@1+ (1,0) [0|3] "" Vector__XXX
 SG_ DiffLockStateCentral : 0|2@1+ (1,0) [0|3] "" Vector__XXX
 SG_ DiffLockStateRearAxle2 : 0|2@1+ (1,0) [0|3] "" Vector__XXX
 SG_ DiffLockStateRearAxle1 : 0|2@1+ (1,0) [0|3] "" Vector__XXX
 SG_ DiffLockStateFrontAxle2 : 0|2@1+ (1,0) [0|3] "" Vector__XXX
 SG_ DiffLockStateFrontAxle1 : 0|2@1+ (1,0) [0|3] "" Vector__XXX
 SG_ Location : 0|8@1+ (1,0) [0|255] "" Vector__XXX
 SG_ SeaWaterPumpOutletPress : 0|8@1+ (2,0) [0|500] "kPa" Vector__XXX
 SG_ EngAuxCoolantTemp : 0|8@1+ (1,-40) [-40|210] "°C" Vector__XXX
 SG_ EngAuxCoolantPress : 0|8@1+ (4,0) [0|1000] "kPa" Vector__XXX
 SG_ Driver2 : 0|8@1+ (1,0) [0|255] "" Vector__XXX
 SG_ Driver1 : 0|8@1+ (1,0) [0|255] "" Vector__XXX
 SG_ CargoAmbientTemp : 0|16@1+ (0.03125,-273) [-273|1735] "°C" Vector__XXX
 SG_ EngOilFilterDiffPress : 0|8@1+ (0.5,0) [0|125] "kPa" Vector__XXX
 SG_ EngFuelFilterDiffPress : 0|8@1+ (2,0) [0|500] "kPa" Vector__XXX
 SG_ FuelLevel : 0|8@1+ (0.4,0) [0|100] "%" Vector__XXX
 SG_ WasherFluidLevel : 0|8@1+ (0.4,0) [0|100] "%" Vector__XXX
 SG_ EngStartEnableDevice2Config : 0|4@1+ (1,0) [0|15] "" Vector__XXX

CM_ SG_ 3221225472 TrailerWeight "Total mass of freight-carrying vehicle designed to be pulled by truck, including the weight of the contents.";
CM_ SG_ 3221225472 AxleWeight "Total mass imposed by the tires on the road surface at the specified axle.";
CM_ SG_ 3221225472 AxleLocation "To identify to which of several similar devices (such as tires or fuel tanks) the information applies.To identify to which of several similar devices (such as tires or fuel tanks) the information applies.";
CM_ SG_ 3221225472 NetBatteryCurrentHiRes "Net flow of electrical current into/out-of the battery or batteries.";
CM_ SG_ 3221225472 AltCurrentHiRes "This parameter indicates the amount of electrical current output from the alternator of the main vehicle.";
CM_ SG_ 3221225472 Battery2Potential "The voltage for isolated battery #2.";
CM_ SG_ 3221225472 ECUPowerOutputSupplyVoltage3 "The third power output from an ECM.";
CM_ SG_ 3221225472 ECUPowerOutputSupplyVoltage2 "The second power output from an ECM.";
CM_ SG_ 3221225472 BatteryPotential_PowerInput2 "This parameter measures the second source of battery potential as measured at the input of the ECM/actuator etc.";
CM_ SG_ 3221225472 Longitude "Longitude position of the vehicle.";
CM_ SG_ 3221225472 Latitude "Latitude position of the vehicle.";
CM_ SG_ 3221225472 TotalPowerTakeoffHours "Accumulated time of operation of power takeoff device.";
CM_ SG_ 3221225472 TotalVehicleHours "Accumulated time of operation of vehicle.";
CM_ SG_ 3221225472 HydOilLevel "This parameter indicates the level of the hydraulic fluid in tank as a ratio of current volume to total tank volume.";
CM_ SG_ 3221225472 HydOilFilterRestrictionSwitch "This switch indicates whether hydraulic oil filter is clogged.";
CM_ SG_ 3221225472 HydTemp "Temperature of hydraulic fluid.";
CM_ SG_ 3221225472 Altitude "Altitude of the vehicle referenced to sea level at standard atmospheric pressure and temperature.";
CM_ SG_ 3221225472 Pitch "Pitch of the vehicle as calculated by the navigation device(s).";
CM_ SG_ 3221225472 NavigationBasedVehicleSpeed "Speed of the vehicle as calculated from a device such as a Global Positioning System (GPS).";
CM_ SG_ 3221225472 CompassBearing "Present compass bearing of vehicle.";
CM_ SG_ 3221225472 TripAirCompressorOnTime "Total time that the air compressor is on and compressing air since the last trip reset.";
CM_ SG_ 3221225472 TripEngRunningTime "Total time accumulated while the engine speed is greater than zero since the last trip reset.";
CM_ SG_ 3221225472 TripPTOTime "Total time accumulated while the engine is in the PTO or remote PTO hold state since the last trip reset.";
CM_ SG_ 3221225472 TripCruiseTime "Total time accumulated while the engine is in the cruise hold state, excluding time in accelerator override, since the last trip reset.";
CM_ SG_ 3221225472 TripTimeInDerateByEng "Total time accumulated when the engine final fueling has been derated due to an engine protection algorithm, since the last reset.";
CM_ SG_ 3221225472 TripTimeInTopGear "Total time accumulated when the vehicle has operated in top gear for a calibrated minimum time, since the last trip reset.";
CM_ SG_ 3221225472 TrpNmberOfIdleShutdownOverrides "Total number of times an operator disables idle shutdown to prevent an engine shutdown, since the last trip reset.";
CM_ SG_ 3221225472 TripNumberOfIdleShutdowns "Total number of times the engine has been shutdown due to idling too long (at normal idle or fast idle) since the last trip reset.";
CM_ SG_ 3221225472 TripNumberOfHotShutdowns "Total number of hot shutdowns since the last trip reset.";
CM_ SG_ 3221225472 TransitRunStatus "Status of the run switch for the vehicle.";
CM_ SG_ 3221225472 VehicleUseStatus "Used to indicate the proper or unauthorized use of the vehicle.";
CM_ SG_ 3221225472 SilentAlarmStatus "Used to report silent alarm push button status.";
CM_ SG_ 3221225472 PatronCount "Count of the number of passengers on a transit vehicle.";
CM_ SG_ 3221225472 TypeOfPassengerCount "Used to notify transit link devices of the type of passenger counting system used in the vehicle.";
CM_ SG_ 3221225472 FareboxAlarmIdentifier "Indicates the nature of the farebox alarm condition.";
CM_ SG_ 3221225472 FareboxEmergencyStatus "Indicates if a farebox emergency condition exists.";
CM_ SG_ 3221225472 TransferSold "Indicates that a transfer was sold or issued on this transaction including its type and/or restrictions.";
CM_ SG_ 3221225472 RouteNumber "The route number issuing the transfer.";
CM_ SG_ 3221225472 PaymentDetails "Payment details.";
CM_ SG_ 3221225472 PassengerType "Enumerated value representing the type/class of passenger, as defined by the agency.";
CM_ SG_ 3221225472 DriversFareboxSecurityCode "Security code for the farebox, numerical only.";
CM_ SG_ 3221225472 AssignedRoute "The identity number assigned to this route.";
CM_ SG_ 3221225472 TripNumber "The identity number assigned to this trip.";
CM_ SG_ 3221225472 TripDirection "The general direction of travel for this trip.";
CM_ SG_ 3221225472 FareboxServiceStatus "Indicates if the farebox is in or out of service.";
CM_ SG_ 3221225472 VehicleID "Numerical designation of the vehicle.";
CM_ SG_ 3221225472 TireLocation "Identifies which tire is associated with the parametric data in this PGN.Identifies which tire is associated with the parametric data in this PGN.Identifies which tire is associated with the parametric data in this PGN.";
CM_ SG_ 3221225472 SteerChannelTirePress "The latest gage pressure reading of the steer group of tires, as opposed to the pressure in each tire.";
CM_ SG_ 3221225472 DriveChannelTirePress "The latest gage pressure reading of the drive group of tires, as opposed to the pressure in each tire.";
CM_ SG_ 3221225472 TrailerTagPushChannelTirePress "The latest gage pressure reading of the trailer, tag, or push group of tires, as opposed to the pressure in each tire.";
CM_ SG_ 3221225472 SteerChannelTirePressTarget "The tire pressure control system’s target gage pressure for the steer group of tires.";
CM_ SG_ 3221225472 DriveChannelTirePressTarget "The tire pressure control system’s target gage pressure for the drive group of tires.";
CM_ SG_ 3221225472 TrlrTgPshChannelTirePressTarget "The tire pressure control system’s target gage pressure for the trailer, tag, or push group of tires.";
CM_ SG_ 3221225472 PCUSupplySolenoidStatus "Current state of the supply solenoid used to implement a tire pressure control system in its pneumatic control unit (PCU).";
CM_ SG_ 3221225472 PCUCtrlSolenoidStatus "Current state of the control solenoid used to implement a tire pressure control system in its pneumatic control unit (PCU).";
CM_ SG_ 3221225472 PCUDeflateSolenoidStatus "Current state of the deflate solenoid used to implement a tire pressure control system in its pneumatic control unit (PCU).";
CM_ SG_ 3221225472 TirePressSupplySwitchStatus "Current state of an open/closed type switch used to determine if adequate pressure exists for system implementation.";
CM_ SG_ 3221225472 PCUSteerSolenoidStatus "Current state of the steer solenoid used to implement a tire pressure control system in its pneumatic control unit (PCU).";
CM_ SG_ 3221225472 PCUDriveSolenoidStatus "Current state of the drive solenoid used to implement a tire pressure control system in its pneumatic control unit (PCU).";
CM_ SG_ 3221225472 DriveChannelMode "Indicates the functional mode of trailer/tag channel of the tire pressure control system.";
CM_ SG_ 3221225472 Trailer_TagChannelMode "Indicates the functional mode of trailer/tag channel of the tire pressure control system.";
CM_ SG_ 3221225472 SteerChannelMode "Indicates the functional mode of steer channel of the tire pressure control system.";
CM_ SG_ 3221225472 TirePressCheckInterval "The interval at which the system will check the tire pressures (e.";
CM_ SG_ 3221225472 TirePressThresholdDetection "Signal indicating the pressure level of the tire.";
CM_ SG_ 3221225472 TireAirLeakageRate "The pressure loss rate of a tire.";
CM_ SG_ 3221225472 CTIWheelEndElectricalFault "Indicates the status of electrical fault on CTI wheel interface.";
CM_ SG_ 3221225472 CTITireStatus "Indicates the status of the tire.";
CM_ SG_ 3221225472 CTIWheelSensorStatus "Indicates whether the wheel is being monitored by the CTI controller.";
CM_ SG_ 3221225472 TireTemp "Temperature at the surface of the tire sidewall.";
CM_ SG_ 3221225472 TirePress "Pressure at which air is contained in cavity formed by tire and rim.";
CM_ SG_ 3221225472 CatalystTankTemp "Temperature of the reagent in the storage tank.";
CM_ SG_ 3221225472 CatalystTankLevel "A special catalyst uses chemical substance to reach legal requirement for NOX emissions.";
CM_ SG_ 3221225472 CatalystTankLevelPreliminaryFMI "Used to identify the applicable J1939-73 FMI that applies to the most significant failure of the catalyst tank level sensor.";
CM_ SG_ 3221225472 CatalystTankLevel2 "The measure of the reagent level in the catalyst tank.";
CM_ SG_ 3221225472 TripFanOnTimeDueToAManualSwitch "Total time the fan has been on due to manual activation by the operator (i.";
CM_ SG_ 3221225472 TripFanOnTime "Total time the fan has been on (due to an automatic trigger or manual trigger) since the last trip reset.";
CM_ SG_ 3221225472 TripFanOnTimeDueToA_CSystem "Total time the fan has been on due to the A/C system since the last trip reset.";
CM_ SG_ 3221225472 TripFanOnTimeDueToEngSystem "Total time the fan has been on due to engine triggers (i.";
CM_ SG_ 3221225472 TripDistanceInTopGear "Total distance accumulated while the vehicle has operated in top gear for a calibrated minimum time since the last trip reset.";
CM_ SG_ 3221225472 TripDistanceOnVSL "Total distance accumulated while the engine torque mode is road speed governing since the last trip reset.";
CM_ SG_ 3221225472 AdjustLocalMinuteOffset "Used to set the local offset in minutes from a reference time.";
CM_ SG_ 3221225472 AdjustYear "Part of a parameter used to set a calendar date.";
CM_ SG_ 3221225472 AdjustDay "Part of a parameter used to set a calendar date.";
CM_ SG_ 3221225472 AdjustMonth "Part of a parameter used to set a calendar date.";
CM_ SG_ 3221225472 AdjustHours "Part of the parameter used to set the time.";
CM_ SG_ 3221225472 AdjustMinutes "Part of the parameter used to set the time.";
CM_ SG_ 3221225472 AdjustSeconds "Part of the parameter used to set the time.";
CM_ SG_ 3221225472 LocalMinuteOffset "Local offset in minutes from a reference time.";
CM_ SG_ 3221225472 Year "Part of a parameter used to represent a calendar date.";
CM_ SG_ 3221225472 Day "Part of a parameter used to represent a calendar date.";
CM_ SG_ 3221225472 Month "Part of a parameter used to represent a calendar date.";
CM_ SG_ 3221225472 Hours "Part of a parameter used to represent time.";
CM_ SG_ 3221225472 Minutes "Part of a parameter used to represent time.";
CM_ SG_ 3221225472 Seconds "Part of a parameter used to represent time.";
CM_ SG_ 3221225472 EngTrbWstgtActuatorCtrlAirPress "Gage pressure of the air used to control the actuator which opens and closes the wastegate valve.";
CM_ SG_ 3221225472 EngTurbo4WastegateDrive "Position of the wastegate drive.";
CM_ SG_ 3221225472 EngTurbo3WastegateDrive "Position of the wastegate drive.";
CM_ SG_ 3221225472 EngTurbo2WastegateDrive "Position of the wastegate drive.";
CM_ SG_ 3221225472 EngTurbo1WastegateDrive "Position of the wastegate drive.";
CM_ SG_ 3221225472 TachographVehicleSpeed "Speed of the vehicle registered by the tachograph.";
CM_ SG_ 3221225472 TachographOutputShaftSpeed "Calculated speed of the transmission output shaft.";
CM_ SG_ 3221225472 DirectionIndicator "Indicates the direction of the vehicle.";
CM_ SG_ 3221225472 HandlingInformation "Indicates that handling information is present.";
CM_ SG_ 3221225472 SystemEvent "Indicates that a tachograph event has occurred.";
CM_ SG_ 3221225472 Driver2TimeRelatedStates "Indicates if the driver approaches or exceeds working time limits (or other limits).";
CM_ SG_ 3221225472 Overspeed "Indicates whether the vehicle is exceeding the legal speed limit set in the tachograph.";
CM_ SG_ 3221225472 Driver1TimeRelatedStates "Indicates if the driver approaches or exceeds working time limits (or other limits).";
CM_ SG_ 3221225472 DriveRecognize "Indicates whether motion of the vehicle is detected or not.";
CM_ SG_ 3221225472 Driver2WorkingState "State of work of the driver.";
CM_ SG_ 3221225472 Driver1WorkingState "State of work of the driver.";
CM_ SG_ 3221225472 EngTurbo4TurbineOutletTemp "Temperature of the combustion by-products exiting the turbine side of the turbocharger.";
CM_ SG_ 3221225472 EngTurbo3TurbineOutletTemp "Temperature of the combustion by-products exiting the turbine side of the turbocharger.";
CM_ SG_ 3221225472 EngTurbo2TurbineOutletTemp "Temperature of the combustion by-products exiting the turbine side of the turbocharger.";
CM_ SG_ 3221225472 EngTurbo1TurbineOutletTemp "Temperature of the combustion by-products exiting the turbine side of the turbocharger.";
CM_ SG_ 3221225472 EngTurbo4TurbineInletTemp "Temperature of the combustion by-products entering the turbine side of the turbocharger.";
CM_ SG_ 3221225472 EngTurbo3TurbineInletTemp "Temperature of the combustion by-products entering the turbine side of the turbocharger.";
CM_ SG_ 3221225472 EngTurbo2TurbineInletTemp "Temperature of the combustion by-products entering the turbine side of the turbocharger.";
CM_ SG_ 3221225472 EngTurbo1TurbineInletTemp "Temperature of the combustion by-products entering the turbine side of the turbocharger.";
CM_ SG_ 3221225472 EngTurbo4CompressorInletPress "Gage pressure of the air entering the compressor side of the turbocharger.";
CM_ SG_ 3221225472 EngTurbo3CompressorInletPress "Gage pressure of the air entering the compressor side of the turbocharger.";
CM_ SG_ 3221225472 EngTurbo2CompressorInletPress "Gage pressure of the air entering the compressor side of the turbocharger.";
CM_ SG_ 3221225472 EngTurbo1CompressorInletPress "Gage pressure of the air entering the compressor side of the turbocharger.";
CM_ SG_ 3221225472 EngTurbo4CompressorInletTemp "Temperature of the air entering the compressor side of the turbocharger.";
CM_ SG_ 3221225472 EngTurbo3CompressorInletTemp "Temperature of the air entering the compressor side of the turbocharger.";
CM_ SG_ 3221225472 EngTurbo2CompressorInletTemp "Temperature of the air entering the compressor side of the turbocharger.";
CM_ SG_ 3221225472 EngTurbo1CompressorInletTemp "Temperature of the air entering the compressor side of the turbocharger.";
CM_ SG_ 3221225472 EngTurbo4Speed "Rotational velocity of rotor in the turbocharger.";
CM_ SG_ 3221225472 EngTurbo3Speed "Rotational velocity of rotor in the turbocharger.";
CM_ SG_ 3221225472 EngTurbo2Speed "Rotational velocity of rotor in the turbocharger.";
CM_ SG_ 3221225472 EngTurboLubeOilPress2 "Gage pressure of oil in turbocharger lubrication system.";
CM_ SG_ 3221225472 NumberOfForwardGearRatios "Number of forward gear ratios in the transmission, provided as part of the configuration.";
CM_ SG_ 3221225472 NumberOfReverseGearRatios "Number of reverse gear ratios in the transmission, provided as part of the transmission configuration.";
CM_ SG_ 3221225472 TrnsShftSlctorDisplayModeSwitch "Status of the operator’s switch used to ‘toggle’ through multiple display modes of a shift selector display.";
CM_ SG_ 3221225472 TransMode4 "Indicates whether transmission mode 4 is enabled.";
CM_ SG_ 3221225472 TransMode3 "Indicates whether transmission mode 3 is enabled.";
CM_ SG_ 3221225472 TransMode2 "Indicates whether transmission mode 2 is enabled.";
CM_ SG_ 3221225472 TransMode1 "Indicates whether transmission mode 1 is enabled.";
CM_ SG_ 3221225472 DisengageDiffLockRqCentralRear "Command signal used to disengage the various differential locks, e.";
CM_ SG_ 3221225472 DisengageDiffLockRqCentralFront "Command signal used to disengage the various differential locks, e.";
CM_ SG_ 3221225472 DisengageDiffLockRqCentral "Command signal used to disengage the various differential locks, e.";
CM_ SG_ 3221225472 DisengageDiffLockRqRearAxle2 "Command signal used to disengage the various differential locks, e.";
CM_ SG_ 3221225472 DisengageDiffLockRqRearAxle1 "Command signal used to disengage the various differential locks, e.";
CM_ SG_ 3221225472 DisengageDiffLockRqFrontAxle2 "Command signal used to disengage the various differential locks, e.";
CM_ SG_ 3221225472 DisengageDiffLockRqFrontAxle1 "Command signal used to disengage the various differential locks, e.";
CM_ SG_ 3221225472 TransRqedGear "Gear requested by the operator, ABS, or engine.";
CM_ SG_ 3221225472 RqedPercentClutchSlip "Parameter which represents the percent clutch slip requested by a device.";
CM_ SG_ 3221225472 DisengageDrivelineRq "Command signal used to simply disengage the driveline, e.";
CM_ SG_ 3221225472 TorqueConverterLockupDisableRq "Command signal to prevent torque converter lockup, which may cause problems in certain circumstances for ASR.";
CM_ SG_ 3221225472 TransGearShiftInhibitRq "Command signal to inhibit gear shifts.";
CM_ SG_ 3221225472 AirSuspensionSupplyPressRq "Command signal to influence the pneumatic pressure in the circuit for the electronically controlled air suspension system.";
CM_ SG_ 3221225472 AuxEquipmentSupplyPressRq "Command signal to influence the pneumatic pressure in the auxiliary circuit.";
CM_ SG_ 3221225472 ServiceBrakeAirPressRqCircuit2 "Command signal to influence the pneumatic pressure in the service brake circuit or reservoir #2.";
CM_ SG_ 3221225472 ServiceBrakeAirPressRqCircuit1 "Command signal to influence the pneumatic pressure in the service brake circuit or reservoir #1.";
CM_ SG_ 3221225472 ParkingAnd_OrTrailerAirPressRq "Command signal to influence the pneumatic pressure in the circuit or reservoir for the parking brake and/or the trailer supply.";
CM_ SG_ 3221225472 PneumaticSupplyPressRq "Command signal to influence the pneumatic pressure in the main reservoir.";
CM_ SG_ 3221225472 EngExtlShutdownAirSupplyPress "Pressure of the air used to shut off the fuel supply to the engine.";
CM_ SG_ 3221225472 ServiceComponentIdentificationB "Identification of component needing service.";
CM_ SG_ 3221225472 ServiceComponentIdentificationA "Identification of component needing service.";
CM_ SG_ 3221225472 SrvceDelay_OperationalTimeBased "The time in vehicle operational time until the next vehicle service inspection is required.";
CM_ SG_ 3221225472 ServiceDelay_CalendarTimeBased "The time in weeks until the next vehicle service inspection is required.";
CM_ SG_ 3221225472 ServiceDistance "The distance which can be traveled by the vehicle before the next service inspection is required.";
CM_ SG_ 3221225472 ServiceComponentIdentification "Identification of component needing service.Identification of component needing service.Identification of component needing service.";
CM_ SG_ 3221225472 TimeSinceLastService "The vehicle operation time since the last service was performed.";
CM_ SG_ 3221225472 MaxContinuousRetarderTorque "Applied limit for maximum continuous retarder torque.";
CM_ SG_ 3221225472 HghLmtThrshhldFrMnCntnsTrqFrmRtr "Maximum allowable value for minimum continuous retarder torque.";
CM_ SG_ 3221225472 LwLmtThrshhldFrMxTrqFrmRetarder "Minimum allowable value for maximum continuous retarder torque.";
CM_ SG_ 3221225472 HydRetarderOilTemp "Temperature of oil found in a hydraulic retarder.";
CM_ SG_ 3221225472 HydRetarderPress "Gage pressure of oil in hydraulic retarder system.";
CM_ SG_ 3221225472 EngBuildHoursReset "Command signal used to reset the engine rebuild hours.";
CM_ SG_ 3221225472 TripGroup2Proprietary "Command signal used to reset proprietary parameters associated with a trip but not defined within this document.";
CM_ SG_ 3221225472 TripGroup1 "Command signal used to reset the PGNs and parameters as defined in Table SPN988_A.";
CM_ SG_ 3221225472 RetarderSpeedAtPoint4 "Retarder speed of point 4 of the engine retarder torque map.";
CM_ SG_ 3221225472 RetarderSpeedAtPoint3 "Retarder speed of point 3 of the engine retarder torque map.";
CM_ SG_ 3221225472 PercentTorqueAtMaxSpeedPoint2 "The torque limit that indicates the available retarder torque which can be provided by the retarder at its maximum speed.";
CM_ SG_ 3221225472 MaxRetarderSpeedPoint2 "Maximum speed of retarder (Please reference PGN 65249).";
CM_ SG_ 3221225472 PercentTorqueAtIdlePoint1 "The torque limit that indicates the available retarder torque which can be provided by the retarder at idle speed.";
CM_ SG_ 3221225472 RetarderCtrlMethod "This parameter identifies the number of steps used by the retarder.";
CM_ SG_ 3221225472 RetarderType "A vehicle retarder is a supplementary device to the wheel brakes for the driver to better control the vehicle.";
CM_ SG_ 3221225472 EngOperationTimeSinceRebuild "The time in engine operation since the last engine rebuild.";
CM_ SG_ 3221225472 RearWasherFunction "State of operation selected by operator switch for the rear washer.";
CM_ SG_ 3221225472 FrontOperatorWasherSwitch "State of operation selected by operator switch for the washer in front of the operator position.";
CM_ SG_ 3221225472 FrontNonoperatorWasherSwitch "State of operation selected by operator switch for the front washer not in front of the operator position.";
CM_ SG_ 3221225472 RearWiperDelayCtrl "Time between cycles of the rear wiper (i.";
CM_ SG_ 3221225472 FrontNonoperatorWiperDelayCtrl "Time between cycles of the front non-operator side wiper (i.";
CM_ SG_ 3221225472 FrontOperatorWiperDelayCtrl "Time between cycles of the front operator side wiper (i.";
CM_ SG_ 3221225472 RearWiperSwitch "State of operation selected by operator switch for the rear wiper.";
CM_ SG_ 3221225472 FrontOperatorWiperSwitch "State of operation selected by operator switch for the Wiper in front of the operator position.";
CM_ SG_ 3221225472 FrontNonoperatorWiperSwitch "State of operation selected by operator switch for the front wiper not in front of the operator position.";
CM_ SG_ 3221225472 EngAltRatingSelect "In some off-highway applications it may be desirable to have multiple engine ratings available for selection by the operator.";
CM_ SG_ 3221225472 EngAltLowIdleSwitch "Operator switch which selects between two low idle speeds, default and alternate.";
CM_ SG_ 3221225472 EngSynchronizationSwitch "This is the On/Off operation of the Multiple Unit Synchronization functionality.";
CM_ SG_ 3221225472 EngAuxGovernorSwitch "This is the On/Off operation of the Auxiliary Governor feature switch.";
CM_ SG_ 3221225472 EngAltRatingSelectState "In some off-highway applications it may be desirable to have multiple engine ratings available for selection by the operator.";
CM_ SG_ 3221225472 EngAltLowIdleSelectState "In many applications, it is desirable that an alternate low idle speed setting be made available via switch input.";
CM_ SG_ 3221225472 EngMultiUnitSyncState "This feature is widely used in Industry to operate multiple engines from a single command source.";
CM_ SG_ 3221225472 EngAuxGovernorState "This is the Engine Auxiliary Governor feature.";
CM_ SG_ 3221225472 OprtrsDesiredDelayedLampOffTime "A 16 bit parameter to be associated with Delayed Off position (1000 binary) of the Main Light Switch.";
CM_ SG_ 3221225472 OperatorsDesiredBacklight "A 8 bit parameter to indicate the level of back lighting the operator has selected for displays.";
CM_ SG_ 3221225472 HighLowBeamSwitch "A 2 bit parameter to indicate the selected position of the operator's high/low beam select switch.";
CM_ SG_ 3221225472 HazardLightSwitch "A 2 bit parameter to indicate the selected position of the operator's hazard light switch.";
CM_ SG_ 3221225472 TurnSignalSwitch "A 4 bit parameter to indicate the selected position of the operator's turn signal switch.";
CM_ SG_ 3221225472 MainLightSwitch "A 4 bit parameter to indicate the selected position of the operator's main light switch.";
CM_ SG_ 3221225472 WorkLightSwitch "A 4 bit parameter to indicate the selected position of the operator's work light switch.";
CM_ SG_ 3221225472 AppliedVehicleSpeedLimit "The vehicle speed limit in effect.";
CM_ SG_ 3221225472 MaxVehicleSpeedLimit1 "The lowest Maximum Vehicle Speed Limit.";
CM_ SG_ 3221225472 OprtrsBlckOutIntensitySelection "Operators Selection of lamp intensity in black out mode.";
CM_ SG_ 3221225472 SlowVesselModeStatus "The status of the Slow Vessel Mode.";
CM_ SG_ 3221225472 TrollingModeStatus "The status of the Trolling Mode.";
CM_ SG_ 3221225472 EngThrttlSynchrnztionModeStatus "The status of the Throttle Synchronization Mode.";
CM_ SG_ 3221225472 EngMainBearing11Temp "Temperature of the main bearing which supports the crankshaft of the engine.";
CM_ SG_ 3221225472 EngMainBearing10Temp "Temperature of the main bearing which supports the crankshaft of the engine.";
CM_ SG_ 3221225472 EngMainBearing9Temp "Temperature of the main bearing which supports the crankshaft of the engine.";
CM_ SG_ 3221225472 EngMainBearing8Temp "Temperature of the main bearing which supports the crankshaft of the engine.";
CM_ SG_ 3221225472 EngMainBearing7Temp "Temperature of the main bearing which supports the crankshaft of the engine.";
CM_ SG_ 3221225472 EngMainBearing6Temp "Temperature of the main bearing which supports the crankshaft of the engine.";
CM_ SG_ 3221225472 EngMainBearing5Temp "Temperature of the main bearing which supports the crankshaft of the engine.";
CM_ SG_ 3221225472 EngMainBearing4Temp "Temperature of the main bearing which supports the crankshaft of the engine.";
CM_ SG_ 3221225472 EngMainBearing3Temp "Temperature of the main bearing which supports the crankshaft of the engine.";
CM_ SG_ 3221225472 EngMainBearing2Temp "Temperature of the main bearing which supports the crankshaft of the engine.";
CM_ SG_ 3221225472 EngMainBearing1Temp "Temperature of the main bearing which supports the crankshaft of the engine.";
CM_ SG_ 3221225472 DisplayDeadbands "Sets Display Deadbands mode.";
CM_ SG_ 3221225472 LEDPatternCtrl "Sets LED Pattern control mode on laser leveling systems.";
CM_ SG_ 3221225472 LEDDisplayDeadbandCtrl "This parameter informs the system what the selected Display deadband will be.";
CM_ SG_ 3221225472 LEDDisplayModeCtrl "This parameter informs the system what the selected Display mode will be.";
CM_ SG_ 3221225472 LEDDisplayData1 "Informs display devices how to display the current vertical position.";
CM_ SG_ 3221225472 AbsLaserStrikePosition "Laser Strike location on the survey type laser receiver.";
CM_ SG_ 3221225472 LaserStrikeDataLatency "Time from laser strike to CAN message transmission.";
CM_ SG_ 3221225472 LaserReceiverType "Identifies which type of Laser Receiver transmitted the message.";
CM_ SG_ 3221225472 LaserStrikeVerticalDeviation "The calculated distance from the laser strike position to the current land leveling system reference point.";
CM_ SG_ 3221225472 LaserTracerInformation "Provides the status of the laser tracer to the operator.";
CM_ SG_ 3221225472 LEDDisplayData2 "Informs display devices how to display the current position of the laser tracer.";
CM_ SG_ 3221225472 LaserTracerHorizontalDeviation "The calculated percent deviation between the target distance and the center of the laser tracer.";
CM_ SG_ 3221225472 LaserTracerVerticalDistance "The elevation of the laser tracer sensor in a laser leveling system.";
CM_ SG_ 3221225472 LaserTracerTargetDeviation "The calculated distance for the laser target to the current laser tracer reference point.";
CM_ SG_ 3221225472 BldHeightSetPointHighResolution "High resolution for the laser guided blade set point.";
CM_ SG_ 3221225472 ModifySetPoint "Used to control and coordinate the set point for the leveling system.";
CM_ SG_ 3221225472 SdshftDsrdBldOffsetOperatorCtrl "This parameter indicates the side-shift blade control mode operator control state the user has set for the land leveling system.";
CM_ SG_ 3221225472 SdshftBldCtrlMdeOperatorControl "This parameter indicates the side-shift blade control mode operator control state the user has set for the land leveling system.";
CM_ SG_ 3221225472 RghtDsrdBladeOffsetOperatorCtrl "This parameter indicates the right blade offset operator control state the user has set for the land leveling system.";
CM_ SG_ 3221225472 RghtBldeCtrlModeOperatorControl "This parameter indicates the right blade control mode operator control state the user has set for the land leveling system.";
CM_ SG_ 3221225472 LftDsredBladeOffsetOperatorCtrl "This parameter indicates the left blade offset operator control state the user has set for the land leveling system.";
CM_ SG_ 3221225472 LftBladeCtrlModeOperatorControl "This parameter indicates the left blade control mode operator control state the user has set for the land leveling system.";
CM_ SG_ 3221225472 DesiredGradeOffsetSwitch "This parameter indicates the grade offset switch state the user has set for the land leveling system.";
CM_ SG_ 3221225472 BladeCtrlModeSwitch "This parameter indicates the blade control mode switch state the user has set for the land leveling system.";
CM_ SG_ 3221225472 MastPos "Used to monitor the position of the sensor attached to the land leveling mast.";
CM_ SG_ 3221225472 FrontWheelDriveActuatorStatus "Feedback on the front wheel drive actuator.";
CM_ SG_ 3221225472 FMSstandardSWversionSupported "Information that identifies which issue level of the FMS-standard document the software included in the FMS gateway supports.";
CM_ SG_ 3221225472 LnDprtureIndicationEnableStatus "Indicates whether lane departure indication is active.";
CM_ SG_ 3221225472 LaneTrackingStatusLeftSide "Indicates whether the left side is tracking lane.";
CM_ SG_ 3221225472 LaneTrackingStatusRightSide "Indicates whether right side is tracking lane.";
CM_ SG_ 3221225472 LaneDepartureImminentLeftSide "Indicates departure imminent on left side of lane.";
CM_ SG_ 3221225472 LaneDepartureImminentRightSide "Indicates departure imminent on right side of lane.";
CM_ SG_ 3221225472 EngFuelLeakage2 "Status signal which indicates fuel leakage in the fuel rail of the engine.";
CM_ SG_ 3221225472 EngFuelLeakage1 "Status signal which indicates fuel leakage in the fuel rail of the engine.";
CM_ SG_ 3221225472 EngTorqueLimit6AxleInput "Limit applied to the engine output torque based on the maximum allowable axle input torque.";
CM_ SG_ 3221225472 EngTorqueLimit5Switch "Limit applied to the engine output torque based on activation of an ECU switch input.";
CM_ SG_ 3221225472 EngTorqueLimitFeature "Torque limit rating described in the current record.";
CM_ SG_ 3221225472 TorqueLimitingFeatureStatus "Status of an ECU feature which limits the torque output of the engine.";
CM_ SG_ 3221225472 CalibRecordDurationTime "Duration in hours for which the engine operated in the conditions captured in the current record.";
CM_ SG_ 3221225472 CalibRecordStartYear "Calendar year timestamp when an ECU record was established.";
CM_ SG_ 3221225472 CalibRecordStartDay "Calendar day timestamp when an ECU record was established.";
CM_ SG_ 3221225472 CalibRecordStartMonth "Calendar month timestamp when an ECU record was established.";
CM_ SG_ 3221225472 EngPeakTorque2 "Maximum torque output of the current ECU calibration when the engine operates on torque curve 2.";
CM_ SG_ 3221225472 EngPeakTorque1 "Maximum torque output of the current ECU calibration when the engine operates on torque curve 1.";
CM_ SG_ 3221225472 EngPower "Advertised engine power capability.";
CM_ SG_ 3221225472 NumberOfEngTorqueHistoryRecords "Number of torque history records contained in the engine torque history PGN.";
CM_ SG_ 3221225472 TransTorqueConverterRatio "Ratio of the transmissions torque converter output torque to torque converter input torque at current speed.";
CM_ SG_ 3221225472 TransShiftInhibitIndicator "State signal indicating a transmission request for the Shift Inhibit Indicator to be active or inactive.";
CM_ SG_ 3221225472 TransEngCrankEnable "State signal from the transmission indicating if the transmission’s status is such that engine cranking is allowed (i.";
CM_ SG_ 3221225472 TransServiceIndicator "Signal from transmission indicating that some aspect of the gearbox requires servicing.";
CM_ SG_ 3221225472 TransCurrRangeDisplayBlankState "State signal indicating a transmission request for the display of the Transmission Current Range parameter.";
CM_ SG_ 3221225472 ClutchLifeRemaining "Signal which indicates the actual clutch life remaining in percent.";
CM_ SG_ 3221225472 LowestPossibleGear "The transmission calculates this gear continuously.";
CM_ SG_ 3221225472 HighestPossibleGear "The transmission calculates this gear continuously.";
CM_ SG_ 3221225472 RecommendedGear "The transmission calculates this gear continuously.";
CM_ SG_ 3221225472 TransForwardDirectionSwitch "Identifies the status of the switch that indicates forward direction.";
CM_ SG_ 3221225472 TransNeutralSwitch "Identifies the status of the switch that indicates neutral.";
CM_ SG_ 3221225472 TransReverseDirectionSwitch "Identifies the status of the switch that indicates reverse direction.";
CM_ SG_ 3221225472 TransLowRangeSenseSwitch "Identifies the status of the switch that represents low range.";
CM_ SG_ 3221225472 TransHighRangeSenseSwitch "Identifies the status of the switch that represents high range.";
CM_ SG_ 3221225472 TransSynchronizerBrakeValue "The current modulated value for the air supply to the synchronizer brake.";
CM_ SG_ 3221225472 TransSynchronizerClutchValue "The current modulated value for the air supply to the synchronizer clutch.";
CM_ SG_ 3221225472 TransInertiaBrakeActuator "Identifies the status of the actuator that controls the inertia brake.";
CM_ SG_ 3221225472 TransDefuelActuator "Identifies the status of the actuator that controls the engine defuel mechanism.";
CM_ SG_ 3221225472 TransLockupClutchActuator "Identifies the status of the actuator that controls the lockup clutch.";
CM_ SG_ 3221225472 TransClutchActuator "Identifies the status of the actuator that controls the clutch.";
CM_ SG_ 3221225472 TransSplitterIndirectActuator "Identifies the status of the splitter indirect actuator in the auxiliary unit.";
CM_ SG_ 3221225472 TransSplitterDirectActuator "Identifies the status of the splitter direct actuator in the auxiliary unit.";
CM_ SG_ 3221225472 TransRangeLowActuator "Identifies the status of the range low actuator in the auxiliary unit.";
CM_ SG_ 3221225472 TransRangeHighActuator "Identifies the status of the range high actuator in the auxiliary unit.";
CM_ SG_ 3221225472 TransShiftFingerGearActuator2 "Identifies the status of the actuator that moves the shift finger identified as gear actuator #2.";
CM_ SG_ 3221225472 TransShiftFingerRailActuator2 "Identifies the status of the actuator that moves the shift finger identified as rail actuator #2.";
CM_ SG_ 3221225472 TransShiftFingerGearActuator1 "Identifies the status of the actuator that moves the shift finger identified as gear actuator #1.";
CM_ SG_ 3221225472 TransShiftFingerRailActuator1 "Identifies the status of the actuator that moves the shift finger identified as rail actuator #1.";
CM_ SG_ 3221225472 TrnsShftFngrCenterRailIndicator "Identifies the status of the shift finger in the center rail position.";
CM_ SG_ 3221225472 TrnsShftFngrEngagementIndicator "Identifies the status of the shift finger in the engagement position.";
CM_ SG_ 3221225472 TrnsShiftFingerNeutralIndicator "Indicates the status of the shift finger in the neutral position.";
CM_ SG_ 3221225472 TransShiftFingerRailPos "The current position of the shift finger in the rail direction.";
CM_ SG_ 3221225472 TransShiftFingerGearPos "The current position of the shift finger in the gear direction.";
CM_ SG_ 3221225472 TransCurrentRange "Range currently being commanded by the transmission control system.";
CM_ SG_ 3221225472 TransRqedRange "Range selected by the operator.";
CM_ SG_ 3221225472 TransActualGearRatio "Actual ratio of input shaft speed to output shaft speed.";
CM_ SG_ 3221225472 SrcAddrssOfCtrllngDvcFrTrnsCtrl "The source address of the SAE J1939 device currently controlling the transmission.";
CM_ SG_ 3221225472 TransInputShaftSpeed "Rotational velocity of the primary shaft transferring power into the transmission.";
CM_ SG_ 3221225472 ProgressiveShiftDisable "Command signal used to indicate that progressive shifting by the engine should be disallowed.";
CM_ SG_ 3221225472 TransOutputShaftSpeed "Calculated speed of the transmission output shaft.";
CM_ SG_ 3221225472 TransShiftInProcess "Indicates that the transmission is in process of shifting from the current gear to the selected gear.";
CM_ SG_ 3221225472 TorqueConverterLockupEngaged "State signal which indicates whether the torque converter lockup is engaged.";
CM_ SG_ 3221225472 EngChargeAirCoolerOutletTemp "Temperature of combustion air after it exits from the Charge Air Cooler but before any mixing of Recirculated Exhaust Gas.";
CM_ SG_ 3221225472 EngCoolantTempHiRes "Temperature of liquid found in engine cooling system.";
CM_ SG_ 3221225472 EngIntkVlvActationSystemOilTemp "The temperature of the oil in the hydraulic system that powers the intake valve actuation system.";
CM_ SG_ 3221225472 EngIntakeManifold1AirTemp "Temperature of pre-combustion air found in intake manifold of engine air supply system.";
CM_ SG_ 3221225472 EngExhstExhstGsTempLeftManifold "Temperature of combustion byproducts within the left engine exhaust manifold.";
CM_ SG_ 3221225472 EngExhstExhstGsTmpRightManifold "Temperature of combustion byproducts within the right engine exhaust manifold.";
CM_ SG_ 3221225472 SterableLiftAxleLoweringInhibit "A signal which indicates if lowering of lifted axle is allowed or inhibited.";
CM_ SG_ 3221225472 TypeOfSteerTrans "Type of Steering Transmission (Ref.";
CM_ SG_ 3221225472 TypeOfSteerForces "Type of Steering Forces (Ref.";
CM_ SG_ 3221225472 SteerType "Indicates the different types of steering systems (ref.";
CM_ SG_ 3221225472 ActualInnerWheelSteerAngle "Signal which indicates the actual inner wheel steering angle.";
CM_ SG_ 3221225472 TransOutputRetarder "Identifies the status of the transmission output retarder.";
CM_ SG_ 3221225472 ActlMxAvlblRtarderPercentTorque "This is the maximum amount of torque that the retarder can immediately deliver.";
CM_ SG_ 3221225472 SrcAddrssOfCtrllngDvcFrRtrdrCtrl "The source address of the SAE J1939 device currently controlling the retarder.";
CM_ SG_ 3221225472 EngCoolantLoadIncrease "Status of an event, external to the engine, that may increase the nominal temperature of the engine coolant liquid.";
CM_ SG_ 3221225472 IntendedRetarderPercentTorque "Braking torque of retarder that the retarder is currently trying to achieve.";
CM_ SG_ 3221225472 ActualRetarderPercentTorque "Actual braking torque of the retarder as a percent of retarder configuration reference torque SPN 556.";
CM_ SG_ 3221225472 RetarderEnableShiftAssistSwitch "Switch signal which indicates whether the operator wishes the retarder to be enabled for transmission shift assist.";
CM_ SG_ 3221225472 RetarderEnableBrakeAssistSwitch "Switch signal which indicates whether the operator wishes the retarder to be enabled for vehicle braking assist.";
CM_ SG_ 3221225472 RetarderTorqueMode "State signal which indicates which retarder torque mode is currently generating, limiting, or controlling the torque.";
CM_ SG_ 3221225472 EngExhaustGasPort20Temp "Temperature at the cylinder exhaust port of the engine.";
CM_ SG_ 3221225472 EngExhaustGasPort19Temp "Temperature at the cylinder exhaust port of the engine.";
CM_ SG_ 3221225472 EngExhaustGasPort18Temp "Temperature at the cylinder exhaust port of the engine.";
CM_ SG_ 3221225472 EngExhaustGasPort17Temp "Temperature at the cylinder exhaust port of the engine.";
CM_ SG_ 3221225472 EngExhaustGasPort16Temp "Temperature at the cylinder exhaust port of the engine.";
CM_ SG_ 3221225472 EngExhaustGasPort15Temp "Temperature at the cylinder exhaust port of the engine.";
CM_ SG_ 3221225472 EngExhaustGasPort14Temp "Temperature at the cylinder exhaust port of the engine.";
CM_ SG_ 3221225472 EngExhaustGasPort13Temp "Temperature at the cylinder exhaust port of the engine.";
CM_ SG_ 3221225472 EngExhaustGasPort12Temp "Temperature at the cylinder exhaust port of the engine.";
CM_ SG_ 3221225472 EngExhaustGasPort11Temp "Temperature at the cylinder exhaust port of the engine.";
CM_ SG_ 3221225472 EngExhaustGasPort10Temp "Temperature at the cylinder exhaust port of the engine.";
CM_ SG_ 3221225472 EngExhaustGasPort9Temp "Temperature at the cylinder exhaust port of the engine.";
CM_ SG_ 3221225472 EngExhaustGasPort8Temp "Temperature at the cylinder exhaust port of the engine.";
CM_ SG_ 3221225472 EngExhaustGasPort7Temp "Temperature at the cylinder exhaust port of the engine.";
CM_ SG_ 3221225472 EngExhaustGasPort6Temp "Temperature at the cylinder exhaust port of the engine.";
CM_ SG_ 3221225472 EngExhaustGasPort5Temp "Temperature at the cylinder exhaust port of the engine.";
CM_ SG_ 3221225472 EngExhaustGasPort4Temp "Temperature at the cylinder exhaust port of the engine.";
CM_ SG_ 3221225472 EngExhaustGasPort3Temp "Temperature at the cylinder exhaust port of the engine.";
CM_ SG_ 3221225472 EngExhaustGasPort2Temp "Temperature at the cylinder exhaust port of the engine.";
CM_ SG_ 3221225472 EngExhaustGasPort1Temp "Temperature at the cylinder exhaust port of the engine.";
CM_ SG_ 3221225472 PayloadPercentage "The current payload of the equipment, reported as a percentage of the equipment's rated payload limit.";
CM_ SG_ 3221225472 DataMemoryUsage "The used storage capacity of the data buffer memory internal to an ECU, such as a data logger.";
CM_ SG_ 3221225472 KeepAliveBatteryConsumption "The capacity consumed from the direct battery connection since the key was last turned off.";
CM_ SG_ 3221225472 Jystck3GripXAxisDetentPosStatus "Reports when the current joystick grip position is in the detent position for that axis of travel.";
CM_ SG_ 3221225472 Jystck3GripYAxisDetentPosStatus "Reports when the current joystick grip position is in the detent position for that axis of travel.";
CM_ SG_ 3221225472 Jystck3ThetaAxisDetentPosStatus "Reports when the current joystick position is in the detent position for that axis of travel.";
CM_ SG_ 3221225472 Joystick3ThetaAxisPos "The position of the joystick in the relative motion of travel from the neutral position.";
CM_ SG_ 3221225472 Jystck3ThtaAxisNeutralPosStatus "Reports when the current joystick position is in the neutral position for that axis of travel.";
CM_ SG_ 3221225472 Joystick3GripYAxisPos "The position of the joystick grip in the relative motion of travel from the neutral position.";
CM_ SG_ 3221225472 Jystck3GrpYAxisNeutralPosStatus "Reports when the current joystick grip position is in the neutral position for that axis of travel.";
CM_ SG_ 3221225472 Joystick3GripXAxisPos "The position of the joystick grip in the relative motion of travel from the neutral position.";
CM_ SG_ 3221225472 Jystck3GrpXAxisNeutralPosStatus "Reports when the current joystick grip position is in the neutral position for that axis of travel.";
CM_ SG_ 3221225472 Jystck2GripXAxisDetentPosStatus "Reports when the current joystick grip position is in the detent position for that axis of travel.";
CM_ SG_ 3221225472 Jystck2GripYAxisDetentPosStatus "Reports when the current joystick grip position is in the detent position for that axis of travel.";
CM_ SG_ 3221225472 Jystck2ThetaAxisDetentPosStatus "Reports when the current joystick position is in the detent position for that axis of travel.";
CM_ SG_ 3221225472 Joystick2ThetaAxisPos "The position of the joystick in the relative motion of travel from the neutral position.";
CM_ SG_ 3221225472 Jystck2ThtaAxisNeutralPosStatus "Reports when the current joystick position is in the neutral position for that axis of travel.";
CM_ SG_ 3221225472 Joystick2GripYAxisPos "The position of the joystick grip in the relative motion of travel from the neutral position.";
CM_ SG_ 3221225472 Jystck2GrpYAxisNeutralPosStatus "Reports when the current joystick grip position is in the neutral position for that axis of travel.";
CM_ SG_ 3221225472 Joystick2GripXAxisPos "The position of the joystick grip in the relative motion of travel from the neutral position.";
CM_ SG_ 3221225472 Jystck2GrpXAxisNeutralPosStatus "Reports when the current joystick grip position is in the neutral position for that axis of travel.";
CM_ SG_ 3221225472 Jystck1GripXAxisDetentPosStatus "Reports when the current joystick grip position is in the detent position for that axis of travel.";
CM_ SG_ 3221225472 Jystck1GripYAxisDetentPosStatus "Reports when the current joystick grip position is in the detent position for that axis of travel.";
CM_ SG_ 3221225472 Jystck1ThetaAxisDetentPosStatus "Reports when the current joystick position is in the detent position for that axis of travel.";
CM_ SG_ 3221225472 Joystick1ThetaAxisPos "The position of the joystick in the relative motion of travel from the neutral position.";
CM_ SG_ 3221225472 Jystck1ThtaAxisNeutralPosStatus "Reports when the current joystick position is in the neutral position for that axis of travel.";
CM_ SG_ 3221225472 Joystick1GripYAxisPos "The position of the joystick grip in the relative motion of travel from the neutral position.";
CM_ SG_ 3221225472 Jystck1GrpYAxisNeutralPosStatus "Reports when the current joystick grip position is in the neutral position for that axis of travel.";
CM_ SG_ 3221225472 Joystick1GripXAxisPos "The position of the joystick grip in the relative motion of travel from the neutral position.";
CM_ SG_ 3221225472 Jystck1GrpXAxisNeutralPosStatus "Reports when the current joystick grip position is in the neutral position for that axis of travel.";
CM_ SG_ 3221225472 EngFuelRackPos "Measured position of the engine fuel rack.";
CM_ SG_ 3221225472 InstantaneousEstBrakePower "Estimate of the power developed by the engine.";
CM_ SG_ 3221225472 EngMassFlow "Mass flow of natural gas to the engine.";
CM_ SG_ 3221225472 EngExhaustGasPress "Gage pressure of the exhaust gasses as measured at the turbine inlet of the turbocharger.";
CM_ SG_ 3221225472 EngPrefilterOilPress "Gage pressure of the engine oil before the oil reaches the oil filter.";
CM_ SG_ 3221225472 TotalECURunTime "Total time accumulated over the life of the ECU, from ignition switch ON to ignition switch OFF.";
CM_ SG_ 3221225472 TotalECUDistance "Total distance accumulated over the life of the ECU.";
CM_ SG_ 3221225472 EngInletAirMassFlowRate "Mass flow rate of fresh air entering the engine air intake, before any EGR mixer, if used.";
CM_ SG_ 3221225472 EngExhstGsRcrcltionMassFlowRate "Flow rate of gas through the EGR system.";
CM_ SG_ 3221225472 EngFuelFilterSucSideDiffPress "Differential pressure measured across the fuel filter located between the fuel tank and the supply pump.";
CM_ SG_ 3221225472 EngFuelSupplyPumpInletPress "Absolute pressure of fuel at the fuel supply pump inlet.";
CM_ SG_ 3221225472 EngOilLevelRemoteReservoir "Ratio of current volume of engine oil in a remote reservoir to the maximum required volume.";
CM_ SG_ 3221225472 EngWasteOilReservoirLevel "Level of crankcase blowby emulsion collected by a container.";
CM_ SG_ 3221225472 EngVentilationStatus "Engine ventilation control states.";
CM_ SG_ 3221225472 EngOilPrimingState "Determination of whether or not the engine is (or has recently been) sufficiently lubricated for starting purposes.";
CM_ SG_ 3221225472 EngOilPrimingPumpSwitch "Switch input for activating the engine oil priming pump.";
CM_ SG_ 3221225472 EngOilPreHeatedState "Indicates whether the engine oil pre-heated sufficiently for starting purposes.";
CM_ SG_ 3221225472 EngOilFilterOutletPress "Oil pressure (gauge) measured just downstream of oil filter.";
CM_ SG_ 3221225472 EngCoolantPreheatedState "Indicates whether the engine coolant is pre-heated sufficiently for starting purposes.";
CM_ SG_ 3221225472 EngExhstGsRcrculationInletPress "EGR inlet gage pressure is measured after the EGR cooler and before the EGR valve.";
CM_ SG_ 3221225472 EngInjectorMeteringRail2Press "The gage pressure of fuel in the metering rail #2 as delivered from the supply pump to the injector metering inlet.";
CM_ SG_ 3221225472 EngInjectorTimingRail1Press "The gage pressure of fuel in the timing rail delivered from the supply pump to the injector timing inlet.";
CM_ SG_ 3221225472 EngInjectorMeteringRail1Press "The gage pressure of fuel in the primary, or first, metering rail as delivered from the supply pump to the injector metering inlet.";
CM_ SG_ 3221225472 EngInjectionCtrlPress "The gage pressure of the engine oil in the hydraulic accumulator that powers an intensifier used for fuel injection.";
CM_ SG_ 3221225472 TurningGearEngaged "Status signal which indicates that the turning gear is engaged.";
CM_ SG_ 3221225472 SafetyWireStatus "Status signal which indicates that the safety wire has been activated.";
CM_ SG_ 3221225472 ElectricalLoad "Electrical power delivered by the engine to the electrical system connected to the generator.";
CM_ SG_ 3221225472 EngVrblGometryTurbo1ActuatorPos "Sensor that measures the position of the variable geometry turbocharger actuator.";
CM_ SG_ 3221225472 EngVrblGmtryTrbArCtrlShtffValve "Isolates vehicle brake air from the Variable Geometry Turbocharger (VGT) system when engine is not running.";
CM_ SG_ 3221225472 EngExhstGsRcirculationValveCtrl "Desired percentage of maximum Exhaust Gas Recirculation (EGR) valve opening.";
CM_ SG_ 3221225472 EngTrb1ClcltedTurbineOutletTemp "Calculated value of turbocharger compressor outlet air temperature.";
CM_ SG_ 3221225472 EngRotationDirection "Direction of engine rotation, as reported by the engine.";
CM_ SG_ 3221225472 CrnkAttmptCntOnPrsntStrtAttempt "Reports the number of cranking cycles undergone during the present start attempt.";
CM_ SG_ 3221225472 EngRatedSpeed "The maximum governed rotational velocity of the engine crankshaft under full load conditions.";
CM_ SG_ 3221225472 EngRatedPower "Net brake power that the engine will deliver continuously, specified for a given application at a rated speed.";
CM_ SG_ 3221225472 EngMaxContinuousTorque "Applied limit for maximum continuous engine torque.";
CM_ SG_ 3221225472 EngHghLmtThrshhldFrMnCntnsTrqFrm "Maximum allowable value for minimum continuous torque.";
CM_ SG_ 3221225472 EngLwLmtThrshldFrMxTrqueFromEng "Minimum allowable value for maximum continuous torque.";
CM_ SG_ 3221225472 DiffLockStateCentralRear "State used which indicates the condition of the central rear differential lock.";
CM_ SG_ 3221225472 DiffLockStateCentralFront "State used which indicates the condition of the central front differential lock.";
CM_ SG_ 3221225472 DiffLockStateCentral "State used which indicates the condition of the central differential lock.";
CM_ SG_ 3221225472 DiffLockStateRearAxle2 "State used which indicates the condition of the rear axle 2 differential lock.";
CM_ SG_ 3221225472 DiffLockStateRearAxle1 "State used which indicates the condition of the rear axle 1 differential lock.";
CM_ SG_ 3221225472 DiffLockStateFrontAxle2 "State used which indicates the condition of the front axle 2 differential lock.";
CM_ SG_ 3221225472 DiffLockStateFrontAxle1 "State used which indicates the condition of the front axle 1 differential lock.";
CM_ SG_ 3221225472 Location "To identify to which of several similar devices (such as tires or fuel tanks) the information applies.";
CM_ SG_ 3221225472 SeaWaterPumpOutletPress "Gauge pressure of liquid found at outlet of sea water pump in sea water cooling system.";
CM_ SG_ 3221225472 EngAuxCoolantTemp "Temperature of coolant found in the intercooler which is located after the turbocharger.";
CM_ SG_ 3221225472 EngAuxCoolantPress "Gage pressure of coolant found in the intercooler which is located after the turbocharger.";
CM_ SG_ 3221225472 CargoAmbientTemp "Temperature of air inside vehicle container used to accommodate cargo.";
CM_ SG_ 3221225472 EngFuelFilterDiffPress "Differential pressure measured across the fuel filter located between the fuel tank and the supply pump.";
CM_ SG_ 3221225472 FuelLevel "Ratio of volume of fuel to the total volume of fuel storage container.";
CM_ SG_ 3221225472 WasherFluidLevel "Ratio of volume of liquid to total container volume of fluid reservoir in windshield wash system.";
CM_ SG_ 3221225472 EngStartEnableDevice2Config "The start enable device installed for start enable device 2.";
BA_DEF_ SG_  "SigType" ENUM  "Default","Range","RangeSigned","ASCII","Discrete","Control","ReferencePGN","DTC","StringDelimiter","StringLength","StringLengthControl";
BA_DEF_ SG_  "GenSigStartValue" INT 0 10000;
BA_DEF_ SG_  "GenSigSendType" ENUM  "Cyclic","OnWrite","reserved","OnChange","reserved","reserved","reserved","NoSigSendType";
BA_DEF_ SG_  "GenSigILSupport" ENUM  "Yes","No";
BA_DEF_ SG_  "GenSigEVName" STRING ;
BA_DEF_ SG_  "SPN" INT 0 524287;
BA_DEF_ BO_  "GenMsgILSupport" ENUM  "Yes","No";
BA_DEF_ BO_  "GenMsgRequestable" INT 0 1;
BA_DEF_ BO_  "GenMsgSendType" ENUM  "cyclic","reserved","cyclicIfActive","reserved","reserved","reserved","reserved","reserved","noMsgSendType";
BA_DEF_ BO_  "VFrameFormat" ENUM  "StandardCAN","ExtendedCAN","reserved","J1939PG";
BA_DEF_ BO_  "GenMsgCycleTime" INT 0 3600000;
BA_DEF_DEF_  "SigType" "Default";
BA_DEF_DEF_  "GenSigStartValue" 0;
BA_DEF_DEF_  "GenSigSendType" "NoSigSendType";
BA_DEF_DEF_  "GenSigILSupport" "Yes";
BA_DEF_DEF_  "GenSigEVName" "Env@Nodename_@Signame";
BA_DEF_DEF_  "SPN" 0;
BA_DEF_DEF_  "GenMsgILSupport" "Yes";
BA_DEF_DEF_  "GenMsgRequestable" 1;
BA_DEF_DEF_  "GenMsgSendType" "noMsgSendType";
BA_DEF_DEF_  "VFrameFormat" "J1939PG";
BA_DEF_DEF_  "GenMsgCycleTime" 0;
BA_ "SigType" SG_ 3221225472 TrailerWeight 1;
BA_ "SPN" SG_ 3221225472 TrailerWeight 180;
BA_ "SigType" SG_ 3221225472 AxleWeight 1;
BA_ "SPN" SG_ 3221225472 AxleWeight 582;
BA_ "SigType" SG_ 3221225472 AxleLocation 1;
BA_ "SPN" SG_ 3221225472 AxleLocation 2928;
BA_ "SigType" SG_ 3221225472 NetBatteryCurrentHiRes 1;
BA_ "SPN" SG_ 3221225472 NetBatteryCurrentHiRes 2579;
BA_ "SigType" SG_ 3221225472 AltCurrentHiRes 1;
BA_ "SPN" SG_ 3221225472 AltCurrentHiRes 1795;
BA_ "SigType" SG_ 3221225472 Battery2Potential 1;
BA_ "SPN" SG_ 3221225472 Battery2Potential 444;
BA_ "SigType" SG_ 3221225472 ECUPowerOutputSupplyVoltage3 1;
BA_ "SPN" SG_ 3221225472 ECUPowerOutputSupplyVoltage3 3599;
BA_ "SigType" SG_ 3221225472 ECUPowerOutputSupplyVoltage2 1;
BA_ "SPN" SG_ 3221225472 ECUPowerOutputSupplyVoltage2 3598;
BA_ "SigType" SG_ 3221225472 ECUPowerOutputSupplyVoltage1 1;
BA_ "SPN" SG_ 3221225472 ECUPowerOutputSupplyVoltage1 3597;
BA_ "SigType" SG_ 3221225472 BatteryPotential_PowerInput2 1;
BA_ "SPN" SG_ 3221225472 BatteryPotential_PowerInput2 444;
BA_ "SigType" SG_ 3221225472 Longitude 1;
BA_ "SPN" SG_ 3221225472 Longitude 585;
BA_ "SigType" SG_ 3221225472 Latitude 1;
BA_ "SPN" SG_ 3221225472 Latitude 584;
BA_ "SigType" SG_ 3221225472 TotalPowerTakeoffHours 1;
BA_ "SPN" SG_ 3221225472 TotalPowerTakeoffHours 248;
BA_ "SigType" SG_ 3221225472 TotalVehicleHours 1;
BA_ "SPN" SG_ 3221225472 TotalVehicleHours 246;
BA_ "SigType" SG_ 3221225472 WinchOilPressSwitch 4;
BA_ "SPN" SG_ 3221225472 WinchOilPressSwitch 1857;
BA_ "SigType" SG_ 3221225472 HydOilLevel 1;
BA_ "SPN" SG_ 3221225472 HydOilLevel 2602;
BA_ "SigType" SG_ 3221225472 HydOilFilterRestrictionSwitch 4;
BA_ "SPN" SG_ 3221225472 HydOilFilterRestrictionSwitch 1713;
BA_ "SigType" SG_ 3221225472 HydTemp 1;
BA_ "SPN" SG_ 3221225472 HydTemp 1638;
BA_ "SigType" SG_ 3221225472 Altitude 1;
BA_ "SPN" SG_ 3221225472 Altitude 580;
BA_ "SigType" SG_ 3221225472 Pitch 1;
BA_ "SPN" SG_ 3221225472 Pitch 583;
BA_ "SigType" SG_ 3221225472 NavigationBasedVehicleSpeed 1;
BA_ "SPN" SG_ 3221225472 NavigationBasedVehicleSpeed 517;
BA_ "SigType" SG_ 3221225472 CompassBearing 1;
BA_ "SPN" SG_ 3221225472 CompassBearing 165;
BA_ "SigType" SG_ 3221225472 TripCruiseDistance 1;
BA_ "SPN" SG_ 3221225472 TripCruiseDistance 1019;
BA_ "SigType" SG_ 3221225472 TripMaxVehicleSpeed 1;
BA_ "SPN" SG_ 3221225472 TripMaxVehicleSpeed 1018;
BA_ "SigType" SG_ 3221225472 TripAirCompressorOnTime 1;
BA_ "SPN" SG_ 3221225472 TripAirCompressorOnTime 1038;
BA_ "SigType" SG_ 3221225472 TripIdleTime 1;
BA_ "SPN" SG_ 3221225472 TripIdleTime 1037;
BA_ "SigType" SG_ 3221225472 TripEngRunningTime 1;
BA_ "SPN" SG_ 3221225472 TripEngRunningTime 1036;
BA_ "SigType" SG_ 3221225472 TripPTOTime 1;
BA_ "SPN" SG_ 3221225472 TripPTOTime 1035;
BA_ "SigType" SG_ 3221225472 TripCruiseTime 1;
BA_ "SPN" SG_ 3221225472 TripCruiseTime 1034;
BA_ "SigType" SG_ 3221225472 TripTimeInDerateByEng 1;
BA_ "SPN" SG_ 3221225472 TripTimeInDerateByEng 1027;
BA_ "SigType" SG_ 3221225472 TripTimeInGearDown 1;
BA_ "SPN" SG_ 3221225472 TripTimeInGearDown 1026;
BA_ "SigType" SG_ 3221225472 TripTimeInTopGear 1;
BA_ "SPN" SG_ 3221225472 TripTimeInTopGear 1025;
BA_ "SigType" SG_ 3221225472 TripTimeInVSL 1;
BA_ "SPN" SG_ 3221225472 TripTimeInVSL 1024;
BA_ "SigType" SG_ 3221225472 TripSuddenDecelerations 1;
BA_ "SPN" SG_ 3221225472 TripSuddenDecelerations 1023;
BA_ "SigType" SG_ 3221225472 TrpNmberOfIdleShutdownOverrides 1;
BA_ "SPN" SG_ 3221225472 TrpNmberOfIdleShutdownOverrides 1022;
BA_ "SigType" SG_ 3221225472 TripNumberOfIdleShutdowns 1;
BA_ "SPN" SG_ 3221225472 TripNumberOfIdleShutdowns 1021;
BA_ "SigType" SG_ 3221225472 TripNumberOfHotShutdowns 1;
BA_ "SPN" SG_ 3221225472 TripNumberOfHotShutdowns 1020;
BA_ "SigType" SG_ 3221225472 TransitRunStatus 4;
BA_ "SPN" SG_ 3221225472 TransitRunStatus 3046;
BA_ "SigType" SG_ 3221225472 VehicleUseStatus 4;
BA_ "SPN" SG_ 3221225472 VehicleUseStatus 3045;
BA_ "SigType" SG_ 3221225472 SilentAlarmStatus 4;
BA_ "SPN" SG_ 3221225472 SilentAlarmStatus 3044;
BA_ "SigType" SG_ 3221225472 PatronCount 1;
BA_ "SPN" SG_ 3221225472 PatronCount 3047;
BA_ "SigType" SG_ 3221225472 TypeOfPassengerCount 1;
BA_ "SPN" SG_ 3221225472 TypeOfPassengerCount 3043;
BA_ "SPN" SG_ 3221225472 FareboxAlarmIdentifier 3181;
BA_ "SigType" SG_ 3221225472 FareboxEmergencyStatus 4;
BA_ "SPN" SG_ 3221225472 FareboxEmergencyStatus 3179;
BA_ "SigType" SG_ 3221225472 TransferSold 1;
BA_ "SPN" SG_ 3221225472 TransferSold 3168;
BA_ "SigType" SG_ 3221225472 RouteNumber 1;
BA_ "SPN" SG_ 3221225472 RouteNumber 3169;
BA_ "SPN" SG_ 3221225472 TransferType 3173;
BA_ "SPN" SG_ 3221225472 TypeOfService 3172;
BA_ "SPN" SG_ 3221225472 InitialFareAgency 3167;
BA_ "SPN" SG_ 3221225472 PassCategory 3166;
BA_ "SPN" SG_ 3221225472 FareValidity 3165;
BA_ "SPN" SG_ 3221225472 PaymentDetails 3177;
BA_ "SPN" SG_ 3221225472 TypeOfFare 3176;
BA_ "SPN" SG_ 3221225472 PassengerType 3171;
BA_ "SPN" SG_ 3221225472 TransactionType 3170;
BA_ "SigType" SG_ 3221225472 DriversFareboxSecurityCode 1;
BA_ "SPN" SG_ 3221225472 DriversFareboxSecurityCode 3164;
BA_ "SigType" SG_ 3221225472 AssignedBlock 1;
BA_ "SPN" SG_ 3221225472 AssignedBlock 3163;
BA_ "SigType" SG_ 3221225472 AssignedRun 1;
BA_ "SPN" SG_ 3221225472 AssignedRun 3162;
BA_ "SigType" SG_ 3221225472 AssignedRoute 1;
BA_ "SPN" SG_ 3221225472 AssignedRoute 3160;
BA_ "SigType" SG_ 3221225472 PatternNumber 1;
BA_ "SPN" SG_ 3221225472 PatternNumber 3161;
BA_ "SigType" SG_ 3221225472 TripNumber 1;
BA_ "SPN" SG_ 3221225472 TripNumber 3159;
BA_ "SigType" SG_ 3221225472 FarePresets 1;
BA_ "SPN" SG_ 3221225472 FarePresets 3175;
BA_ "SPN" SG_ 3221225472 TripDirection 3174;
BA_ "SPN" SG_ 3221225472 TripStatus 3180;
BA_ "SigType" SG_ 3221225472 FareboxServiceStatus 4;
BA_ "SPN" SG_ 3221225472 FareboxServiceStatus 3178;
BA_ "SigType" SG_ 3221225472 VehicleID 1;
BA_ "SPN" SG_ 3221225472 VehicleID 3085;
BA_ "SigType" SG_ 3221225472 StrobeActivationCtrlStatus 4;
BA_ "SPN" SG_ 3221225472 StrobeActivationCtrlStatus 3082;
BA_ "SigType" SG_ 3221225472 TransitDoorEnable 4;
BA_ "SPN" SG_ 3221225472 TransitDoorEnable 3083;
BA_ "SPN" SG_ 3221225472 PriorityOfRespSentByEmitter 3084;
BA_ "SigType" SG_ 3221225472 IntersectionPreemptionRq_Resp 4;
BA_ "SPN" SG_ 3221225472 IntersectionPreemptionRq_Resp 3079;
BA_ "SigType" SG_ 3221225472 TransitRouteIDUsage 4;
BA_ "SPN" SG_ 3221225472 TransitRouteIDUsage 3080;
BA_ "SigType" SG_ 3221225472 RangeCodeEnable 4;
BA_ "SPN" SG_ 3221225472 RangeCodeEnable 3081;
BA_ "SigType" SG_ 3221225472 NmbrOfBytsInMlpstIdentification 1;
BA_ "SPN" SG_ 3221225472 NmbrOfBytsInMlpstIdentification 3070;
BA_ "SigType" SG_ 3221225472 Agency 1;
BA_ "SPN" SG_ 3221225472 Agency 3078;
BA_ "SigType" SG_ 3221225472 NmbrOfBytsInTrnstAssgndBlckIdntt 1;
BA_ "SPN" SG_ 3221225472 NmbrOfBytsInTrnstAssgndBlckIdntt 3073;
BA_ "SigType" SG_ 3221225472 NmbrOfBytsInTrnstAssgndRnIdntty 1;
BA_ "SPN" SG_ 3221225472 NmbrOfBytsInTrnstAssgndRnIdntty 3072;
BA_ "SigType" SG_ 3221225472 NmbrOfBytsInTrnstAssgndRtIdntty 1;
BA_ "SPN" SG_ 3221225472 NmbrOfBytsInTrnstAssgndRtIdntty 3071;
BA_ "SigType" SG_ 3221225472 ReferenceTirePressSetting 1;
BA_ "SPN" SG_ 3221225472 ReferenceTirePressSetting 3193;
BA_ "SigType" SG_ 3221225472 TireLocation 1;
BA_ "SPN" SG_ 3221225472 TireLocation 929;
BA_ "SigType" SG_ 3221225472 ReferenceTirePress 1;
BA_ "SPN" SG_ 3221225472 ReferenceTirePress 3191;
BA_ "SigType" SG_ 3221225472 SteerChannelTirePress 1;
BA_ "SPN" SG_ 3221225472 SteerChannelTirePress 146;
BA_ "SigType" SG_ 3221225472 DriveChannelTirePress 1;
BA_ "SPN" SG_ 3221225472 DriveChannelTirePress 145;
BA_ "SigType" SG_ 3221225472 TrailerTagPushChannelTirePress 1;
BA_ "SPN" SG_ 3221225472 TrailerTagPushChannelTirePress 144;
BA_ "SigType" SG_ 3221225472 SteerChannelTirePressTarget 1;
BA_ "SPN" SG_ 3221225472 SteerChannelTirePressTarget 143;
BA_ "SigType" SG_ 3221225472 DriveChannelTirePressTarget 1;
BA_ "SPN" SG_ 3221225472 DriveChannelTirePressTarget 142;
BA_ "SigType" SG_ 3221225472 TrlrTgPshChannelTirePressTarget 1;
BA_ "SPN" SG_ 3221225472 TrlrTgPshChannelTirePressTarget 141;
BA_ "SigType" SG_ 3221225472 PCUSupplySolenoidStatus 4;
BA_ "SPN" SG_ 3221225472 PCUSupplySolenoidStatus 1474;
BA_ "SigType" SG_ 3221225472 PCUCtrlSolenoidStatus 4;
BA_ "SPN" SG_ 3221225472 PCUCtrlSolenoidStatus 1473;
BA_ "SigType" SG_ 3221225472 PCUDeflateSolenoidStatus 4;
BA_ "SPN" SG_ 3221225472 PCUDeflateSolenoidStatus 1472;
BA_ "SigType" SG_ 3221225472 TirePressSupplySwitchStatus 4;
BA_ "SPN" SG_ 3221225472 TirePressSupplySwitchStatus 1471;
BA_ "SigType" SG_ 3221225472 PCUSteerSolenoidStatus 4;
BA_ "SPN" SG_ 3221225472 PCUSteerSolenoidStatus 1470;
BA_ "SigType" SG_ 3221225472 PCUDriveSolenoidStatus 4;
BA_ "SPN" SG_ 3221225472 PCUDriveSolenoidStatus 1469;
BA_ "SPN" SG_ 3221225472 DriveChannelMode 1468;
BA_ "SPN" SG_ 3221225472 Trailer_TagChannelMode 1467;
BA_ "SPN" SG_ 3221225472 SteerChannelMode 1466;
BA_ "SigType" SG_ 3221225472 TirePressCheckInterval 1;
BA_ "SPN" SG_ 3221225472 TirePressCheckInterval 39;
BA_ "SigType" SG_ 3221225472 PCUTrailerTagPushSolenoidStatus 4;
BA_ "SPN" SG_ 3221225472 PCUTrailerTagPushSolenoidStatus 1475;
BA_ "SPN" SG_ 3221225472 TirePressThresholdDetection 2587;
BA_ "SigType" SG_ 3221225472 TireAirLeakageRate 1;
BA_ "SPN" SG_ 3221225472 TireAirLeakageRate 2586;
BA_ "SigType" SG_ 3221225472 CTIWheelEndElectricalFault 4;
BA_ "SPN" SG_ 3221225472 CTIWheelEndElectricalFault 1697;
BA_ "SigType" SG_ 3221225472 CTITireStatus 4;
BA_ "SPN" SG_ 3221225472 CTITireStatus 1698;
BA_ "SigType" SG_ 3221225472 CTIWheelSensorStatus 4;
BA_ "SPN" SG_ 3221225472 CTIWheelSensorStatus 1699;
BA_ "SigType" SG_ 3221225472 TireTemp 1;
BA_ "SPN" SG_ 3221225472 TireTemp 242;
BA_ "SigType" SG_ 3221225472 TirePress 1;
BA_ "SPN" SG_ 3221225472 TirePress 241;
BA_ "SigType" SG_ 3221225472 CatalystTankTemp 1;
BA_ "SPN" SG_ 3221225472 CatalystTankTemp 3031;
BA_ "SigType" SG_ 3221225472 CatalystTankLevel 1;
BA_ "SPN" SG_ 3221225472 CatalystTankLevel 1761;
BA_ "SPN" SG_ 3221225472 CatalystTankLevelPreliminaryFMI 3532;
BA_ "SigType" SG_ 3221225472 CatalystTankLevel2 1;
BA_ "SPN" SG_ 3221225472 CatalystTankLevel2 3517;
BA_ "SigType" SG_ 3221225472 TripFanOnTimeDueToAManualSwitch 1;
BA_ "SPN" SG_ 3221225472 TripFanOnTimeDueToAManualSwitch 996;
BA_ "SigType" SG_ 3221225472 TripFanOnTime 1;
BA_ "SPN" SG_ 3221225472 TripFanOnTime 994;
BA_ "SigType" SG_ 3221225472 TripFanOnTimeDueToA_CSystem 1;
BA_ "SPN" SG_ 3221225472 TripFanOnTimeDueToA_CSystem 997;
BA_ "SigType" SG_ 3221225472 TripFanOnTimeDueToEngSystem 1;
BA_ "SPN" SG_ 3221225472 TripFanOnTimeDueToEngSystem 995;
BA_ "SigType" SG_ 3221225472 TripDistanceInTopGear 1;
BA_ "SPN" SG_ 3221225472 TripDistanceInTopGear 1000;
BA_ "SigType" SG_ 3221225472 TripGearDownDistance 1;
BA_ "SPN" SG_ 3221225472 TripGearDownDistance 999;
BA_ "SigType" SG_ 3221225472 TripDistanceOnVSL 1;
BA_ "SPN" SG_ 3221225472 TripDistanceOnVSL 998;
BA_ "SigType" SG_ 3221225472 AdjustLocalHourOffset 1;
BA_ "SPN" SG_ 3221225472 AdjustLocalHourOffset 1610;
BA_ "SigType" SG_ 3221225472 AdjustLocalMinuteOffset 1;
BA_ "SPN" SG_ 3221225472 AdjustLocalMinuteOffset 1609;
BA_ "SigType" SG_ 3221225472 AdjustYear 1;
BA_ "SPN" SG_ 3221225472 AdjustYear 1608;
BA_ "SigType" SG_ 3221225472 AdjustDay 1;
BA_ "SPN" SG_ 3221225472 AdjustDay 1607;
BA_ "SigType" SG_ 3221225472 AdjustMonth 1;
BA_ "SPN" SG_ 3221225472 AdjustMonth 1606;
BA_ "SigType" SG_ 3221225472 AdjustHours 1;
BA_ "SPN" SG_ 3221225472 AdjustHours 1605;
BA_ "SigType" SG_ 3221225472 AdjustMinutes 1;
BA_ "SPN" SG_ 3221225472 AdjustMinutes 1604;
BA_ "SigType" SG_ 3221225472 AdjustSeconds 1;
BA_ "SPN" SG_ 3221225472 AdjustSeconds 1603;
BA_ "SigType" SG_ 3221225472 LocalHourOffset 1;
BA_ "SPN" SG_ 3221225472 LocalHourOffset 1602;
BA_ "SigType" SG_ 3221225472 LocalMinuteOffset 1;
BA_ "SPN" SG_ 3221225472 LocalMinuteOffset 1601;
BA_ "SigType" SG_ 3221225472 Year 1;
BA_ "SPN" SG_ 3221225472 Year 964;
BA_ "SigType" SG_ 3221225472 Day 1;
BA_ "SPN" SG_ 3221225472 Day 962;
BA_ "SigType" SG_ 3221225472 Month 1;
BA_ "SPN" SG_ 3221225472 Month 963;
BA_ "SigType" SG_ 3221225472 Hours 1;
BA_ "SPN" SG_ 3221225472 Hours 961;
BA_ "SigType" SG_ 3221225472 Minutes 1;
BA_ "SPN" SG_ 3221225472 Minutes 960;
BA_ "SigType" SG_ 3221225472 Seconds 1;
BA_ "SPN" SG_ 3221225472 Seconds 959;
BA_ "SigType" SG_ 3221225472 EngTrbWstgtActuatorCtrlAirPress 1;
BA_ "SPN" SG_ 3221225472 EngTrbWstgtActuatorCtrlAirPress 1192;
BA_ "SigType" SG_ 3221225472 EngTurbo4WastegateDrive 1;
BA_ "SPN" SG_ 3221225472 EngTurbo4WastegateDrive 1191;
BA_ "SigType" SG_ 3221225472 EngTurbo3WastegateDrive 1;
BA_ "SPN" SG_ 3221225472 EngTurbo3WastegateDrive 1190;
BA_ "SigType" SG_ 3221225472 EngTurbo2WastegateDrive 1;
BA_ "SPN" SG_ 3221225472 EngTurbo2WastegateDrive 1189;
BA_ "SigType" SG_ 3221225472 EngTurbo1WastegateDrive 1;
BA_ "SPN" SG_ 3221225472 EngTurbo1WastegateDrive 1188;
BA_ "SigType" SG_ 3221225472 TachographVehicleSpeed 1;
BA_ "SPN" SG_ 3221225472 TachographVehicleSpeed 1624;
BA_ "SigType" SG_ 3221225472 TachographOutputShaftSpeed 1;
BA_ "SPN" SG_ 3221225472 TachographOutputShaftSpeed 1623;
BA_ "SigType" SG_ 3221225472 DirectionIndicator 4;
BA_ "SPN" SG_ 3221225472 DirectionIndicator 1619;
BA_ "SigType" SG_ 3221225472 TachographPerformance 4;
BA_ "SPN" SG_ 3221225472 TachographPerformance 1620;
BA_ "SigType" SG_ 3221225472 HandlingInformation 4;
BA_ "SPN" SG_ 3221225472 HandlingInformation 1621;
BA_ "SigType" SG_ 3221225472 SystemEvent 4;
BA_ "SPN" SG_ 3221225472 SystemEvent 1622;
BA_ "SigType" SG_ 3221225472 DriverCardDriver2 4;
BA_ "SPN" SG_ 3221225472 DriverCardDriver2 1616;
BA_ "SPN" SG_ 3221225472 Driver2TimeRelatedStates 1618;
BA_ "SigType" SG_ 3221225472 Overspeed 4;
BA_ "SPN" SG_ 3221225472 Overspeed 1614;
BA_ "SigType" SG_ 3221225472 DriverCardDriver1 4;
BA_ "SPN" SG_ 3221225472 DriverCardDriver1 1615;
BA_ "SPN" SG_ 3221225472 Driver1TimeRelatedStates 1617;
BA_ "SigType" SG_ 3221225472 DriveRecognize 4;
BA_ "SPN" SG_ 3221225472 DriveRecognize 1611;
BA_ "SPN" SG_ 3221225472 Driver2WorkingState 1613;
BA_ "SPN" SG_ 3221225472 Driver1WorkingState 1612;
BA_ "SigType" SG_ 3221225472 EngTurbo4CompressorOutletTemp 1;
BA_ "SPN" SG_ 3221225472 EngTurbo4CompressorOutletTemp 2801;
BA_ "SigType" SG_ 3221225472 EngTurbo3CompressorOutletTemp 1;
BA_ "SPN" SG_ 3221225472 EngTurbo3CompressorOutletTemp 2800;
BA_ "SigType" SG_ 3221225472 EngTurbo2CompressorOutletTemp 1;
BA_ "SPN" SG_ 3221225472 EngTurbo2CompressorOutletTemp 2799;
BA_ "SigType" SG_ 3221225472 EngTurbo1CompressorOutletTemp 1;
BA_ "SPN" SG_ 3221225472 EngTurbo1CompressorOutletTemp 2629;
BA_ "SigType" SG_ 3221225472 EngTurbo4TurbineOutletTemp 1;
BA_ "SPN" SG_ 3221225472 EngTurbo4TurbineOutletTemp 1187;
BA_ "SigType" SG_ 3221225472 EngTurbo3TurbineOutletTemp 1;
BA_ "SPN" SG_ 3221225472 EngTurbo3TurbineOutletTemp 1186;
BA_ "SigType" SG_ 3221225472 EngTurbo2TurbineOutletTemp 1;
BA_ "SPN" SG_ 3221225472 EngTurbo2TurbineOutletTemp 1185;
BA_ "SigType" SG_ 3221225472 EngTurbo1TurbineOutletTemp 1;
BA_ "SPN" SG_ 3221225472 EngTurbo1TurbineOutletTemp 1184;
BA_ "SigType" SG_ 3221225472 EngTurbo4TurbineInletTemp 1;
BA_ "SPN" SG_ 3221225472 EngTurbo4TurbineInletTemp 1183;
BA_ "SigType" SG_ 3221225472 EngTurbo3TurbineInletTemp 1;
BA_ "SPN" SG_ 3221225472 EngTurbo3TurbineInletTemp 1182;
BA_ "SigType" SG_ 3221225472 EngTurbo2TurbineInletTemp 1;
BA_ "SPN" SG_ 3221225472 EngTurbo2TurbineInletTemp 1181;
BA_ "SigType" SG_ 3221225472 EngTurbo1TurbineInletTemp 1;
BA_ "SPN" SG_ 3221225472 EngTurbo1TurbineInletTemp 1180;
BA_ "SigType" SG_ 3221225472 EngTurbo4CompressorInletPress 1;
BA_ "SPN" SG_ 3221225472 EngTurbo4CompressorInletPress 1179;
BA_ "SigType" SG_ 3221225472 EngTurbo3CompressorInletPress 1;
BA_ "SPN" SG_ 3221225472 EngTurbo3CompressorInletPress 1178;
BA_ "SigType" SG_ 3221225472 EngTurbo2CompressorInletPress 1;
BA_ "SPN" SG_ 3221225472 EngTurbo2CompressorInletPress 1177;
BA_ "SigType" SG_ 3221225472 EngTurbo1CompressorInletPress 1;
BA_ "SPN" SG_ 3221225472 EngTurbo1CompressorInletPress 1176;
BA_ "SigType" SG_ 3221225472 EngTurbo4CompressorInletTemp 1;
BA_ "SPN" SG_ 3221225472 EngTurbo4CompressorInletTemp 1175;
BA_ "SigType" SG_ 3221225472 EngTurbo3CompressorInletTemp 1;
BA_ "SPN" SG_ 3221225472 EngTurbo3CompressorInletTemp 1174;
BA_ "SigType" SG_ 3221225472 EngTurbo2CompressorInletTemp 1;
BA_ "SPN" SG_ 3221225472 EngTurbo2CompressorInletTemp 1173;
BA_ "SigType" SG_ 3221225472 EngTurbo1CompressorInletTemp 1;
BA_ "SPN" SG_ 3221225472 EngTurbo1CompressorInletTemp 1172;
BA_ "SigType" SG_ 3221225472 EngTurbo4Speed 1;
BA_ "SPN" SG_ 3221225472 EngTurbo4Speed 1171;
BA_ "SigType" SG_ 3221225472 EngTurbo3Speed 1;
BA_ "SPN" SG_ 3221225472 EngTurbo3Speed 1170;
BA_ "SigType" SG_ 3221225472 EngTurbo2Speed 1;
BA_ "SPN" SG_ 3221225472 EngTurbo2Speed 1169;
BA_ "SigType" SG_ 3221225472 EngTurboLubeOilPress2 1;
BA_ "SPN" SG_ 3221225472 EngTurboLubeOilPress2 1168;
BA_ "SigType" SG_ 3221225472 TransTorqueLimit 1;
BA_ "SPN" SG_ 3221225472 TransTorqueLimit 1845;
BA_ "SigType" SG_ 3221225472 TransGearRatio 1;
BA_ "SPN" SG_ 3221225472 TransGearRatio 581;
BA_ "SigType" SG_ 3221225472 NumberOfForwardGearRatios 1;
BA_ "SPN" SG_ 3221225472 NumberOfForwardGearRatios 957;
BA_ "SigType" SG_ 3221225472 NumberOfReverseGearRatios 1;
BA_ "SPN" SG_ 3221225472 NumberOfReverseGearRatios 958;
BA_ "SigType" SG_ 3221225472 TrnsShftSlctorDisplayModeSwitch 4;
BA_ "SPN" SG_ 3221225472 TrnsShftSlctorDisplayModeSwitch 2985;
BA_ "SigType" SG_ 3221225472 TransMode4 4;
BA_ "SPN" SG_ 3221225472 TransMode4 1855;
BA_ "SigType" SG_ 3221225472 TransMode3 4;
BA_ "SPN" SG_ 3221225472 TransMode3 1854;
BA_ "SigType" SG_ 3221225472 TransMode2 4;
BA_ "SPN" SG_ 3221225472 TransMode2 1853;
BA_ "SigType" SG_ 3221225472 TransMode1 4;
BA_ "SPN" SG_ 3221225472 TransMode1 1852;
BA_ "SigType" SG_ 3221225472 DisengageDiffLockRqCentralRear 4;
BA_ "SPN" SG_ 3221225472 DisengageDiffLockRqCentralRear 691;
BA_ "SigType" SG_ 3221225472 DisengageDiffLockRqCentralFront 4;
BA_ "SPN" SG_ 3221225472 DisengageDiffLockRqCentralFront 690;
BA_ "SigType" SG_ 3221225472 DisengageDiffLockRqCentral 4;
BA_ "SPN" SG_ 3221225472 DisengageDiffLockRqCentral 689;
BA_ "SigType" SG_ 3221225472 DisengageDiffLockRqRearAxle2 4;
BA_ "SPN" SG_ 3221225472 DisengageDiffLockRqRearAxle2 688;
BA_ "SigType" SG_ 3221225472 DisengageDiffLockRqRearAxle1 4;
BA_ "SPN" SG_ 3221225472 DisengageDiffLockRqRearAxle1 687;
BA_ "SigType" SG_ 3221225472 DisengageDiffLockRqFrontAxle2 4;
BA_ "SPN" SG_ 3221225472 DisengageDiffLockRqFrontAxle2 686;
BA_ "SigType" SG_ 3221225472 DisengageDiffLockRqFrontAxle1 4;
BA_ "SPN" SG_ 3221225472 DisengageDiffLockRqFrontAxle1 685;
BA_ "SigType" SG_ 3221225472 TransRqedGear 1;
BA_ "SPN" SG_ 3221225472 TransRqedGear 525;
BA_ "SigType" SG_ 3221225472 RqedPercentClutchSlip 1;
BA_ "SPN" SG_ 3221225472 RqedPercentClutchSlip 684;
BA_ "SigType" SG_ 3221225472 DisengageDrivelineRq 4;
BA_ "SPN" SG_ 3221225472 DisengageDrivelineRq 683;
BA_ "SigType" SG_ 3221225472 TorqueConverterLockupDisableRq 4;
BA_ "SPN" SG_ 3221225472 TorqueConverterLockupDisableRq 682;
BA_ "SigType" SG_ 3221225472 TransGearShiftInhibitRq 4;
BA_ "SPN" SG_ 3221225472 TransGearShiftInhibitRq 681;
BA_ "SigType" SG_ 3221225472 EngTotalAverageFuelEconomy 1;
BA_ "SPN" SG_ 3221225472 EngTotalAverageFuelEconomy 1835;
BA_ "SigType" SG_ 3221225472 EngTotalAverageFuelRate 1;
BA_ "SPN" SG_ 3221225472 EngTotalAverageFuelRate 1834;
BA_ "SigType" SG_ 3221225472 AirSuspensionSupplyPressRq 1;
BA_ "SPN" SG_ 3221225472 AirSuspensionSupplyPressRq 2608;
BA_ "SigType" SG_ 3221225472 AuxEquipmentSupplyPressRq 1;
BA_ "SPN" SG_ 3221225472 AuxEquipmentSupplyPressRq 2607;
BA_ "SigType" SG_ 3221225472 ServiceBrakeAirPressRqCircuit2 1;
BA_ "SPN" SG_ 3221225472 ServiceBrakeAirPressRqCircuit2 2606;
BA_ "SigType" SG_ 3221225472 ServiceBrakeAirPressRqCircuit1 1;
BA_ "SPN" SG_ 3221225472 ServiceBrakeAirPressRqCircuit1 2605;
BA_ "SigType" SG_ 3221225472 ParkingAnd_OrTrailerAirPressRq 1;
BA_ "SPN" SG_ 3221225472 ParkingAnd_OrTrailerAirPressRq 2604;
BA_ "SigType" SG_ 3221225472 PneumaticSupplyPressRq 1;
BA_ "SPN" SG_ 3221225472 PneumaticSupplyPressRq 2603;
BA_ "SigType" SG_ 3221225472 EngExtlShutdownAirSupplyPress 1;
BA_ "SPN" SG_ 3221225472 EngExtlShutdownAirSupplyPress 1320;
BA_ "SigType" SG_ 3221225472 ServiceComponentIdentificationB 1;
BA_ "SPN" SG_ 3221225472 ServiceComponentIdentificationB 912;
BA_ "SigType" SG_ 3221225472 ServiceComponentIdentificationA 1;
BA_ "SPN" SG_ 3221225472 ServiceComponentIdentificationA 911;
BA_ "SigType" SG_ 3221225472 SrvceDelay_OperationalTimeBased 1;
BA_ "SPN" SG_ 3221225472 SrvceDelay_OperationalTimeBased 916;
BA_ "SigType" SG_ 3221225472 ServiceDelay_CalendarTimeBased 1;
BA_ "SPN" SG_ 3221225472 ServiceDelay_CalendarTimeBased 915;
BA_ "SigType" SG_ 3221225472 ServiceDistance 1;
BA_ "SPN" SG_ 3221225472 ServiceDistance 914;
BA_ "SigType" SG_ 3221225472 ServiceComponentIdentification 1;
BA_ "SPN" SG_ 3221225472 ServiceComponentIdentification 1584;
BA_ "SigType" SG_ 3221225472 TimeSinceLastService 1;
BA_ "SPN" SG_ 3221225472 TimeSinceLastService 1350;
BA_ "SigType" SG_ 3221225472 MaxContinuousRetarderTorque 1;
BA_ "SPN" SG_ 3221225472 MaxContinuousRetarderTorque 1782;
BA_ "SigType" SG_ 3221225472 MinContinuousRetarderSpeed 1;
BA_ "SPN" SG_ 3221225472 MinContinuousRetarderSpeed 1781;
BA_ "SigType" SG_ 3221225472 MaxContinuousRetarderSpeed 1;
BA_ "SPN" SG_ 3221225472 MaxContinuousRetarderSpeed 1780;
BA_ "SigType" SG_ 3221225472 HghLmtThrshhldFrMnCntnsTrqFrmRtr 1;
BA_ "SPN" SG_ 3221225472 HghLmtThrshhldFrMnCntnsTrqFrmRtr 1779;
BA_ "SigType" SG_ 3221225472 LwLmtThrshhldFrMxTrqFrmRetarder 1;
BA_ "SPN" SG_ 3221225472 LwLmtThrshhldFrMxTrqFrmRetarder 1778;
BA_ "SigType" SG_ 3221225472 HghLmtThrshhldFrMnCntnsRPMFrmRtr 1;
BA_ "SPN" SG_ 3221225472 HghLmtThrshhldFrMnCntnsRPMFrmRtr 1777;
BA_ "SigType" SG_ 3221225472 LwLmtThrshhldFrMxRPMFrmRetarder 1;
BA_ "SPN" SG_ 3221225472 LwLmtThrshhldFrMxRPMFrmRetarder 1776;
BA_ "SigType" SG_ 3221225472 MinContinuousRetarderTorque 1;
BA_ "SPN" SG_ 3221225472 MinContinuousRetarderTorque 1783;
BA_ "SigType" SG_ 3221225472 HydRetarderOilTemp 1;
BA_ "SPN" SG_ 3221225472 HydRetarderOilTemp 120;
BA_ "SigType" SG_ 3221225472 HydRetarderPress 1;
BA_ "SPN" SG_ 3221225472 HydRetarderPress 119;
BA_ "SigType" SG_ 3221225472 EngBuildHoursReset 4;
BA_ "SPN" SG_ 3221225472 EngBuildHoursReset 1211;
BA_ "SigType" SG_ 3221225472 TripGroup2Proprietary 4;
BA_ "SPN" SG_ 3221225472 TripGroup2Proprietary 989;
BA_ "SigType" SG_ 3221225472 TripGroup1 4;
BA_ "SPN" SG_ 3221225472 TripGroup1 988;
BA_ "SigType" SG_ 3221225472 PercentTorqueAtPeakTorquePoint5 1;
BA_ "SPN" SG_ 3221225472 PercentTorqueAtPeakTorquePoint5 555;
BA_ "SigType" SG_ 3221225472 RetarderSpeedAtPeakTorquePoint5 1;
BA_ "SPN" SG_ 3221225472 RetarderSpeedAtPeakTorquePoint5 547;
BA_ "SigType" SG_ 3221225472 PercentTorqueAtPoint4 1;
BA_ "SPN" SG_ 3221225472 PercentTorqueAtPoint4 554;
BA_ "SigType" SG_ 3221225472 RetarderSpeedAtPoint4 1;
BA_ "SPN" SG_ 3221225472 RetarderSpeedAtPoint4 550;
BA_ "SigType" SG_ 3221225472 PercentTorqueAtPoint3 1;
BA_ "SPN" SG_ 3221225472 PercentTorqueAtPoint3 553;
BA_ "SigType" SG_ 3221225472 RetarderSpeedAtPoint3 1;
BA_ "SPN" SG_ 3221225472 RetarderSpeedAtPoint3 549;
BA_ "SigType" SG_ 3221225472 PercentTorqueAtMaxSpeedPoint2 1;
BA_ "SPN" SG_ 3221225472 PercentTorqueAtMaxSpeedPoint2 552;
BA_ "SigType" SG_ 3221225472 MaxRetarderSpeedPoint2 1;
BA_ "SPN" SG_ 3221225472 MaxRetarderSpeedPoint2 548;
BA_ "SigType" SG_ 3221225472 PercentTorqueAtIdlePoint1 1;
BA_ "SPN" SG_ 3221225472 PercentTorqueAtIdlePoint1 551;
BA_ "SigType" SG_ 3221225472 RetarderSpeedAtIdlePoint1 1;
BA_ "SPN" SG_ 3221225472 RetarderSpeedAtIdlePoint1 546;
BA_ "SigType" SG_ 3221225472 RetarderCtrlMethod 1;
BA_ "SPN" SG_ 3221225472 RetarderCtrlMethod 557;
BA_ "SPN" SG_ 3221225472 RetarderLocation 902;
BA_ "SPN" SG_ 3221225472 RetarderType 901;
BA_ "SigType" SG_ 3221225472 EngOperationTimeSinceRebuild 1;
BA_ "SPN" SG_ 3221225472 EngOperationTimeSinceRebuild 1193;
BA_ "SPN" SG_ 3221225472 RearWasherFunction 2868;
BA_ "SPN" SG_ 3221225472 FrontOperatorWasherSwitch 2866;
BA_ "SPN" SG_ 3221225472 FrontNonoperatorWasherSwitch 2867;
BA_ "SigType" SG_ 3221225472 RearWiperDelayCtrl 1;
BA_ "SPN" SG_ 3221225472 RearWiperDelayCtrl 2871;
BA_ "SigType" SG_ 3221225472 FrontNonoperatorWiperDelayCtrl 1;
BA_ "SPN" SG_ 3221225472 FrontNonoperatorWiperDelayCtrl 2870;
BA_ "SigType" SG_ 3221225472 FrontOperatorWiperDelayCtrl 1;
BA_ "SPN" SG_ 3221225472 FrontOperatorWiperDelayCtrl 2869;
BA_ "SPN" SG_ 3221225472 RearWiperSwitch 2865;
BA_ "SPN" SG_ 3221225472 FrontOperatorWiperSwitch 2863;
BA_ "SPN" SG_ 3221225472 FrontNonoperatorWiperSwitch 2864;
BA_ "SPN" SG_ 3221225472 EngAltDroopAuxInputSelect 2885;
BA_ "SPN" SG_ 3221225472 EngAltDroopRemoteAccelSelect 2886;
BA_ "SPN" SG_ 3221225472 EngAltDroopAccel2Select 2879;
BA_ "SPN" SG_ 3221225472 EngAltDroopAccel1Select 2881;
BA_ "SigType" SG_ 3221225472 EngAltRatingSelect 1;
BA_ "SPN" SG_ 3221225472 EngAltRatingSelect 2882;
BA_ "SigType" SG_ 3221225472 EngAltLowIdleSwitch 4;
BA_ "SPN" SG_ 3221225472 EngAltLowIdleSwitch 2883;
BA_ "SigType" SG_ 3221225472 EngSynchronizationSwitch 4;
BA_ "SPN" SG_ 3221225472 EngSynchronizationSwitch 1377;
BA_ "SigType" SG_ 3221225472 EngAuxGovernorSwitch 4;
BA_ "SPN" SG_ 3221225472 EngAuxGovernorSwitch 2884;
BA_ "SPN" SG_ 3221225472 EngAltDroopAuxInputSelectState 2895;
BA_ "SPN" SG_ 3221225472 EngAltDrpRemoteAccelSelectState 2894;
BA_ "SPN" SG_ 3221225472 EngAltDroopAccel2SelectState 2893;
BA_ "SPN" SG_ 3221225472 EngAltDroopAccel1SelectState 2889;
BA_ "SigType" SG_ 3221225472 EngAltRatingSelectState 1;
BA_ "SPN" SG_ 3221225472 EngAltRatingSelectState 2888;
BA_ "SigType" SG_ 3221225472 EngAltLowIdleSelectState 4;
BA_ "SPN" SG_ 3221225472 EngAltLowIdleSelectState 2891;
BA_ "SigType" SG_ 3221225472 EngMultiUnitSyncState 4;
BA_ "SPN" SG_ 3221225472 EngMultiUnitSyncState 2890;
BA_ "SigType" SG_ 3221225472 EngAuxGovernorState 4;
BA_ "SPN" SG_ 3221225472 EngAuxGovernorState 2896;
BA_ "SigType" SG_ 3221225472 OprtrsDesiredDelayedLampOffTime 1;
BA_ "SPN" SG_ 3221225472 OprtrsDesiredDelayedLampOffTime 2877;
BA_ "SigType" SG_ 3221225472 OperatorsDesiredBacklight 1;
BA_ "SPN" SG_ 3221225472 OperatorsDesiredBacklight 2878;
BA_ "SigType" SG_ 3221225472 HighLowBeamSwitch 4;
BA_ "SPN" SG_ 3221225472 HighLowBeamSwitch 2874;
BA_ "SigType" SG_ 3221225472 HazardLightSwitch 4;
BA_ "SPN" SG_ 3221225472 HazardLightSwitch 2875;
BA_ "SPN" SG_ 3221225472 TurnSignalSwitch 2876;
BA_ "SPN" SG_ 3221225472 MainLightSwitch 2872;
BA_ "SPN" SG_ 3221225472 WorkLightSwitch 2873;
BA_ "SigType" SG_ 3221225472 AppliedVehicleSpeedLimit 1;
BA_ "SPN" SG_ 3221225472 AppliedVehicleSpeedLimit 2595;
BA_ "SigType" SG_ 3221225472 MaxVehicleSpeedLimit7 1;
BA_ "SPN" SG_ 3221225472 MaxVehicleSpeedLimit7 2594;
BA_ "SigType" SG_ 3221225472 MaxVehicleSpeedLimit6 1;
BA_ "SPN" SG_ 3221225472 MaxVehicleSpeedLimit6 2593;
BA_ "SigType" SG_ 3221225472 MaxVehicleSpeedLimit5 1;
BA_ "SPN" SG_ 3221225472 MaxVehicleSpeedLimit5 2592;
BA_ "SigType" SG_ 3221225472 MaxVehicleSpeedLimit4 1;
BA_ "SPN" SG_ 3221225472 MaxVehicleSpeedLimit4 2591;
BA_ "SigType" SG_ 3221225472 MaxVehicleSpeedLimit3 1;
BA_ "SPN" SG_ 3221225472 MaxVehicleSpeedLimit3 2590;
BA_ "SigType" SG_ 3221225472 MaxVehicleSpeedLimit2 1;
BA_ "SPN" SG_ 3221225472 MaxVehicleSpeedLimit2 2589;
BA_ "SigType" SG_ 3221225472 MaxVehicleSpeedLimit1 1;
BA_ "SPN" SG_ 3221225472 MaxVehicleSpeedLimit1 2588;
BA_ "SigType" SG_ 3221225472 OprtrsBlckOutIntensitySelection 1;
BA_ "SPN" SG_ 3221225472 OprtrsBlckOutIntensitySelection 1844;
BA_ "SigType" SG_ 3221225472 BlackOutWorkLampSelect 4;
BA_ "SPN" SG_ 3221225472 BlackOutWorkLampSelect 1842;
BA_ "SigType" SG_ 3221225472 NightVisionIlluminatorSelect 4;
BA_ "SPN" SG_ 3221225472 NightVisionIlluminatorSelect 1843;
BA_ "SigType" SG_ 3221225472 BlackOutBrake_StopLampSelect 4;
BA_ "SPN" SG_ 3221225472 BlackOutBrake_StopLampSelect 1841;
BA_ "SigType" SG_ 3221225472 ConvoyDrivingLampSelect 4;
BA_ "SPN" SG_ 3221225472 ConvoyDrivingLampSelect 1837;
BA_ "SigType" SG_ 3221225472 ConvoyLampSelect 4;
BA_ "SPN" SG_ 3221225472 ConvoyLampSelect 1838;
BA_ "SigType" SG_ 3221225472 FrontBlackOutMarkerLampSelect 4;
BA_ "SPN" SG_ 3221225472 FrontBlackOutMarkerLampSelect 1839;
BA_ "SigType" SG_ 3221225472 RearBlackOutMarkerSelect 4;
BA_ "SPN" SG_ 3221225472 RearBlackOutMarkerSelect 1840;
BA_ "SigType" SG_ 3221225472 SlowVesselModeStatus 4;
BA_ "SPN" SG_ 3221225472 SlowVesselModeStatus 2617;
BA_ "SigType" SG_ 3221225472 TrollingModeStatus 4;
BA_ "SPN" SG_ 3221225472 TrollingModeStatus 2616;
BA_ "SPN" SG_ 3221225472 EngThrttlSynchrnztionModeStatus 2615;
BA_ "SigType" SG_ 3221225472 EngMainBearing11Temp 1;
BA_ "SPN" SG_ 3221225472 EngMainBearing11Temp 1167;
BA_ "SigType" SG_ 3221225472 EngMainBearing10Temp 1;
BA_ "SPN" SG_ 3221225472 EngMainBearing10Temp 1166;
BA_ "SigType" SG_ 3221225472 EngMainBearing9Temp 1;
BA_ "SPN" SG_ 3221225472 EngMainBearing9Temp 1165;
BA_ "SigType" SG_ 3221225472 EngMainBearing8Temp 1;
BA_ "SPN" SG_ 3221225472 EngMainBearing8Temp 1164;
BA_ "SigType" SG_ 3221225472 EngMainBearing7Temp 1;
BA_ "SPN" SG_ 3221225472 EngMainBearing7Temp 1163;
BA_ "SigType" SG_ 3221225472 EngMainBearing6Temp 1;
BA_ "SPN" SG_ 3221225472 EngMainBearing6Temp 1162;
BA_ "SigType" SG_ 3221225472 EngMainBearing5Temp 1;
BA_ "SPN" SG_ 3221225472 EngMainBearing5Temp 1161;
BA_ "SigType" SG_ 3221225472 EngMainBearing4Temp 1;
BA_ "SPN" SG_ 3221225472 EngMainBearing4Temp 1160;
BA_ "SigType" SG_ 3221225472 EngMainBearing3Temp 1;
BA_ "SPN" SG_ 3221225472 EngMainBearing3Temp 1159;
BA_ "SigType" SG_ 3221225472 EngMainBearing2Temp 1;
BA_ "SPN" SG_ 3221225472 EngMainBearing2Temp 1158;
BA_ "SigType" SG_ 3221225472 EngMainBearing1Temp 1;
BA_ "SPN" SG_ 3221225472 EngMainBearing1Temp 1157;
BA_ "SPN" SG_ 3221225472 DisplayDeadbands 2577;
BA_ "SPN" SG_ 3221225472 LEDPatternCtrl 2578;
BA_ "SPN" SG_ 3221225472 LEDDisplayDeadbandCtrl 1806;
BA_ "SPN" SG_ 3221225472 LEDDisplayModeCtrl 1805;
BA_ "SigType" SG_ 3221225472 LEDDisplayData1 1;
BA_ "SPN" SG_ 3221225472 LEDDisplayData1 1573;
BA_ "SigType" SG_ 3221225472 AbsLaserStrikePosition 1;
BA_ "SPN" SG_ 3221225472 AbsLaserStrikePosition 2794;
BA_ "SigType" SG_ 3221225472 LaserStrikeDataLatency 1;
BA_ "SPN" SG_ 3221225472 LaserStrikeDataLatency 2793;
BA_ "SigType" SG_ 3221225472 LaserReceiverType 1;
BA_ "SPN" SG_ 3221225472 LaserReceiverType 2576;
BA_ "SigType" SG_ 3221225472 LaserStrikeVerticalDeviation 1;
BA_ "SPN" SG_ 3221225472 LaserStrikeVerticalDeviation 1574;
BA_ "SigType" SG_ 3221225472 LaserTracerInformation 1;
BA_ "SPN" SG_ 3221225472 LaserTracerInformation 1583;
BA_ "SigType" SG_ 3221225472 LEDDisplayData2 1;
BA_ "SPN" SG_ 3221225472 LEDDisplayData2 1582;
BA_ "SigType" SG_ 3221225472 LaserTracerHorizontalDeviation 1;
BA_ "SPN" SG_ 3221225472 LaserTracerHorizontalDeviation 1581;
BA_ "SigType" SG_ 3221225472 LaserTracerVerticalDistance 1;
BA_ "SPN" SG_ 3221225472 LaserTracerVerticalDistance 1580;
BA_ "SigType" SG_ 3221225472 LaserTracerTargetDeviation 1;
BA_ "SPN" SG_ 3221225472 LaserTracerTargetDeviation 1579;
BA_ "SigType" SG_ 3221225472 BldHeightSetPointHighResolution 1;
BA_ "SPN" SG_ 3221225472 BldHeightSetPointHighResolution 1759;
BA_ "SigType" SG_ 3221225472 ModifySetPoint 1;
BA_ "SPN" SG_ 3221225472 ModifySetPoint 1575;
BA_ "SPN" SG_ 3221225472 SdshftDsrdBldOffsetOperatorCtrl 3339;
BA_ "SPN" SG_ 3221225472 SdshftBldCtrlMdeOperatorControl 3338;
BA_ "SPN" SG_ 3221225472 RghtDsrdBladeOffsetOperatorCtrl 3337;
BA_ "SPN" SG_ 3221225472 RghtBldeCtrlModeOperatorControl 3335;
BA_ "SPN" SG_ 3221225472 LftDsredBladeOffsetOperatorCtrl 3336;
BA_ "SPN" SG_ 3221225472 LftBladeCtrlModeOperatorControl 3334;
BA_ "SPN" SG_ 3221225472 BladeAutoModeCmd 3158;
BA_ "SPN" SG_ 3221225472 DesiredGradeOffsetSwitch 3157;
BA_ "SPN" SG_ 3221225472 BladeCtrlModeSwitch 3156;
BA_ "SigType" SG_ 3221225472 MastPos 1;
BA_ "SPN" SG_ 3221225472 MastPos 1576;
BA_ "SigType" SG_ 3221225472 FrontWheelDriveActuatorStatus 4;
BA_ "SPN" SG_ 3221225472 FrontWheelDriveActuatorStatus 2612;
BA_ "SigType" SG_ 3221225472 FMSstandardSWversionSupported 1;
BA_ "SPN" SG_ 3221225472 FMSstandardSWversionSupported 2806;
BA_ "SigType" SG_ 3221225472 FMSstandardRqsSupported 4;
BA_ "SPN" SG_ 3221225472 FMSstandardRqsSupported 2805;
BA_ "SigType" SG_ 3221225472 FMSstandardDiagnosticsSupported 4;
BA_ "SPN" SG_ 3221225472 FMSstandardDiagnosticsSupported 2804;
BA_ "SigType" SG_ 3221225472 LnDprtureIndicationEnableStatus 4;
BA_ "SPN" SG_ 3221225472 LnDprtureIndicationEnableStatus 1702;
BA_ "SigType" SG_ 3221225472 LaneTrackingStatusLeftSide 4;
BA_ "SPN" SG_ 3221225472 LaneTrackingStatusLeftSide 1710;
BA_ "SigType" SG_ 3221225472 LaneTrackingStatusRightSide 4;
BA_ "SPN" SG_ 3221225472 LaneTrackingStatusRightSide 1711;
BA_ "SigType" SG_ 3221225472 LaneDepartureImminentLeftSide 4;
BA_ "SPN" SG_ 3221225472 LaneDepartureImminentLeftSide 1700;
BA_ "SigType" SG_ 3221225472 LaneDepartureImminentRightSide 4;
BA_ "SPN" SG_ 3221225472 LaneDepartureImminentRightSide 1701;
BA_ "SigType" SG_ 3221225472 EngFuelLeakage2 4;
BA_ "SPN" SG_ 3221225472 EngFuelLeakage2 1240;
BA_ "SigType" SG_ 3221225472 EngFuelLeakage1 4;
BA_ "SPN" SG_ 3221225472 EngFuelLeakage1 1239;
BA_ "SigType" SG_ 3221225472 EngTorqueLimit6AxleInput 1;
BA_ "SPN" SG_ 3221225472 EngTorqueLimit6AxleInput 1263;
BA_ "SigType" SG_ 3221225472 EngTorqueLimit5Switch 1;
BA_ "SPN" SG_ 3221225472 EngTorqueLimit5Switch 1262;
BA_ "SigType" SG_ 3221225472 EngTorqueLimit4Trans 1;
BA_ "SPN" SG_ 3221225472 EngTorqueLimit4Trans 1261;
BA_ "SigType" SG_ 3221225472 EngTorqueLimit3Trans 1;
BA_ "SPN" SG_ 3221225472 EngTorqueLimit3Trans 1260;
BA_ "SigType" SG_ 3221225472 TransGearRatio3 1;
BA_ "SPN" SG_ 3221225472 TransGearRatio3 1259;
BA_ "SigType" SG_ 3221225472 EngTorqueLimit2Trans 1;
BA_ "SPN" SG_ 3221225472 EngTorqueLimit2Trans 1258;
BA_ "SigType" SG_ 3221225472 TransGearRatio2 1;
BA_ "SPN" SG_ 3221225472 TransGearRatio2 1257;
BA_ "SigType" SG_ 3221225472 EngTorqueLimit1Trans 1;
BA_ "SPN" SG_ 3221225472 EngTorqueLimit1Trans 1256;
BA_ "SigType" SG_ 3221225472 TransGearRatio1 1;
BA_ "SPN" SG_ 3221225472 TransGearRatio1 1255;
BA_ "SPN" SG_ 3221225472 EngTorqueLimitFeature 1632;
BA_ "SigType" SG_ 3221225472 TorqueLimitingFeatureStatus 4;
BA_ "SPN" SG_ 3221225472 TorqueLimitingFeatureStatus 1254;
BA_ "SigType" SG_ 3221225472 CalibRecordDurationTime 1;
BA_ "SPN" SG_ 3221225472 CalibRecordDurationTime 1253;
BA_ "SigType" SG_ 3221225472 CalibRecordStartYear 1;
BA_ "SPN" SG_ 3221225472 CalibRecordStartYear 1252;
BA_ "SigType" SG_ 3221225472 CalibRecordStartDay 1;
BA_ "SPN" SG_ 3221225472 CalibRecordStartDay 1251;
BA_ "SigType" SG_ 3221225472 CalibRecordStartMonth 1;
BA_ "SPN" SG_ 3221225472 CalibRecordStartMonth 1250;
BA_ "SigType" SG_ 3221225472 EngPeakTorque2 1;
BA_ "SPN" SG_ 3221225472 EngPeakTorque2 1249;
BA_ "SigType" SG_ 3221225472 EngPeakTorque1 1;
BA_ "SPN" SG_ 3221225472 EngPeakTorque1 1248;
BA_ "SigType" SG_ 3221225472 EngPower 1;
BA_ "SPN" SG_ 3221225472 EngPower 1247;
BA_ "SigType" SG_ 3221225472 NumberOfEngTorqueHistoryRecords 1;
BA_ "SPN" SG_ 3221225472 NumberOfEngTorqueHistoryRecords 1246;
BA_ "SigType" SG_ 3221225472 TransTorqueConverterRatio 1;
BA_ "SPN" SG_ 3221225472 TransTorqueConverterRatio 3030;
BA_ "SigType" SG_ 3221225472 TransRqedGearFeedback 1;
BA_ "SPN" SG_ 3221225472 TransRqedGearFeedback 3289;
BA_ "SigType" SG_ 3221225472 TransMode1Indicator 4;
BA_ "SPN" SG_ 3221225472 TransMode1Indicator 2536;
BA_ "SigType" SG_ 3221225472 TransMode2Indicator 4;
BA_ "SPN" SG_ 3221225472 TransMode2Indicator 2537;
BA_ "SigType" SG_ 3221225472 TransMode3Indicator 4;
BA_ "SPN" SG_ 3221225472 TransMode3Indicator 2538;
BA_ "SigType" SG_ 3221225472 TransMode4Indicator 4;
BA_ "SPN" SG_ 3221225472 TransMode4Indicator 2539;
BA_ "SigType" SG_ 3221225472 TransShiftInhibitIndicator 4;
BA_ "SPN" SG_ 3221225472 TransShiftInhibitIndicator 1851;
BA_ "SigType" SG_ 3221225472 TransEngCrankEnable 4;
BA_ "SPN" SG_ 3221225472 TransEngCrankEnable 2900;
BA_ "SigType" SG_ 3221225472 ActiveShiftConsoleIndicator 4;
BA_ "SPN" SG_ 3221225472 ActiveShiftConsoleIndicator 2945;
BA_ "SigType" SG_ 3221225472 TransReadyForBrakeRelease 4;
BA_ "SPN" SG_ 3221225472 TransReadyForBrakeRelease 3086;
BA_ "SigType" SG_ 3221225472 TransRqedRangeDisplayFlashState 4;
BA_ "SPN" SG_ 3221225472 TransRqedRangeDisplayFlashState 1849;
BA_ "SigType" SG_ 3221225472 TransRqedRangeDisplayBlankState 4;
BA_ "SPN" SG_ 3221225472 TransRqedRangeDisplayBlankState 1850;
BA_ "SigType" SG_ 3221225472 TransServiceIndicator 4;
BA_ "SPN" SG_ 3221225472 TransServiceIndicator 4178;
BA_ "SigType" SG_ 3221225472 TransCurrRangeDisplayBlankState 4;
BA_ "SPN" SG_ 3221225472 TransCurrRangeDisplayBlankState 4176;
BA_ "SigType" SG_ 3221225472 ClutchLifeRemaining 1;
BA_ "SPN" SG_ 3221225472 ClutchLifeRemaining 2983;
BA_ "SigType" SG_ 3221225472 LowestPossibleGear 1;
BA_ "SPN" SG_ 3221225472 LowestPossibleGear 1114;
BA_ "SigType" SG_ 3221225472 HighestPossibleGear 1;
BA_ "SPN" SG_ 3221225472 HighestPossibleGear 1115;
BA_ "SigType" SG_ 3221225472 RecommendedGear 1;
BA_ "SPN" SG_ 3221225472 RecommendedGear 1113;
BA_ "SigType" SG_ 3221225472 TransForwardDirectionSwitch 4;
BA_ "SPN" SG_ 3221225472 TransForwardDirectionSwitch 903;
BA_ "SigType" SG_ 3221225472 TransNeutralSwitch 4;
BA_ "SPN" SG_ 3221225472 TransNeutralSwitch 604;
BA_ "SigType" SG_ 3221225472 TransReverseDirectionSwitch 4;
BA_ "SPN" SG_ 3221225472 TransReverseDirectionSwitch 767;
BA_ "SigType" SG_ 3221225472 TransLowRangeSenseSwitch 4;
BA_ "SPN" SG_ 3221225472 TransLowRangeSenseSwitch 779;
BA_ "SigType" SG_ 3221225472 TransHighRangeSenseSwitch 4;
BA_ "SPN" SG_ 3221225472 TransHighRangeSenseSwitch 778;
BA_ "SigType" SG_ 3221225472 TransSynchronizerBrakeValue 1;
BA_ "SPN" SG_ 3221225472 TransSynchronizerBrakeValue 54;
BA_ "SigType" SG_ 3221225472 TransSynchronizerClutchValue 1;
BA_ "SPN" SG_ 3221225472 TransSynchronizerClutchValue 53;
BA_ "SigType" SG_ 3221225472 TransInertiaBrakeActuator 4;
BA_ "SPN" SG_ 3221225472 TransInertiaBrakeActuator 787;
BA_ "SigType" SG_ 3221225472 TransDefuelActuator 4;
BA_ "SPN" SG_ 3221225472 TransDefuelActuator 786;
BA_ "SigType" SG_ 3221225472 TransLockupClutchActuator 4;
BA_ "SPN" SG_ 3221225472 TransLockupClutchActuator 740;
BA_ "SigType" SG_ 3221225472 TransClutchActuator 4;
BA_ "SPN" SG_ 3221225472 TransClutchActuator 788;
BA_ "SigType" SG_ 3221225472 TransSplitterIndirectActuator 4;
BA_ "SPN" SG_ 3221225472 TransSplitterIndirectActuator 771;
BA_ "SigType" SG_ 3221225472 TransSplitterDirectActuator 4;
BA_ "SPN" SG_ 3221225472 TransSplitterDirectActuator 770;
BA_ "SigType" SG_ 3221225472 TransRangeLowActuator 4;
BA_ "SPN" SG_ 3221225472 TransRangeLowActuator 769;
BA_ "SigType" SG_ 3221225472 TransRangeHighActuator 4;
BA_ "SPN" SG_ 3221225472 TransRangeHighActuator 768;
BA_ "SigType" SG_ 3221225472 TransShiftFingerGearActuator2 4;
BA_ "SPN" SG_ 3221225472 TransShiftFingerGearActuator2 784;
BA_ "SigType" SG_ 3221225472 TransShiftFingerRailActuator2 4;
BA_ "SPN" SG_ 3221225472 TransShiftFingerRailActuator2 783;
BA_ "SigType" SG_ 3221225472 TransShiftFingerGearActuator1 4;
BA_ "SPN" SG_ 3221225472 TransShiftFingerGearActuator1 773;
BA_ "SigType" SG_ 3221225472 TransShiftFingerRailActuator1 4;
BA_ "SPN" SG_ 3221225472 TransShiftFingerRailActuator1 772;
BA_ "SigType" SG_ 3221225472 TrnsShftFngrCenterRailIndicator 4;
BA_ "SPN" SG_ 3221225472 TrnsShftFngrCenterRailIndicator 782;
BA_ "SigType" SG_ 3221225472 TrnsShftFngrEngagementIndicator 4;
BA_ "SPN" SG_ 3221225472 TrnsShftFngrEngagementIndicator 781;
BA_ "SigType" SG_ 3221225472 TrnsShiftFingerNeutralIndicator 4;
BA_ "SPN" SG_ 3221225472 TrnsShiftFingerNeutralIndicator 780;
BA_ "SigType" SG_ 3221225472 TransShiftFingerRailPos 1;
BA_ "SPN" SG_ 3221225472 TransShiftFingerRailPos 60;
BA_ "SigType" SG_ 3221225472 TransShiftFingerGearPos 1;
BA_ "SPN" SG_ 3221225472 TransShiftFingerGearPos 59;
BA_ "SigType" SG_ 3221225472 TransCurrentRange 1;
BA_ "SPN" SG_ 3221225472 TransCurrentRange 163;
BA_ "SigType" SG_ 3221225472 TransRqedRange 1;
BA_ "SPN" SG_ 3221225472 TransRqedRange 162;
BA_ "SigType" SG_ 3221225472 TransCurrentGear 1;
BA_ "SPN" SG_ 3221225472 TransCurrentGear 523;
BA_ "SigType" SG_ 3221225472 TransActualGearRatio 1;
BA_ "SPN" SG_ 3221225472 TransActualGearRatio 526;
BA_ "SigType" SG_ 3221225472 TransSelectedGear 1;
BA_ "SPN" SG_ 3221225472 TransSelectedGear 524;
BA_ "SigType" SG_ 3221225472 SrcAddrssOfCtrllngDvcFrTrnsCtrl 1;
BA_ "SPN" SG_ 3221225472 SrcAddrssOfCtrllngDvcFrTrnsCtrl 1482;
BA_ "SigType" SG_ 3221225472 TransInputShaftSpeed 1;
BA_ "SPN" SG_ 3221225472 TransInputShaftSpeed 161;
BA_ "SigType" SG_ 3221225472 ProgressiveShiftDisable 4;
BA_ "SPN" SG_ 3221225472 ProgressiveShiftDisable 607;
BA_ "SigType" SG_ 3221225472 EngMomentaryOverspeedEnable 4;
BA_ "SPN" SG_ 3221225472 EngMomentaryOverspeedEnable 606;
BA_ "SigType" SG_ 3221225472 TransOutputShaftSpeed 1;
BA_ "SPN" SG_ 3221225472 TransOutputShaftSpeed 191;
BA_ "SigType" SG_ 3221225472 TransShiftInProcess 4;
BA_ "SPN" SG_ 3221225472 TransShiftInProcess 574;
BA_ "SigType" SG_ 3221225472 TorqueConverterLockupEngaged 4;
BA_ "SPN" SG_ 3221225472 TorqueConverterLockupEngaged 573;
BA_ "SigType" SG_ 3221225472 TransDrivelineEngaged 4;
BA_ "SPN" SG_ 3221225472 TransDrivelineEngaged 560;
BA_ "SigType" SG_ 3221225472 EngChargeAirCoolerOutletTemp 1;
BA_ "SPN" SG_ 3221225472 EngChargeAirCoolerOutletTemp 2630;
BA_ "SigType" SG_ 3221225472 EngCoolantTempHiRes 1;
BA_ "SPN" SG_ 3221225472 EngCoolantTempHiRes 1637;
BA_ "SigType" SG_ 3221225472 EngIntkVlvActationSystemOilTemp 1;
BA_ "SPN" SG_ 3221225472 EngIntkVlvActationSystemOilTemp 2986;
BA_ "SigType" SG_ 3221225472 EngIntakeManifold1AirTemp 1;
BA_ "SPN" SG_ 3221225472 EngIntakeManifold1AirTemp 1636;
BA_ "SigType" SG_ 3221225472 EngExhstExhstGsTempLeftManifold 1;
BA_ "SPN" SG_ 3221225472 EngExhstExhstGsTempLeftManifold 2434;
BA_ "SigType" SG_ 3221225472 EngExhstExhstGsTmpRightManifold 1;
BA_ "SPN" SG_ 3221225472 EngExhstExhstGsTmpRightManifold 2433;
BA_ "SigType" SG_ 3221225472 SterableLiftAxleLoweringInhibit 4;
BA_ "SPN" SG_ 3221225472 SterableLiftAxleLoweringInhibit 2922;
BA_ "SPN" SG_ 3221225472 TypeOfSteerTrans 2926;
BA_ "SPN" SG_ 3221225472 TypeOfSteerForces 2925;
BA_ "SPN" SG_ 3221225472 SteerType 2924;
BA_ "SPN" SG_ 3221225472 StatusOfSteerAxle 2923;
BA_ "SigType" SG_ 3221225472 ActualInnerWheelSteerAngle 1;
BA_ "SPN" SG_ 3221225472 ActualInnerWheelSteerAngle 2927;
BA_ "SigType" SG_ 3221225472 TransOutputRetarder 4;
BA_ "SPN" SG_ 3221225472 TransOutputRetarder 748;
BA_ "SigType" SG_ 3221225472 RetarderSelectionNonEng 1;
BA_ "SPN" SG_ 3221225472 RetarderSelectionNonEng 1716;
BA_ "SigType" SG_ 3221225472 ActlMxAvlblRtarderPercentTorque 1;
BA_ "SPN" SG_ 3221225472 ActlMxAvlblRtarderPercentTorque 1717;
BA_ "SigType" SG_ 3221225472 DrvrsDmandRetarderPercentTorque 1;
BA_ "SPN" SG_ 3221225472 DrvrsDmandRetarderPercentTorque 1715;
BA_ "SigType" SG_ 3221225472 SrcAddrssOfCtrllngDvcFrRtrdrCtrl 1;
BA_ "SPN" SG_ 3221225472 SrcAddrssOfCtrllngDvcFrRtrdrCtrl 1480;
BA_ "SigType" SG_ 3221225472 RetarderRqingBrakeLight 4;
BA_ "SPN" SG_ 3221225472 RetarderRqingBrakeLight 1667;
BA_ "SigType" SG_ 3221225472 EngCoolantLoadIncrease 4;
BA_ "SPN" SG_ 3221225472 EngCoolantLoadIncrease 1082;
BA_ "SigType" SG_ 3221225472 IntendedRetarderPercentTorque 1;
BA_ "SPN" SG_ 3221225472 IntendedRetarderPercentTorque 1085;
BA_ "SigType" SG_ 3221225472 ActualRetarderPercentTorque 1;
BA_ "SPN" SG_ 3221225472 ActualRetarderPercentTorque 520;
BA_ "SigType" SG_ 3221225472 RetarderEnableShiftAssistSwitch 4;
BA_ "SPN" SG_ 3221225472 RetarderEnableShiftAssistSwitch 572;
BA_ "SigType" SG_ 3221225472 RetarderEnableBrakeAssistSwitch 4;
BA_ "SPN" SG_ 3221225472 RetarderEnableBrakeAssistSwitch 571;
BA_ "SPN" SG_ 3221225472 RetarderTorqueMode 900;
BA_ "SigType" SG_ 3221225472 EngExhaustGasPort20Temp 1;
BA_ "SPN" SG_ 3221225472 EngExhaustGasPort20Temp 1156;
BA_ "SigType" SG_ 3221225472 EngExhaustGasPort19Temp 1;
BA_ "SPN" SG_ 3221225472 EngExhaustGasPort19Temp 1155;
BA_ "SigType" SG_ 3221225472 EngExhaustGasPort18Temp 1;
BA_ "SPN" SG_ 3221225472 EngExhaustGasPort18Temp 1154;
BA_ "SigType" SG_ 3221225472 EngExhaustGasPort17Temp 1;
BA_ "SPN" SG_ 3221225472 EngExhaustGasPort17Temp 1153;
BA_ "SigType" SG_ 3221225472 EngExhaustGasPort16Temp 1;
BA_ "SPN" SG_ 3221225472 EngExhaustGasPort16Temp 1152;
BA_ "SigType" SG_ 3221225472 EngExhaustGasPort15Temp 1;
BA_ "SPN" SG_ 3221225472 EngExhaustGasPort15Temp 1151;
BA_ "SigType" SG_ 3221225472 EngExhaustGasPort14Temp 1;
BA_ "SPN" SG_ 3221225472 EngExhaustGasPort14Temp 1150;
BA_ "SigType" SG_ 3221225472 EngExhaustGasPort13Temp 1;
BA_ "SPN" SG_ 3221225472 EngExhaustGasPort13Temp 1149;
BA_ "SigType" SG_ 3221225472 EngExhaustGasPort12Temp 1;
BA_ "SPN" SG_ 3221225472 EngExhaustGasPort12Temp 1148;
BA_ "SigType" SG_ 3221225472 EngExhaustGasPort11Temp 1;
BA_ "SPN" SG_ 3221225472 EngExhaustGasPort11Temp 1147;
BA_ "SigType" SG_ 3221225472 EngExhaustGasPort10Temp 1;
BA_ "SPN" SG_ 3221225472 EngExhaustGasPort10Temp 1146;
BA_ "SigType" SG_ 3221225472 EngExhaustGasPort9Temp 1;
BA_ "SPN" SG_ 3221225472 EngExhaustGasPort9Temp 1145;
BA_ "SigType" SG_ 3221225472 EngExhaustGasPort8Temp 1;
BA_ "SPN" SG_ 3221225472 EngExhaustGasPort8Temp 1144;
BA_ "SigType" SG_ 3221225472 EngExhaustGasPort7Temp 1;
BA_ "SPN" SG_ 3221225472 EngExhaustGasPort7Temp 1143;
BA_ "SigType" SG_ 3221225472 EngExhaustGasPort6Temp 1;
BA_ "SPN" SG_ 3221225472 EngExhaustGasPort6Temp 1142;
BA_ "SigType" SG_ 3221225472 EngExhaustGasPort5Temp 1;
BA_ "SPN" SG_ 3221225472 EngExhaustGasPort5Temp 1141;
BA_ "SigType" SG_ 3221225472 EngExhaustGasPort4Temp 1;
BA_ "SPN" SG_ 3221225472 EngExhaustGasPort4Temp 1140;
BA_ "SigType" SG_ 3221225472 EngExhaustGasPort3Temp 1;
BA_ "SPN" SG_ 3221225472 EngExhaustGasPort3Temp 1139;
BA_ "SigType" SG_ 3221225472 EngExhaustGasPort2Temp 1;
BA_ "SPN" SG_ 3221225472 EngExhaustGasPort2Temp 1138;
BA_ "SigType" SG_ 3221225472 EngExhaustGasPort1Temp 1;
BA_ "SPN" SG_ 3221225472 EngExhaustGasPort1Temp 1137;
BA_ "SigType" SG_ 3221225472 PayloadPercentage 1;
BA_ "SPN" SG_ 3221225472 PayloadPercentage 2600;
BA_ "SigType" SG_ 3221225472 DataMemoryUsage 1;
BA_ "SPN" SG_ 3221225472 DataMemoryUsage 2802;
BA_ "SigType" SG_ 3221225472 KeepAliveBatteryConsumption 1;
BA_ "SPN" SG_ 3221225472 KeepAliveBatteryConsumption 2803;
BA_ "SigType" SG_ 3221225472 TravelVelocityCtrlPos 1;
BA_ "SPN" SG_ 3221225472 TravelVelocityCtrlPos 2601;
BA_ "SigType" SG_ 3221225472 Jystck3GripXAxisDetentPosStatus 4;
BA_ "SPN" SG_ 3221225472 Jystck3GripXAxisDetentPosStatus 2756;
BA_ "SigType" SG_ 3221225472 Jystck3GripYAxisDetentPosStatus 4;
BA_ "SPN" SG_ 3221225472 Jystck3GripYAxisDetentPosStatus 2757;
BA_ "SigType" SG_ 3221225472 Jystck3ThetaAxisDetentPosStatus 4;
BA_ "SPN" SG_ 3221225472 Jystck3ThetaAxisDetentPosStatus 2758;
BA_ "SigType" SG_ 3221225472 Joystick3ThetaAxisPos 1;
BA_ "SPN" SG_ 3221225472 Joystick3ThetaAxisPos 2738;
BA_ "SigType" SG_ 3221225472 Jystck3ThtAxsClckwsPstvPsStatus 4;
BA_ "SPN" SG_ 3221225472 Jystck3ThtAxsClckwsPstvPsStatus 2743;
BA_ "SigType" SG_ 3221225472 Jystck3ThtAxsCntrClckwsNgtvPsStt 4;
BA_ "SPN" SG_ 3221225472 Jystck3ThtAxsCntrClckwsNgtvPsStt 2748;
BA_ "SigType" SG_ 3221225472 Jystck3ThtaAxisNeutralPosStatus 4;
BA_ "SPN" SG_ 3221225472 Jystck3ThtaAxisNeutralPosStatus 2753;
BA_ "SigType" SG_ 3221225472 Joystick3GripYAxisPos 1;
BA_ "SPN" SG_ 3221225472 Joystick3GripYAxisPos 2737;
BA_ "SigType" SG_ 3221225472 Jystck3GrpYAxsLvrFrwrdPstvPsStts 4;
BA_ "SPN" SG_ 3221225472 Jystck3GrpYAxsLvrFrwrdPstvPsStts 2742;
BA_ "SigType" SG_ 3221225472 Jystck3GrpYAxsLvrBckNgtvPsSttus 4;
BA_ "SPN" SG_ 3221225472 Jystck3GrpYAxsLvrBckNgtvPsSttus 2747;
BA_ "SigType" SG_ 3221225472 Jystck3GrpYAxisNeutralPosStatus 4;
BA_ "SPN" SG_ 3221225472 Jystck3GrpYAxisNeutralPosStatus 2752;
BA_ "SigType" SG_ 3221225472 Joystick3GripXAxisPos 1;
BA_ "SPN" SG_ 3221225472 Joystick3GripXAxisPos 2736;
BA_ "SigType" SG_ 3221225472 Jystck3GrpXAxsLvrRghtPstvPsStts 4;
BA_ "SPN" SG_ 3221225472 Jystck3GrpXAxsLvrRghtPstvPsStts 2741;
BA_ "SigType" SG_ 3221225472 Jystck3GrpXAxsLvrLftNgtvPsSttus 4;
BA_ "SPN" SG_ 3221225472 Jystck3GrpXAxsLvrLftNgtvPsSttus 2746;
BA_ "SigType" SG_ 3221225472 Jystck3GrpXAxisNeutralPosStatus 4;
BA_ "SPN" SG_ 3221225472 Jystck3GrpXAxisNeutralPosStatus 2751;
BA_ "SigType" SG_ 3221225472 Jystck2GripXAxisDetentPosStatus 4;
BA_ "SPN" SG_ 3221225472 Jystck2GripXAxisDetentPosStatus 2719;
BA_ "SigType" SG_ 3221225472 Jystck2GripYAxisDetentPosStatus 4;
BA_ "SPN" SG_ 3221225472 Jystck2GripYAxisDetentPosStatus 2720;
BA_ "SigType" SG_ 3221225472 Jystck2ThetaAxisDetentPosStatus 4;
BA_ "SPN" SG_ 3221225472 Jystck2ThetaAxisDetentPosStatus 2721;
BA_ "SigType" SG_ 3221225472 Joystick2ThetaAxisPos 1;
BA_ "SPN" SG_ 3221225472 Joystick2ThetaAxisPos 2701;
BA_ "SigType" SG_ 3221225472 Jystck2ThtAxsClckwsPstvPsStatus 4;
BA_ "SPN" SG_ 3221225472 Jystck2ThtAxsClckwsPstvPsStatus 2706;
BA_ "SigType" SG_ 3221225472 Jystck2ThtAxsCntrClckwsNgtvPsStt 4;
BA_ "SPN" SG_ 3221225472 Jystck2ThtAxsCntrClckwsNgtvPsStt 2711;
BA_ "SigType" SG_ 3221225472 Jystck2ThtaAxisNeutralPosStatus 4;
BA_ "SPN" SG_ 3221225472 Jystck2ThtaAxisNeutralPosStatus 2716;
BA_ "SigType" SG_ 3221225472 Joystick2GripYAxisPos 1;
BA_ "SPN" SG_ 3221225472 Joystick2GripYAxisPos 2700;
BA_ "SigType" SG_ 3221225472 Jystck2GrpYAxsLvrFrwrdPstvPsStts 4;
BA_ "SPN" SG_ 3221225472 Jystck2GrpYAxsLvrFrwrdPstvPsStts 2705;
BA_ "SigType" SG_ 3221225472 Jystck2GrpYAxsLvrBckNgtvPsSttus 4;
BA_ "SPN" SG_ 3221225472 Jystck2GrpYAxsLvrBckNgtvPsSttus 2710;
BA_ "SigType" SG_ 3221225472 Jystck2GrpYAxisNeutralPosStatus 4;
BA_ "SPN" SG_ 3221225472 Jystck2GrpYAxisNeutralPosStatus 2715;
BA_ "SigType" SG_ 3221225472 Joystick2GripXAxisPos 1;
BA_ "SPN" SG_ 3221225472 Joystick2GripXAxisPos 2699;
BA_ "SigType" SG_ 3221225472 Jystck2GrpXAxsLvrRghtPstvPsStts 4;
BA_ "SPN" SG_ 3221225472 Jystck2GrpXAxsLvrRghtPstvPsStts 2704;
BA_ "SigType" SG_ 3221225472 Jystck2GrpXAxsLvrLftNgtvPsSttus 4;
BA_ "SPN" SG_ 3221225472 Jystck2GrpXAxsLvrLftNgtvPsSttus 2709;
BA_ "SigType" SG_ 3221225472 Jystck2GrpXAxisNeutralPosStatus 4;
BA_ "SPN" SG_ 3221225472 Jystck2GrpXAxisNeutralPosStatus 2714;
BA_ "SigType" SG_ 3221225472 Jystck1GripXAxisDetentPosStatus 4;
BA_ "SPN" SG_ 3221225472 Jystck1GripXAxisDetentPosStatus 2682;
BA_ "SigType" SG_ 3221225472 Jystck1GripYAxisDetentPosStatus 4;
BA_ "SPN" SG_ 3221225472 Jystck1GripYAxisDetentPosStatus 2683;
BA_ "SigType" SG_ 3221225472 Jystck1ThetaAxisDetentPosStatus 4;
BA_ "SPN" SG_ 3221225472 Jystck1ThetaAxisDetentPosStatus 2684;
BA_ "SigType" SG_ 3221225472 Joystick1ThetaAxisPos 1;
BA_ "SPN" SG_ 3221225472 Joystick1ThetaAxisPos 2664;
BA_ "SigType" SG_ 3221225472 Jystck1ThtAxsClckwsPstvPsStatus 4;
BA_ "SPN" SG_ 3221225472 Jystck1ThtAxsClckwsPstvPsStatus 2669;
BA_ "SigType" SG_ 3221225472 Jystck1ThtAxsCntrClckwsNgtvPsStt 4;
BA_ "SPN" SG_ 3221225472 Jystck1ThtAxsCntrClckwsNgtvPsStt 2674;
BA_ "SigType" SG_ 3221225472 Jystck1ThtaAxisNeutralPosStatus 4;
BA_ "SPN" SG_ 3221225472 Jystck1ThtaAxisNeutralPosStatus 2679;
BA_ "SigType" SG_ 3221225472 Joystick1GripYAxisPos 1;
BA_ "SPN" SG_ 3221225472 Joystick1GripYAxisPos 2663;
BA_ "SigType" SG_ 3221225472 Jystck1GrpYAxsLvrFrwrdPstvPsStts 4;
BA_ "SPN" SG_ 3221225472 Jystck1GrpYAxsLvrFrwrdPstvPsStts 2668;
BA_ "SigType" SG_ 3221225472 Jystck1GrpYAxsLvrBckNgtvPsSttus 4;
BA_ "SPN" SG_ 3221225472 Jystck1GrpYAxsLvrBckNgtvPsSttus 2673;
BA_ "SigType" SG_ 3221225472 Jystck1GrpYAxisNeutralPosStatus 4;
BA_ "SPN" SG_ 3221225472 Jystck1GrpYAxisNeutralPosStatus 2678;
BA_ "SigType" SG_ 3221225472 Joystick1GripXAxisPos 1;
BA_ "SPN" SG_ 3221225472 Joystick1GripXAxisPos 2662;
BA_ "SigType" SG_ 3221225472 Jystck1GrpXAxsLvrRghtPstvPsStts 4;
BA_ "SPN" SG_ 3221225472 Jystck1GrpXAxsLvrRghtPstvPsStts 2667;
BA_ "SigType" SG_ 3221225472 Jystck1GrpXAxsLvrLftNgtvPsSttus 4;
BA_ "SPN" SG_ 3221225472 Jystck1GrpXAxsLvrLftNgtvPsSttus 2672;
BA_ "SigType" SG_ 3221225472 Jystck1GrpXAxisNeutralPosStatus 4;
BA_ "SPN" SG_ 3221225472 Jystck1GrpXAxisNeutralPosStatus 2677;
BA_ "SigType" SG_ 3221225472 EngFuelRackPos 1;
BA_ "SPN" SG_ 3221225472 EngFuelRackPos 1210;
BA_ "SigType" SG_ 3221225472 InstantaneousEstBrakePower 1;
BA_ "SPN" SG_ 3221225472 InstantaneousEstBrakePower 1242;
BA_ "SigType" SG_ 3221225472 EngMassFlow 1;
BA_ "SPN" SG_ 3221225472 EngMassFlow 1241;
BA_ "SigType" SG_ 3221225472 EngExhaustGasPress 1;
BA_ "SPN" SG_ 3221225472 EngExhaustGasPress 1209;
BA_ "SigType" SG_ 3221225472 EngPrefilterOilPress 1;
BA_ "SPN" SG_ 3221225472 EngPrefilterOilPress 1208;
BA_ "SigType" SG_ 3221225472 TotalECURunTime 1;
BA_ "SPN" SG_ 3221225472 TotalECURunTime 1033;
BA_ "SigType" SG_ 3221225472 TotalECUDistance 1;
BA_ "SPN" SG_ 3221225472 TotalECUDistance 1032;
BA_ "SigType" SG_ 3221225472 EngInletAirMassFlowRate 1;
BA_ "SPN" SG_ 3221225472 EngInletAirMassFlowRate 132;
BA_ "SigType" SG_ 3221225472 EngExhstGsRcrcltionMassFlowRate 1;
BA_ "SPN" SG_ 3221225472 EngExhstGsRcrcltionMassFlowRate 2659;
BA_ "SigType" SG_ 3221225472 EngFuelFilterSucSideDiffPress 1;
BA_ "SPN" SG_ 3221225472 EngFuelFilterSucSideDiffPress 1382;
BA_ "SigType" SG_ 3221225472 EngFuelSupplyPumpInletPress 1;
BA_ "SPN" SG_ 3221225472 EngFuelSupplyPumpInletPress 1381;
BA_ "SigType" SG_ 3221225472 EngOilLevelRemoteReservoir 1;
BA_ "SPN" SG_ 3221225472 EngOilLevelRemoteReservoir 1380;
BA_ "SigType" SG_ 3221225472 EngWasteOilReservoirLevel 1;
BA_ "SPN" SG_ 3221225472 EngWasteOilReservoirLevel 3548;
BA_ "SPN" SG_ 3221225472 EngVentilationStatus 3554;
BA_ "SigType" SG_ 3221225472 EngOilPrimingState 4;
BA_ "SPN" SG_ 3221225472 EngOilPrimingState 3551;
BA_ "SigType" SG_ 3221225472 EngOilPrimingPumpSwitch 4;
BA_ "SPN" SG_ 3221225472 EngOilPrimingPumpSwitch 3550;
BA_ "SigType" SG_ 3221225472 EngOilPreHeatedState 4;
BA_ "SPN" SG_ 3221225472 EngOilPreHeatedState 3552;
BA_ "SigType" SG_ 3221225472 EngOilFilterOutletPress 1;
BA_ "SPN" SG_ 3221225472 EngOilFilterOutletPress 3549;
BA_ "SigType" SG_ 3221225472 EngCoolantPreheatedState 4;
BA_ "SPN" SG_ 3221225472 EngCoolantPreheatedState 3553;
BA_ "SigType" SG_ 3221225472 EngExhstGsRcrculationInletPress 1;
BA_ "SPN" SG_ 3221225472 EngExhstGsRcrculationInletPress 3358;
BA_ "SigType" SG_ 3221225472 EngIntkVlvActtionSystemOilPress 1;
BA_ "SPN" SG_ 3221225472 EngIntkVlvActtionSystemOilPress 2948;
BA_ "SigType" SG_ 3221225472 EngInjectorMeteringRail2Press 1;
BA_ "SPN" SG_ 3221225472 EngInjectorMeteringRail2Press 1349;
BA_ "SigType" SG_ 3221225472 EngInjectorTimingRail1Press 1;
BA_ "SPN" SG_ 3221225472 EngInjectorTimingRail1Press 156;
BA_ "SigType" SG_ 3221225472 EngInjectorMeteringRail1Press 1;
BA_ "SPN" SG_ 3221225472 EngInjectorMeteringRail1Press 157;
BA_ "SigType" SG_ 3221225472 EngInjectionCtrlPress 1;
BA_ "SPN" SG_ 3221225472 EngInjectionCtrlPress 164;
BA_ "SigType" SG_ 3221225472 TurningGearEngaged 4;
BA_ "SPN" SG_ 3221225472 TurningGearEngaged 1206;
BA_ "SigType" SG_ 3221225472 SafetyWireStatus 4;
BA_ "SPN" SG_ 3221225472 SafetyWireStatus 1205;
BA_ "SigType" SG_ 3221225472 ElectricalLoad 1;
BA_ "SPN" SG_ 3221225472 ElectricalLoad 1204;
BA_ "SigType" SG_ 3221225472 EngVrblGometryTurbo1ActuatorPos 1;
BA_ "SPN" SG_ 3221225472 EngVrblGometryTurbo1ActuatorPos 2795;
BA_ "SigType" SG_ 3221225472 EngVrblGmtryTrbArCtrlShtffValve 4;
BA_ "SPN" SG_ 3221225472 EngVrblGmtryTrbArCtrlShtffValve 2792;
BA_ "SigType" SG_ 3221225472 EngExhstGsRcirculationValveCtrl 1;
BA_ "SPN" SG_ 3221225472 EngExhstGsRcirculationValveCtrl 2791;
BA_ "SigType" SG_ 3221225472 EngTrb1ClcltedTurbineOutletTemp 1;
BA_ "SPN" SG_ 3221225472 EngTrb1ClcltedTurbineOutletTemp 2790;
BA_ "SigType" SG_ 3221225472 EngTrb1ClclatedTurbineInletTemp 1;
BA_ "SPN" SG_ 3221225472 EngTrb1ClclatedTurbineInletTemp 2789;
BA_ "SigType" SG_ 3221225472 EngRotationDirection 4;
BA_ "SPN" SG_ 3221225472 EngRotationDirection 3669;
BA_ "SigType" SG_ 3221225472 CrnkAttmptCntOnPrsntStrtAttempt 1;
BA_ "SPN" SG_ 3221225472 CrnkAttmptCntOnPrsntStrtAttempt 3671;
BA_ "SigType" SG_ 3221225472 EngRatedSpeed 1;
BA_ "SPN" SG_ 3221225472 EngRatedSpeed 189;
BA_ "SigType" SG_ 3221225472 EngRatedPower 1;
BA_ "SPN" SG_ 3221225472 EngRatedPower 166;
BA_ "SigType" SG_ 3221225472 EngMinContinuousTorque 1;
BA_ "SPN" SG_ 3221225472 EngMinContinuousTorque 1775;
BA_ "SigType" SG_ 3221225472 EngMaxContinuousTorque 1;
BA_ "SPN" SG_ 3221225472 EngMaxContinuousTorque 1774;
BA_ "SigType" SG_ 3221225472 EngMinContinuousRPM 1;
BA_ "SPN" SG_ 3221225472 EngMinContinuousRPM 1773;
BA_ "SigType" SG_ 3221225472 EngMaxContinuousRPM 1;
BA_ "SPN" SG_ 3221225472 EngMaxContinuousRPM 1772;
BA_ "SigType" SG_ 3221225472 EngHghLmtThrshhldFrMnCntnsTrqFrm 1;
BA_ "SPN" SG_ 3221225472 EngHghLmtThrshhldFrMnCntnsTrqFrm 1771;
BA_ "SigType" SG_ 3221225472 EngLwLmtThrshldFrMxTrqueFromEng 1;
BA_ "SPN" SG_ 3221225472 EngLwLmtThrshldFrMxTrqueFromEng 1770;
BA_ "SigType" SG_ 3221225472 EngHghLmtThrshhldFrMnCntnsEngRPM 1;
BA_ "SPN" SG_ 3221225472 EngHghLmtThrshhldFrMnCntnsEngRPM 1769;
BA_ "SigType" SG_ 3221225472 EngLwLmtThrshhldFrMaxRPMFromEng 1;
BA_ "SPN" SG_ 3221225472 EngLwLmtThrshhldFrMaxRPMFromEng 1768;
BA_ "SigType" SG_ 3221225472 RearAxleGroupEngagementStatus 4;
BA_ "SPN" SG_ 3221225472 RearAxleGroupEngagementStatus 3820;
BA_ "SigType" SG_ 3221225472 FrontAxleGroupEngagementStatus 4;
BA_ "SPN" SG_ 3221225472 FrontAxleGroupEngagementStatus 3819;
BA_ "SigType" SG_ 3221225472 DiffLockStateCentralRear 4;
BA_ "SPN" SG_ 3221225472 DiffLockStateCentralRear 566;
BA_ "SigType" SG_ 3221225472 DiffLockStateCentralFront 4;
BA_ "SPN" SG_ 3221225472 DiffLockStateCentralFront 565;
BA_ "SigType" SG_ 3221225472 DiffLockStateCentral 4;
BA_ "SPN" SG_ 3221225472 DiffLockStateCentral 564;
BA_ "SigType" SG_ 3221225472 DiffLockStateRearAxle2 4;
BA_ "SPN" SG_ 3221225472 DiffLockStateRearAxle2 570;
BA_ "SigType" SG_ 3221225472 DiffLockStateRearAxle1 4;
BA_ "SPN" SG_ 3221225472 DiffLockStateRearAxle1 569;
BA_ "SigType" SG_ 3221225472 DiffLockStateFrontAxle2 4;
BA_ "SPN" SG_ 3221225472 DiffLockStateFrontAxle2 568;
BA_ "SigType" SG_ 3221225472 DiffLockStateFrontAxle1 4;
BA_ "SPN" SG_ 3221225472 DiffLockStateFrontAxle1 567;
BA_ "SigType" SG_ 3221225472 Location 1;
BA_ "SPN" SG_ 3221225472 Location 927;
BA_ "SigType" SG_ 3221225472 SeaWaterPumpOutletPress 1;
BA_ "SPN" SG_ 3221225472 SeaWaterPumpOutletPress 2435;
BA_ "SigType" SG_ 3221225472 EngAuxCoolantTemp 1;
BA_ "SPN" SG_ 3221225472 EngAuxCoolantTemp 1212;
BA_ "SigType" SG_ 3221225472 EngAuxCoolantPress 1;
BA_ "SPN" SG_ 3221225472 EngAuxCoolantPress 1203;
BA_ "SigType" SG_ 3221225472 Driver2 8;
BA_ "SPN" SG_ 3221225472 Driver2 1626;
BA_ "SigType" SG_ 3221225472 Driver1 8;
BA_ "SPN" SG_ 3221225472 Driver1 1625;
BA_ "SigType" SG_ 3221225472 CargoAmbientTemp 1;
BA_ "SPN" SG_ 3221225472 CargoAmbientTemp 169;
BA_ "SigType" SG_ 3221225472 EngOilFilterDiffPress 1;
BA_ "SPN" SG_ 3221225472 EngOilFilterDiffPress 99;
BA_ "SigType" SG_ 3221225472 EngFuelFilterDiffPress 1;
BA_ "SPN" SG_ 3221225472 EngFuelFilterDiffPress 95;
BA_ "SigType" SG_ 3221225472 FuelLevel 1;
BA_ "SPN" SG_ 3221225472 FuelLevel 96;
BA_ "SigType" SG_ 3221225472 WasherFluidLevel 1;
BA_ "SPN" SG_ 3221225472 WasherFluidLevel 80;
BA_ "SPN" SG_ 3221225472 EngStartEnableDevice2Config 2898;
VAL_ 3221225472 WinchOilPressSwitch 3 "NotAvailable" 2 "ErrrSwtchStteCannotBeDetermined" 1 "OKOilPressIsAboveMin" 0 "NOTOKOilPressIsTooLow" ;
VAL_ 3221225472 HydOilFilterRestrictionSwitch 3 "NotAvailable" 2 "Error" 1 "RestrictionExistsOnOilFilter" 0 "NoRestriction" ;
VAL_ 3221225472 TransitRunStatus 3 "NotAvailable" 2 "ErrorCondition" 1 "On" 0 "Off" ;
VAL_ 3221225472 VehicleUseStatus 3 "NotAvailable" 2 "ErrorCondition" 1 "UnauthorizedUse" 0 "NormalUse" ;
VAL_ 3221225472 SilentAlarmStatus 3 "NotAvailable" 2 "ErrorCondition" 1 "On" 0 "Off" ;
VAL_ 3221225472 TypeOfPassengerCount 1 "BoardingPassenger" 0 "AbsPassengerCount" 4 "Exiting Passenger (second passenger stream)" 3 "Boarding Passenger (second passenger stream)" 2 "Exiting Passenger" ;
VAL_ 3221225472 FareboxAlarmIdentifier 97 "1111111AgencyDefined" 26 "1100000ReservedToBeAssigned" 25 "MaintenanceAccessOutOfService" 24 "MntnncAccssInSrvcCnsdrdAnAlrmCn" 23 "PaperCurrencyJamCleared" 22 "PaperCurrencyJam" 21 "Pass_TransferJamCleared" 20 "Pass_TransferJam" 19 "FareboxResetToAutomaticMode" 18 "FareboxSetInManualBypass" 17 "CoinDejamOperated" 16 "Card_PassBoxFull" 15 "Card_PassBoxLessThan75Full" 14 "Card_PassBox75Full" 13 "CurrencyBoxFull" 12 "CurrencyBoxLessThan75Full" 11 "CurrencyBox75Full" 10 "CoinboxFull" 9 "Coinbox75Full" 8 "InsufficientFareAccepted" 7 "CshbxOpndInSrvcCnsdrdAnAlrmCndt" 6 "CashboxDoorTimeout" 5 "CashboxRestored" 4 "CashboxRemoved" 3 "ProbeCompleted" 2 "ProbeStarted" 1 "VoltageRestored" 0 "VoltageDropout" ;
VAL_ 3221225472 FareboxEmergencyStatus 3 "NotAvailable" 2 "ErrorCondition" 1 "EmergencyCondition" 0 "NonemergencyCondition" ;
VAL_ 3221225472 TransferType 6 "11111AgencyDefined" 5 "Out" 4 "In" 3 "West" 2 "East" 1 "South" 0 "North" ;
VAL_ 3221225472 TypeOfService 2 "111AgencyDefined" 1 "ExpressService" 0 "LocalService" ;
VAL_ 3221225472 PaymentDetails 11 "1111AgencyDefined" 6 "1010ReservedForAssignment" 5 "Card" 4 "Pass" 3 "Ticket" 2 "Token" 1 "Cash" 0 "NotAnUpgrade" ;
VAL_ 3221225472 TypeOfFare 11 "1111AgencyDefined" 7 "1010ReservedForAssignment" 6 "PassB" 5 "PassA" 4 "TicketB" 3 "TicketA" 2 "TokenB" 1 "TokenA" 0 "Cash_NoDetail" ;
VAL_ 3221225472 TransactionType 12 "1111AgencyDefined" 8 "1011ReservedForAssignment" 7 "Free" 6 "Transfer" 5 "Permit" 4 "Card" 3 "Pass" 2 "Ticket" 1 "Token" 0 "Cash" ;
VAL_ 3221225472 DriversFareboxSecurityCode 1 "65535SecurityCode" 0 "Farebox is in reporting status" ;
VAL_ 3221225472 TripDirection 6 "1111AgencyDefined" 5 "Out" 4 "In" 3 "West" 2 "East" 1 "South" 0 "North" ;
VAL_ 3221225472 TripStatus 6 "LayoverEnd" 5 "LayoverStart" 2 "TripEnd" 1 "TripStart" 7 "Undefined" ;
VAL_ 3221225472 FareboxServiceStatus 3 "NotAvailable" 2 "ErrorCondition" 1 "FareboxInService" 0 "FareboxOutOfService" ;
VAL_ 3221225472 StrobeActivationCtrlStatus 3 "NotAvailable" 2 "ErrorCondition" 1 "ActivateStrobe" 0 "DeactivateStrobe" ;
VAL_ 3221225472 TransitDoorEnable 3 "NotAvailable" 2 "ErrorCondition" 1 "TrnstDrSttsWllOvrrdStrbActvtion" 0 "IgnoreTransitDoorStatus" ;
VAL_ 3221225472 PriorityOfRespSentByEmitter 15 "NotAvailable" 14 "ErrorCondition" 12 "to1101Reserved" 11 "PrrtyStByHardwareToHighPriority" 10 "PrrtyStByHrdwareToProbePriority" 9 "PrrtySetByHardwareToLowPriority" 4 "to1000Reserved" 3 "HighPriority" 2 "ProbePriority" 1 "LowPriority" 0 "Reserved" ;
VAL_ 3221225472 IntersectionPreemptionRq_Resp 3 "NotAvailable" 2 "ErrorCondition" 1 "MessageIsARespFromEmitter" 0 "MessageIsARqDirectedToEmitter" ;
VAL_ 3221225472 TransitRouteIDUsage 3 "NotAvailable" 2 "ErrorCondition" 1 "TrnstRtIDUsedForInterleavedData" 0 "TrnstRtIDNtUsdFrInterleavedData" ;
VAL_ 3221225472 RangeCodeEnable 3 "NotAvailable" 2 "ErrorCondition" 1 "RangeCodeUsedForInterleavedData" 0 "RngCdeNotUsedForInterleavedData" ;
VAL_ 3221225472 PCUSupplySolenoidStatus 3 "NotAvailable" 2 "Error" 1 "On" 0 "Off" ;
VAL_ 3221225472 PCUCtrlSolenoidStatus 3 "NotAvailable" 2 "Error" 1 "On" 0 "Off" ;
VAL_ 3221225472 PCUDeflateSolenoidStatus 3 "NotAvailable" 2 "Error" 1 "On" 0 "Off" ;
VAL_ 3221225472 TirePressSupplySwitchStatus 3 "NotAvailable" 2 "Error" 1 "On" 0 "Off" ;
VAL_ 3221225472 PCUSteerSolenoidStatus 3 "NotAvailable" 2 "Error" 1 "On" 0 "Off" ;
VAL_ 3221225472 PCUDriveSolenoidStatus 3 "NotAvailable" 2 "Error" 1 "On" 0 "Off" ;
VAL_ 3221225472 DriveChannelMode 15 "NotAvailable" 14 "ErrorCondition" 7 "1101Reserved" 6 "PressCheck" 5 "DfltWtSystmWllDfltWhnCndtnsAllw" 4 "InfltWtSystmWllInfltWhnCndtnsAl" 3 "Confirm" 2 "Deflate" 1 "Inflate" 0 "Maintain" ;
VAL_ 3221225472 Trailer_TagChannelMode 15 "NotAvailable" 14 "ErrorCondition" 7 "1101Reserved" 6 "PressCheck" 5 "DfltWtSystmWllDfltWhnCndtnsAllw" 4 "InfltWtSystmWllInfltWhnCndtnsAl" 3 "Confirm" 2 "Deflate" 1 "Inflate" 0 "Maintain" ;
VAL_ 3221225472 SteerChannelMode 15 "NotAvailable" 14 "ErrorCondition" 7 "1101Reserved" 6 "PressCheck" 5 "DfltWtSystmWllDfltWhnCndtnsAllw" 4 "InfltWtSystmWllInfltWhnCndtnsAl" 3 "Confirm" 2 "Deflate" 1 "Inflate" 0 "Maintain" ;
VAL_ 3221225472 PCUTrailerTagPushSolenoidStatus 3 "NotAvailable" 2 "Error" 1 "On" 0 "Off" ;
VAL_ 3221225472 TirePressThresholdDetection 7 "NotAvailable" 6 "ErrorIndicator" 5 "NotDefined" 4 "ExtrmUndrPrssTrPrssrIsAtALvlWhr" 3 "UndrPrssTrPrssrIsLwrThnThPrssrD" 2 "NWrnngPrssTrPrssrIsWthnThThrshl" 1 "OvrPrssTrPrssrIsHghrThnThPrssrD" 0 "ExtrmOvrPrssTrPrssrIsAtALvlWhrT" ;
VAL_ 3221225472 CTIWheelEndElectricalFault 3 "NotSupported" 2 "Error" 1 "NotDefined" 0 "Ok" ;
VAL_ 3221225472 CTITireStatus 3 "NotSupported" 2 "Error" 1 "TireLeakDetected" 0 "Ok" ;
VAL_ 3221225472 CTIWheelSensorStatus 3 "NotSupported" 2 "NotDefined" 1 "On" 0 "Off_IsolatedFromCTIPressCtrl" ;
VAL_ 3221225472 DirectionIndicator 3 "NotAvailable" 2 "Error" 1 "Reverse" 0 "Forward" ;
VAL_ 3221225472 TachographPerformance 3 "NotAvailable" 2 "Error" 1 "PerformanceAnalysis" 0 "NormalPerformance" ;
VAL_ 3221225472 HandlingInformation 3 "NotAvailable" 2 "Error" 1 "HandlingInformation" 0 "NoHandlingInformation" ;
VAL_ 3221225472 SystemEvent 3 "NotAvailable" 2 "Error" 1 "TachographEvent" 0 "NoTachographEvent" ;
VAL_ 3221225472 DriverCardDriver2 3 "NotAvailable" 2 "Error" 1 "DriverCardPresent" 0 "DriverCardNotPresent" ;
VAL_ 3221225472 Driver2TimeRelatedStates 15 "NotAvailable" 14 "Error" 13 "Other" 7 "1100Reserved" 6 "Limit616HReached" 5 "Limit515MinBefore16H" 4 "Limit49HReached" 3 "Limit315MinBefore9H" 2 "Limit24HReached" 1 "Limit115MinBefore4H" 0 "Normal_NoLimitsReached" ;
VAL_ 3221225472 Overspeed 3 "NotAvailable" 2 "Error" 1 "Overspeed" 0 "NoOverspeed" ;
VAL_ 3221225472 DriverCardDriver1 3 "NotAvailable" 2 "Error" 1 "DriverCardPresent" 0 "DriverCardNotPresent" ;
VAL_ 3221225472 Driver1TimeRelatedStates 15 "NotAvailable" 14 "Error" 13 "Other" 7 "1100Reserved" 6 "Limit616HReached" 5 "Limit515MinBefore16H" 4 "Limit49HReached" 3 "Limit315MinBefore9H" 2 "Limit24HReached" 1 "Limit115MinBefore4H" 0 "Normal_NoLimitsReached" ;
VAL_ 3221225472 DriveRecognize 3 "NotAvailable" 2 "Error" 1 "VehicleMotionDetected" 0 "VehicleMotionNotDetected" ;
VAL_ 3221225472 Driver2WorkingState 7 "NotAvailable" 6 "Error" 4 "101Reserved" 3 "DriveBehindWheel" 2 "WrkLdngUnldingWorkingInAnOffice" 1 "DriverAvailableShortBreak" 0 "RestSleeping" ;
VAL_ 3221225472 Driver1WorkingState 7 "NotAvailable" 6 "Error" 4 "101Reserved" 3 "DriveBehindWheel" 2 "WrkLdngUnldingWorkingInAnOffice" 1 "DriverAvailableShortBreak" 0 "RestSleeping" ;
VAL_ 3221225472 TrnsShftSlctorDisplayModeSwitch 3 "NotAvailable" 2 "Error" 1 "On" 0 "Off" ;
VAL_ 3221225472 TransMode4 3 "TakeNoAction" 2 "Reserved" 1 "Enable" 0 "Disable" ;
VAL_ 3221225472 TransMode3 3 "TakeNoAction" 2 "Reserved" 1 "Enable" 0 "Disable" ;
VAL_ 3221225472 TransMode2 3 "TakeNoAction" 2 "Reserved" 1 "Enable" 0 "Disable" ;
VAL_ 3221225472 TransMode1 3 "TakeNoAction" 2 "Reserved" 1 "Enable" 0 "Disable" ;
VAL_ 3221225472 DisengageDiffLockRqCentralRear 2 "Reserved" 3 "TakeNoAction" 1 "DisengageDiffLock" 0 "EngageDiffLock" ;
VAL_ 3221225472 DisengageDiffLockRqCentralFront 2 "Reserved" 3 "TakeNoAction" 1 "DisengageDiffLock" 0 "EngageDiffLock" ;
VAL_ 3221225472 DisengageDiffLockRqCentral 2 "Reserved" 3 "TakeNoAction" 1 "DisengageDiffLock" 0 "EngageDiffLock" ;
VAL_ 3221225472 DisengageDiffLockRqRearAxle2 2 "Reserved" 3 "TakeNoAction" 1 "DisengageDiffLock" 0 "EngageDiffLock" ;
VAL_ 3221225472 DisengageDiffLockRqRearAxle1 2 "Reserved" 3 "TakeNoAction" 1 "DisengageDiffLock" 0 "EngageDiffLock" ;
VAL_ 3221225472 DisengageDiffLockRqFrontAxle2 2 "Reserved" 3 "TakeNoAction" 1 "DisengageDiffLock" 0 "EngageDiffLock" ;
VAL_ 3221225472 DisengageDiffLockRqFrontAxle1 2 "Reserved" 3 "TakeNoAction" 1 "DisengageDiffLock" 0 "EngageDiffLock" ;
VAL_ 3221225472 TransRqedGear 61 "Reserved" 222 "NeutralSelectorPos" 223 "ReverseSelectorPos" 224 "PsUnknownAnd_OrNoButtonsPressed" 225 "PrssOfMmntryBttnTRslctCrrentPos" 226 "BtwnRvrsAndPrkShiftSelectorPoss" 227 "BtwnNtrlAndRvrsShftSelectorPoss" 228 "BtwnDrvAndNtrlShiftSelectorPoss" 229 "BtwnD1AndDriveShiftSelectorPoss" 230 "BetweenD2AndD1ShiftSelectorPoss" 231 "BetweenD3AndD2ShiftSelectorPoss" 232 "BetweenD4AndD3ShiftSelectorPoss" 233 "BetweenD5AndD4ShiftSelectorPoss" 234 "BetweenD6AndD5ShiftSelectorPoss" 235 "BetweenD7AndD6ShiftSelectorPoss" 236 "BtwnTwoForwardShiftSelectorPoss" 237 "BtwnTwoReverseShiftSelectorPoss" 238 "BetweenTwoShiftSelectorPoss" 239 "D77thFrwrdSlctrPsRfrncdFrmDrive" 240 "D66thFrwrdSlctrPsRfrncdFrmDrive" 241 "D55thFrwrdSlctrPsRfrncdFrmDrive" 242 "D44thFrwrdSlctrPsRfrncdFrmDrive" 243 "D33rdFrwrdSlctrPsRfrncdFrmDrive" 244 "D22ndFrwrdSlctrPsRfrncdFrmDrive" 245 "D11stFrwrdSlctrPsRfrncdFrmDrive" 246 "Downshift2GearsFromCurrentPos" 247 "Downshift1GearFromCurrentPos" 248 "Upshift2GearsFromCurrentPos" 249 "Upshift1GearFromCurrentPos" 250 "ForwardLowPos" 251 "ParkPos" 252 "ForwardDrivePos" 253 "HoldCurrentGear" ;
VAL_ 3221225472 DisengageDrivelineRq 2 "Reserved" 3 "TakeNoAction" 1 "DisengageDriveline" 0 "AllowDrivelineEngagement" ;
VAL_ 3221225472 TorqueConverterLockupDisableRq 2 "Reserved" 3 "TakeNoAction" 1 "DisableTorqueConvertorLockup" 0 "AllowTorqueConvertorLockup" ;
VAL_ 3221225472 TransGearShiftInhibitRq 2 "Reserved" 3 "TakeNoAction" 1 "GearShiftsAreInhibited" 0 "GearShiftsAreAllowed" ;
VAL_ 3221225472 EngBuildHoursReset 2 "Reserved" 3 "TakeNoAction" 1 "Reset" 0 "DoNotReset" ;
VAL_ 3221225472 TripGroup2Proprietary 2 "Reserved" 3 "NotApplicable" 1 "Reset" 0 "TakeNoAction" ;
VAL_ 3221225472 TripGroup1 2 "Reserved" 3 "NotApplicable" 1 "Reset" 0 "TakeNoAction" ;
VAL_ 3221225472 RetarderLocation 15 "NotAvailable" 14 "Other" 6 "1101NotDefined" 5 "Trailer" 4 "Driveline" 3 "TransOutput" 2 "TransInput" 1 "EngExhaustBrake" 0 "EngCompressionReleaseBrake" ;
VAL_ 3221225472 RetarderType 15 "NotAvailable" 14 "Other" 5 "1101NotDefined" 4 "Exhaust" 3 "CompressionRelease" 2 "CooledFriction" 1 "Hyd" 0 "Electric_Magnetic" ;
VAL_ 3221225472 RearWasherFunction 7 "NotAvailable" 4 "110Reserved" 3 "High" 2 "Medium" 1 "Low" 0 "Off" ;
VAL_ 3221225472 FrontOperatorWasherSwitch 7 "NotAvailable" 4 "110Reserved" 3 "High" 2 "Medium" 1 "Low" 0 "Off" ;
VAL_ 3221225472 FrontNonoperatorWasherSwitch 7 "NotAvailable" 4 "110Reserved" 3 "High" 2 "Medium" 1 "Low" 0 "Off" ;
VAL_ 3221225472 RearWiperSwitch 7 "1110Reserved" 6 "Mist" 5 "Delayed2" 4 "Delayed1" 2 "Medium" 15 "NotAvailable" 3 "High" 1 "Low" 0 "Off" ;
VAL_ 3221225472 FrontOperatorWiperSwitch 7 "1110Reserved" 6 "Mist" 5 "Delayed2" 4 "Delayed1" 2 "Medium" 15 "NotAvailable" 3 "High" 1 "Low" 0 "Off" ;
VAL_ 3221225472 FrontNonoperatorWiperSwitch 7 "1110Reserved" 6 "Mist" 5 "Delayed2" 4 "Delayed1" 2 "Medium" 15 "NotAvailable" 3 "High" 1 "Low" 0 "Off" ;
VAL_ 3221225472 EngAltDroopAuxInputSelect 15 "NotAvailable" 14 "ErrorCondition" 1 "thr1101OnOfAltDrpSttng1Thrgh13I" 0 "NormalDroopSettingIsSelected" ;
VAL_ 3221225472 EngAltDroopRemoteAccelSelect 15 "NotAvailable" 14 "ErrorCondition" 1 "thr1101OnOfAltDrpSttng1Thrgh13I" 0 "NormalDroopSettingIsSelected" ;
VAL_ 3221225472 EngAltDroopAccel2Select 15 "NotAvailable" 14 "ErrorCondition" 1 "thr1101OnOfAltDrpSttng1Thrgh13I" 0 "NormalDroopSettingIsSelected" ;
VAL_ 3221225472 EngAltDroopAccel1Select 15 "NotAvailable" 14 "ErrorCondition" 1 "thr1101OnOfAltDrpSttng1Thrgh13I" 0 "NormalDroopSettingIsSelected" ;
VAL_ 3221225472 EngAltRatingSelect 1 "IndctsThtAltPwrFling1IsSelected" 0 "IndctsThtMxPwrFuelingIsSelected" ;
VAL_ 3221225472 EngAltLowIdleSwitch 3 "NotAvailableUnused" 2 "Error" 1 "AltLowIdlePointIsSelected" 0 "DefaultLowIdlePointIsSelected" ;
VAL_ 3221225472 EngSynchronizationSwitch 3 "NotAvailableUnused" 2 "Error" 1 "FunctionalityIsEnabled" 0 "FunctionalityIsDisabled" ;
VAL_ 3221225472 EngAuxGovernorSwitch 2 "ErrorCondition" 1 "AuxGovernorIsEnabled" 0 "AuxGovernorIsDisabled" ;
VAL_ 3221225472 EngAltDroopAuxInputSelectState 14 "SAEReserved" 1 "thr1101CtrlSttIsOnOfAltDrpSttng" 0 "CtrlStateIsNormalDroopSetting" ;
VAL_ 3221225472 EngAltDrpRemoteAccelSelectState 15 "NotAvailable" 14 "SAEReserved" 1 "thr1101CtrlSttIsOnOfAltDrpSttng" 0 "CtrlStateIsNormalDroopSetting" ;
VAL_ 3221225472 EngAltDroopAccel2SelectState 15 "NotAvailable" 14 "SAEReserved" 1 "thr1101CtrlsSttIsOnOfAltDrpSttn" 0 "CtrlsStateIsNormalDroopSetting" ;
VAL_ 3221225472 EngAltDroopAccel1SelectState 15 "NotAvailable" 14 "SAEReserved" 1 "thr1101CtrlSttIsOnOfAltDrpSttng" 0 "CtrlStateIsNormalDroopSetting" ;
VAL_ 3221225472 EngAltRatingSelectState 1 "CtrlStateIsAltPowerFueling1" 0 "CtrlStateIsMaxPowerFueling" ;
VAL_ 3221225472 EngAltLowIdleSelectState 3 "NotAvailable" 2 "SAEReserved" 1 "AltIdleState" 0 "NormalIdleState" ;
VAL_ 3221225472 EngMultiUnitSyncState 3 "NotAvailable" 2 "SAEReserved" 1 "CtrlStateIsFunctionalityEnabled" 0 "CtrlStteIsFunctionalityDisabled" ;
VAL_ 3221225472 EngAuxGovernorState 3 "NotAvailable" 2 "SAEReserved" 1 "CtrlStateIsAuxGovernorEnabled" 0 "CtrlStateIsAuxGovernorDisabled" ;
VAL_ 3221225472 HighLowBeamSwitch 3 "NotAvailable" 2 "Error" 1 "HighBeamSelected" 0 "LowBeamSelected" ;
VAL_ 3221225472 HazardLightSwitch 3 "NotAvailable" 2 "Error" 1 "HazardLampsToBeFlashing" 0 "HazardLampsToBeOff" ;
VAL_ 3221225472 TurnSignalSwitch 2 "RightTurnToBeFlashing" 15 "NotAvailable" 14 "Error" 3 "1101Reserved" 1 "LeftTurnToBeFlashing" 0 "NoTurnBeingSignaled" ;
VAL_ 3221225472 MainLightSwitch 9 "1101Reserved" 8 "DlydOffPsByWhchThOprtrSlctsThtA" 4 "0111Reserved" 2 "HdlghtOnPsByWhchThOprtrSlctsTht" 15 "NotAvailable" 14 "Error" 3 "HdlghtAndPrkOnPsByWhchThOprtrSl" 1 "PrkOnPsByWhchThOprtrSlctsThtThP" 0 "OffPsByWhchThOprtrSlctsThtNnOfT" ;
VAL_ 3221225472 WorkLightSwitch 5 "1101Reserved" 4 "WrkLghtCmbntn4OnPsByWhchThOprtr" 2 "WrkLghtCmbntn2OnPsByWhchThOprtr" 15 "NotAvailable" 14 "Error" 3 "WrkLghtCmbntn3OnPsByWhchThOprtr" 1 "WrkLghtCmbntn1OnPsByWhchThOprtr" 0 "OffPsByWhchThOprtrSlctsThtNnOfT" ;
VAL_ 3221225472 BlackOutWorkLampSelect 3 "NotSupported" 2 "Reserved" 1 "On" 0 "Off" ;
VAL_ 3221225472 NightVisionIlluminatorSelect 3 "NotSupported" 2 "Reserved" 1 "On" 0 "Off" ;
VAL_ 3221225472 BlackOutBrake_StopLampSelect 3 "NotSupported" 2 "Reserved" 1 "On" 0 "Off" ;
VAL_ 3221225472 ConvoyDrivingLampSelect 3 "NotSupported" 2 "Reserved" 1 "On" 0 "Off" ;
VAL_ 3221225472 ConvoyLampSelect 3 "NotSupported" 2 "Reserved" 1 "On" 0 "Off" ;
VAL_ 3221225472 FrontBlackOutMarkerLampSelect 3 "NotSupported" 2 "Reserved" 1 "On" 0 "Off" ;
VAL_ 3221225472 RearBlackOutMarkerSelect 3 "NotSupported" 2 "Reserved" 1 "On" 0 "Off" ;
VAL_ 3221225472 SlowVesselModeStatus 3 "TakeNoAction" 2 "Reserved" 1 "SlowVesselModeIsACTIVE" 0 "SlowVesselModeIsOFF" ;
VAL_ 3221225472 TrollingModeStatus 3 "TakeNoAction" 2 "Reserved" 1 "TrollingModeIsACTIVE" 0 "TrollingModeIsOFF" ;
VAL_ 3221225472 EngThrttlSynchrnztionModeStatus 15 "TakeNoAction" 5 "1110Reserved" 4 "SynchronizedMaster" 3 "SynchronizedStarboard" 2 "SynchronizedPort" 1 "SynchronizedCenter" 0 "NotSynchronized" ;
VAL_ 3221225472 DisplayDeadbands 15 "NotAvailable" 3 "1110Reserved" 2 "Wide_24mm" 1 "Standard_12mm" 0 "Narrow_45mm" ;
VAL_ 3221225472 LEDPatternCtrl 15 "NotAvailable" 3 "1110Reserved" 2 "7Channel" 1 "Offset" 0 "5Channel" ;
VAL_ 3221225472 LEDDisplayDeadbandCtrl 15 "NotAvailableNotApplicable" 5 "1110Reserved" 4 "_1Mm" 3 "_5Mm" 2 "_24Mm" 1 "_12Mm" 0 "_45Mm" ;
VAL_ 3221225472 LEDDisplayModeCtrl 15 "NotAvailableNotApplicable" 3 "1110Reserved" 2 "CenterOnGradeDisplayMode2" 1 "OffsetOnGradeDisplayMode" 0 "CenterOnGradeDisplayMode1" ;
VAL_ 3221225472 LEDDisplayData1 32 "LowCoarseLEDOn" 16 "LowFineLEDOn" 8 "OngradeLEDOn" 4 "HighFineLEDOn" 2 "HighCoarseLEDOn" ;
VAL_ 3221225472 LaserReceiverType 1 "LinearLaserReceiver" 0 "Reserved" ;
VAL_ 3221225472 LaserTracerInformation 32 "Curb" 16 "Stringline" 8 "PreviousPass" 4 "ValidTarget" 2 "LaserIsReady" 1 "LaserPowerIsOn" ;
VAL_ 3221225472 LEDDisplayData2 64 "RightLEDOn" 32 "LeftLEDOn" 16 "DownLEDOn" 8 "UpLEDOn" 4 "OngradeCLEDOn" 2 "OngradeBLEDOn" 1 "OngradeALEDOn" ;
VAL_ 3221225472 SdshftDsrdBldOffsetOperatorCtrl 15 "NotInstalled" 14 "ErrorIndicator" 4 "1101Reserved" 3 "AutomaticOperatorCtrlRq" 2 "ManualOperatorCtrlRq" 0 "NoOperatorCtrlRq" 1 "MomentaryOperatorCtrlRq" ;
VAL_ 3221225472 SdshftBldCtrlMdeOperatorControl 15 "NotInstalled" 14 "ErrorIndicator" 4 "1101Reserved" 3 "AutomaticOperatorCtrlRq" 2 "ManualOperatorCtrlRq" 0 "NoOperatorCtrlRq" 1 "OprtrCtrlSttCnBRdInTwWysOnMthdU" ;
VAL_ 3221225472 RghtDsrdBladeOffsetOperatorCtrl 15 "NotInstalled" 14 "ErrorIndicator" 3 "1101Reserved" 2 "DecrementOperatorCtrlRq" 0 "NoOperatorCtrlRq" 1 "OprtrCtrlSttCnBRdInTwWysOnMthdU" ;
VAL_ 3221225472 RghtBldeCtrlModeOperatorControl 15 "NotInstalled" 14 "ErrorIndicator" 3 "AutomaticOperatorCtrlRq" 2 "ManualOperatorCtrlRq" 0 "NoChange" 1 "MomentaryOperatorCtrlRq" ;
VAL_ 3221225472 LftDsredBladeOffsetOperatorCtrl 15 "NotInstalled" 14 "ErrorIndicator" 3 "1101Reserved" 2 "DecrementOperatorCtrlRq" 0 "NoOperatorCtrlRq" 1 "OprtrCtrlSttCnBRdInTwWysOnMthdU" ;
VAL_ 3221225472 LftBladeCtrlModeOperatorControl 15 "NotInstalled" 14 "ErrorIndicator" 12 "1101Reserved" 3 "AutomaticOperatorCtrlRq" 2 "ManualOperatorCtrlRq" 0 "NoChange" 1 "OprtrCtrlSttCnBRdInTwWysOnMthdU" ;
VAL_ 3221225472 BladeAutoModeCmd 15 "NotSupported" 14 "ErrorIndicator" 4 "AutoNotAllowed" 3 "SrvcMdAtAllwdOnlyDrngSrvceModes" 2 "SspndAtTmprarilySuspendAutoMode" 1 "ActvtyAllwsAtMstDtctOprtrBfrAtA" 0 "AutoAllowed" ;
VAL_ 3221225472 DesiredGradeOffsetSwitch 15 "NotInstalled" 14 "ErrorIndicator" 2 "DecrementButtonPressed" 0 "NoButtonPressed" 1 "SwtchSttCnBRdInTwWysOnMthdUssTh" ;
VAL_ 3221225472 BladeCtrlModeSwitch 15 "NotInstalled" 14 "ErrorIndicator" 3 "AutomaticButtonPressed" 2 "ManualButtonPressed" 0 "NoButtonPressed" 1 "SwtchSttCnBRdInTwWysOnMthdUssTh" ;
VAL_ 3221225472 FrontWheelDriveActuatorStatus 3 "NotAvailable" 2 "Error" 1 "FrontWheelDriveActuatorEngaged" 0 "FrntWhelDriveActuatorNotEngaged" ;
VAL_ 3221225472 FMSstandardRqsSupported 3 "DontCare" 2 "Reserved" 1 "OnRqModeIsSupported" 0 "OnRqModeIsNotSupported" ;
VAL_ 3221225472 FMSstandardDiagnosticsSupported 3 "DontCare" 2 "Reserved" 1 "DiagnosticsIsSupported" 0 "DiagnosticsIsNotSupported" ;
VAL_ 3221225472 LnDprtureIndicationEnableStatus 3 "NotUsed" 2 "Reserved" 1 "LaneDepartureIndicationEnabled" 0 "LaneDepartureIndicationDisabled" ;
VAL_ 3221225472 LaneTrackingStatusLeftSide 3 "DontCare_TakeNoAction" 2 "Reserved" 1 "TrackingLeftSide" 0 "NotTrackingLeftSide" ;
VAL_ 3221225472 LaneTrackingStatusRightSide 3 "DontCare_TakeNoAction" 2 "Reserved" 1 "TrackingRightSide" 0 "NotTrackingRightSide" ;
VAL_ 3221225472 LaneDepartureImminentLeftSide 3 "NotUsed" 2 "Reserved" 1 "Imminent" 0 "NotImminent" ;
VAL_ 3221225472 LaneDepartureImminentRightSide 3 "NotUsed" 2 "Reserved" 1 "Imminent" 0 "NotImminent" ;
VAL_ 3221225472 EngFuelLeakage2 3 "NotAvailable" 2 "Error" 1 "LeakageDetected" 0 "NoLeakageDetected" ;
VAL_ 3221225472 EngFuelLeakage1 3 "NotAvailable" 2 "Error" 1 "LeakageDetected" 0 "NoLeakageDetected" ;
VAL_ 3221225472 EngTorqueLimitFeature 7 "NotAvailable" 5 "110Reserved" 4 "CurrentTorqueRating" 3 "PreviousTorqueRating" 2 "FirstTorqueRating" 1 "HighestTorqueRating" 0 "Reserved" ;
VAL_ 3221225472 TorqueLimitingFeatureStatus 3 "NotAvailable" 2 "Error" 1 "Enabled" 0 "Disabled" ;
VAL_ 3221225472 TransMode1Indicator 3 "NotAvailable" 2 "Error" 1 "TransMode1Active" 0 "TransMode1NotActive" ;
VAL_ 3221225472 TransMode2Indicator 3 "NotAvailable" 2 "Error" 1 "TransMode2Active" 0 "TransMode2NotActive" ;
VAL_ 3221225472 TransMode3Indicator 3 "NotAvailable" 2 "Error" 1 "TransMode3Active" 0 "TransMode3NotActive" ;
VAL_ 3221225472 TransMode4Indicator 3 "NotAvailable" 2 "Error" 1 "TransMode4Active" 0 "TransMode4NotActive" ;
VAL_ 3221225472 TransShiftInhibitIndicator 3 "TakeNoAction" 2 "Reserved" 1 "ActiveShiftIsInhibited" 0 "InactiveShiftIsNotInhibited" ;
VAL_ 3221225472 TransEngCrankEnable 3 "NotAvailable" 2 "Error" 1 "CrnkngEnbldEngCrnkngIsAllwdByTr" 0 "CrnkngDsbldEngCrnkngIsPrhbtdByT" ;
VAL_ 3221225472 ActiveShiftConsoleIndicator 3 "NotAvailable" 2 "Reserved" 1 "SecondShiftConsoleIsActive" 0 "PrimaryShiftConsoleIsActive" ;
VAL_ 3221225472 TransReadyForBrakeRelease 3 "DontCare" 2 "Reserved" 1 "TransReadyForBrakeRelease" 0 "TransNotReadyForBrakeRelease" ;
VAL_ 3221225472 TransRqedRangeDisplayFlashState 3 "TakeNoAction" 2 "Reserved" 1 "ActvTrnsRqdRngDsplyShldBFlshing" 0 "InctvTrnsRqdRngDsplyShldNtBFlsh" ;
VAL_ 3221225472 TransRqedRangeDisplayBlankState 3 "TakeNoAction" 2 "Reserved" 1 "ActvTrnsRqdRngDsplyShldBBlanked" 0 "InctvTrnsRqdRngDsplyShldNtBBlnk" ;
VAL_ 3221225472 TransServiceIndicator 3 "NotAvailable" 2 "ServiceIndicatorFlashing" 1 "ServiceIndicatorOn" 0 "SeviceIndicatorOff" ;
VAL_ 3221225472 TransCurrRangeDisplayBlankState 3 "NotSupported" 2 "Error" 1 "Blanked" 0 "NotBlanked" ;
VAL_ 3221225472 TransForwardDirectionSwitch 3 "NotAvailable" 2 "Error" 1 "On" 0 "Off" ;
VAL_ 3221225472 TransNeutralSwitch 3 "NotAvailable" 2 "Error" 1 "On" 0 "Off" ;
VAL_ 3221225472 TransReverseDirectionSwitch 3 "NotAvailable" 2 "Error" 1 "On" 0 "Off" ;
VAL_ 3221225472 TransLowRangeSenseSwitch 3 "NotAvailable" 2 "Error" 1 "On" 0 "Off" ;
VAL_ 3221225472 TransHighRangeSenseSwitch 3 "NotAvailable" 2 "Error" 1 "On" 0 "Off" ;
VAL_ 3221225472 TransInertiaBrakeActuator 3 "NotAvailable" 2 "Error" 1 "On" 0 "Off" ;
VAL_ 3221225472 TransDefuelActuator 3 "NotAvailable" 2 "Error" 1 "On" 0 "Off" ;
VAL_ 3221225472 TransLockupClutchActuator 3 "NotAvailable" 2 "Error" 1 "On" 0 "Off" ;
VAL_ 3221225472 TransClutchActuator 3 "NotAvailable" 2 "Error" 1 "On" 0 "Off" ;
VAL_ 3221225472 TransSplitterIndirectActuator 3 "NotAvailable" 2 "Error" 1 "On" 0 "Off" ;
VAL_ 3221225472 TransSplitterDirectActuator 3 "NotAvailable" 2 "Error" 1 "On" 0 "Off" ;
VAL_ 3221225472 TransRangeLowActuator 3 "NotAvailable" 2 "Error" 1 "On" 0 "Off" ;
VAL_ 3221225472 TransRangeHighActuator 3 "NotAvailable" 2 "Error" 1 "On" 0 "Off" ;
VAL_ 3221225472 TransShiftFingerGearActuator2 3 "NotAvailable" 2 "Error" 1 "On" 0 "Off" ;
VAL_ 3221225472 TransShiftFingerRailActuator2 3 "NotAvailable" 2 "Error" 1 "On" 0 "Off" ;
VAL_ 3221225472 TransShiftFingerGearActuator1 3 "NotAvailable" 2 "Error" 1 "On" 0 "Off" ;
VAL_ 3221225472 TransShiftFingerRailActuator1 3 "NotAvailable" 2 "Error" 1 "On" 0 "Off" ;
VAL_ 3221225472 TrnsShftFngrCenterRailIndicator 3 "NotAvailable" 2 "Error" 1 "On" 0 "Off" ;
VAL_ 3221225472 TrnsShftFngrEngagementIndicator 3 "NotAvailable" 2 "Error" 1 "On" 0 "Off" ;
VAL_ 3221225472 TrnsShiftFingerNeutralIndicator 3 "NotAvailable" 2 "Error" 1 "On" 0 "Off" ;
VAL_ 3221225472 ProgressiveShiftDisable 2 "Reserved" 3 "TakeNoAction" 1 "ProgressiveShiftIsDisabled" 0 "ProgressiveShiftIsNotDisabled" ;
VAL_ 3221225472 EngMomentaryOverspeedEnable 2 "Reserved" 3 "TakeNoAction" 1 "MomentaryEngOverspeedIsEnabled" 0 "MomentaryEngOverspeedIsDisabled" ;
VAL_ 3221225472 TransShiftInProcess 3 "NotAvailable" 2 "Error" 1 "ShiftInProcess" 0 "ShiftIsNotInProcess" ;
VAL_ 3221225472 TorqueConverterLockupEngaged 3 "NotAvailable" 2 "Error" 1 "TorqueConverterLockupEngaged" 0 "TorqueConverterLockupDisengaged" ;
VAL_ 3221225472 TransDrivelineEngaged 3 "NotAvailable" 2 "Error" 1 "DrivelineEngaged" 0 "DrivelineDisengaged" ;
VAL_ 3221225472 SterableLiftAxleLoweringInhibit 3 "NotAvailable" 2 "Reserved" 1 "LoweringInhibited" 0 "LoweringAllowed" ;
VAL_ 3221225472 TypeOfSteerTrans 15 "NotAvailable" 4 "1110ReservedForSAEAssignment" 3 "HybrdStrTrnsAStrngTrnsmssnInWhc" 2 "PrlyElctrcStrTrnsAStrngTrnsmssn" 1 "PrlyHydStrTrnsAStrngTrnsmssnInW" 0 "PrlyMchStrTrnsAStrngTrnsmssnInW" ;
VAL_ 3221225472 TypeOfSteerForces 15 "NotAvailable" 4 "1110ReservedForSAEAssignment" 3 "SlfTrckngStrEqpmntASystmDsgndTC" 2 "FllPwrStrEqpmntStrngFrcsArPrvdd" 1 "PwrAssstdStrEqpmntStrngFrcsRslt" 0 "MnlStrEqpmntStrngFrcsRsltSllyFr" ;
VAL_ 3221225472 SteerType 15 "NotAvailable" 2 "1110ReservedForAssignmentBySAE" 1 "AxStrEqpmntASystmInWhchWhlsOnAx" 0 "MnStrSystmStrngEqpmntOfAVhclWhc" ;
VAL_ 3221225472 StatusOfSteerAxle 15 "NotAvailable" 6 "1110ReservedForSAEAssignment" 5 "AxleSteerInSpecialMode" 4 "AxleNotActiveBecauseOfAnError" 3 "AxleCenteredBecauseOfAnError" 2 "AxleCentered" 1 "AxleSteerActive" 0 "AxleSteerNotActive" ;
VAL_ 3221225472 TransOutputRetarder 3 "NotAvailable" 2 "Error" 1 "On" 0 "Off" ;
VAL_ 3221225472 EngCoolantLoadIncrease 3 "NotAvailable" 2 "Error" 1 "CoolantLoadIncreasePossible" 0 "NoCoolantLoadIncrease" ;
VAL_ 3221225472 RetarderEnableShiftAssistSwitch 3 "NotAvailable" 2 "Error" 1 "RetarderShiftAssistEnabled" 0 "RetarderShiftAssistDisabled" ;
VAL_ 3221225472 RetarderEnableBrakeAssistSwitch 3 "NotAvailable" 2 "Error" 1 "RetarderBrakeAssistEnabled" 0 "RetarderBrakeAssistDisabled" ;
VAL_ 3221225472 Jystck3GripXAxisDetentPosStatus 3 "NotAvailable" 2 "ErrorIndicator" 1 "InDetentPos" 0 "NotInDetentPos" ;
VAL_ 3221225472 Jystck3GripYAxisDetentPosStatus 3 "NotAvailable" 2 "ErrorIndicator" 1 "InDetentPos" 0 "NotInDetentPos" ;
VAL_ 3221225472 Jystck3ThetaAxisDetentPosStatus 3 "NotAvailable" 2 "ErrorIndicator" 1 "InDetentPos" 0 "NotInDetentPos" ;
VAL_ 3221225472 Jystck3ThtAxsClckwsPstvPsStatus 3 "NotAvailable" 2 "ErrorIndicator" 1 "OnPositiveSideOfNeutral" 0 "NotOnPositiveSideOfNeutral" ;
VAL_ 3221225472 Jystck3ThtAxsCntrClckwsNgtvPsStt 3 "NotAvailable" 2 "ErrorIndicator" 1 "OnNegativeSideOfNeutral" 0 "NotOnNegativeSideOfNeutral" ;
VAL_ 3221225472 Jystck3ThtaAxisNeutralPosStatus 3 "NotAvailable" 2 "ErrorIndicator" 1 "InNeutralPos" 0 "NotInNeutralPos" ;
VAL_ 3221225472 Jystck3GrpYAxsLvrFrwrdPstvPsStts 3 "NotAvailable" 2 "ErrorIndicator" 1 "OnPositiveSideOfNeutral" 0 "NotOnPositiveSideOfNeutral" ;
VAL_ 3221225472 Jystck3GrpYAxsLvrBckNgtvPsSttus 3 "NotAvailable" 2 "ErrorIndicator" 1 "OnNegativeSideOfNeutral" 0 "NotOnNegativeSideOfNeutral" ;
VAL_ 3221225472 Jystck3GrpYAxisNeutralPosStatus 3 "NotAvailable" 2 "ErrorIndicator" 1 "InNeutralPos" 0 "NotInNeutralPos" ;
VAL_ 3221225472 Jystck3GrpXAxsLvrRghtPstvPsStts 3 "NotAvailable" 2 "ErrorIndicator" 1 "OnPositiveSideOfNeutral" 0 "NotOnPositiveSideOfNeutral" ;
VAL_ 3221225472 Jystck3GrpXAxsLvrLftNgtvPsSttus 3 "NotAvailable" 2 "ErrorIndicator" 1 "OnNegativeSideOfNeutral" 0 "NotOnNegativeSideOfNeutral" ;
VAL_ 3221225472 Jystck3GrpXAxisNeutralPosStatus 3 "NotAvailable" 2 "ErrorIndicator" 1 "OnNegativeSideOfNeutral" 0 "NotOnNegativeSideOfNeutral" ;
VAL_ 3221225472 Jystck2GripXAxisDetentPosStatus 3 "NotAvailable" 2 "ErrorIndicator" 1 "InDetentPos" 0 "NotInDetentPos" ;
VAL_ 3221225472 Jystck2GripYAxisDetentPosStatus 3 "NotAvailable" 2 "ErrorIndicator" 1 "InDetentPos" 0 "NotInDetentPos" ;
VAL_ 3221225472 Jystck2ThetaAxisDetentPosStatus 3 "NotAvailable" 2 "ErrorIndicator" 1 "InDetentPos" 0 "NotInDetentPos" ;
VAL_ 3221225472 Jystck2ThtAxsClckwsPstvPsStatus 3 "NotAvailable" 2 "ErrorIndicator" 1 "OnPositiveSideOfNeutral" 0 "NotOnPositiveSideOfNeutral" ;
VAL_ 3221225472 Jystck2ThtAxsCntrClckwsNgtvPsStt 3 "NotAvailable" 2 "ErrorIndicator" 1 "OnNegativeSideOfNeutral" 0 "NotOnNegativeSideOfNeutral" ;
VAL_ 3221225472 Jystck2ThtaAxisNeutralPosStatus 3 "NotAvailable" 2 "ErrorIndicator" 1 "InNeutralPos" 0 "NotInNeutralPos" ;
VAL_ 3221225472 Jystck2GrpYAxsLvrFrwrdPstvPsStts 3 "NotAvailable" 2 "ErrorIndicator" 1 "OnPositiveSideOfNeutral" 0 "NotOnPositiveSideOfNeutral" ;
VAL_ 3221225472 Jystck2GrpYAxsLvrBckNgtvPsSttus 3 "NotAvailable" 2 "ErrorIndicator" 1 "OnNegativeSideOfNeutral" 0 "NotOnNegativeSideOfNeutral" ;
VAL_ 3221225472 Jystck2GrpYAxisNeutralPosStatus 3 "NotAvailable" 2 "ErrorIndicator" 1 "InNeutralPos" 0 "NotInNeutralPos" ;
VAL_ 3221225472 Jystck2GrpXAxsLvrRghtPstvPsStts 3 "NotAvailable" 2 "ErrorIndicator" 1 "OnPositiveSideOfNeutral" 0 "NotOnPositiveSideOfNeutral" ;
VAL_ 3221225472 Jystck2GrpXAxsLvrLftNgtvPsSttus 3 "NotAvailable" 2 "ErrorIndicator" 1 "OnNegativeSideOfNeutral" 0 "NotOnNegativeSideOfNeutral" ;
VAL_ 3221225472 Jystck2GrpXAxisNeutralPosStatus 3 "NotAvailable" 2 "ErrorIndicator" 1 "OnNegativeSideOfNeutral" 0 "NotOnNegativeSideOfNeutral" ;
VAL_ 3221225472 Jystck1GripXAxisDetentPosStatus 3 "NotAvailable" 2 "ErrorIndicator" 1 "InDetentPos" 0 "NotInDetentPos" ;
VAL_ 3221225472 Jystck1GripYAxisDetentPosStatus 3 "NotAvailable" 2 "ErrorIndicator" 1 "InDetentPos" 0 "NotInDetentPos" ;
VAL_ 3221225472 Jystck1ThetaAxisDetentPosStatus 3 "NotAvailable" 2 "ErrorIndicator" 1 "InDetentPos" 0 "NotInDetentPos" ;
VAL_ 3221225472 Jystck1ThtAxsClckwsPstvPsStatus 3 "NotAvailable" 2 "ErrorIndicator" 1 "OnPositiveSideOfNeutral" 0 "NotOnPositiveSideOfNeutral" ;
VAL_ 3221225472 Jystck1ThtAxsCntrClckwsNgtvPsStt 3 "NotAvailable" 2 "ErrorIndicator" 1 "OnNegativeSideOfNeutral" 0 "NotOnNegativeSideOfNeutral" ;
VAL_ 3221225472 Jystck1ThtaAxisNeutralPosStatus 3 "NotAvailable" 2 "ErrorIndicator" 1 "InNeutralPos" 0 "NotInNeutralPos" ;
VAL_ 3221225472 Jystck1GrpYAxsLvrFrwrdPstvPsStts 3 "NotAvailable" 2 "ErrorIndicator" 1 "OnPositiveSideOfNeutral" 0 "NotOnPositiveSideOfNeutral" ;
VAL_ 3221225472 Jystck1GrpYAxsLvrBckNgtvPsSttus 3 "NotAvailable" 2 "ErrorIndicator" 1 "OnNegativeSideOfNeutral" 0 "NotOnNegativeSideOfNeutral" ;
VAL_ 3221225472 Jystck1GrpYAxisNeutralPosStatus 3 "NotAvailable" 2 "ErrorIndicator" 1 "InNeutralPos" 0 "NotInNeutralPos" ;
VAL_ 3221225472 Jystck1GrpXAxsLvrRghtPstvPsStts 3 "NotAvailable" 2 "ErrorIndicator" 1 "OnPositiveSideOfNeutral" 0 "NotOnPositiveSideOfNeutral" ;
VAL_ 3221225472 Jystck1GrpXAxsLvrLftNgtvPsSttus 3 "NotAvailable" 2 "ErrorIndicator" 1 "OnNegativeSideOfNeutral" 0 "NotOnNegativeSideOfNeutral" ;
VAL_ 3221225472 Jystck1GrpXAxisNeutralPosStatus 3 "NotAvailable" 2 "ErrorIndicator" 1 "InNeutralPos" 0 "NotInNeutralPos" ;
VAL_ 3221225472 EngWasteOilReservoirLevel 4 "RepresentsCompletelyFull" ;
VAL_ 3221225472 EngVentilationStatus 7 "NotAvailableNotInstalle" 6 "NtAblTDtrmnIfSufficientlyVented" 5 "ReservedForSAEAssignment" 3 "CurrentlyVenting" 2 "VentilationDelay" 1 "VentilationNeeded" 0 "SufficientlyVented" ;
VAL_ 3221225472 EngOilPrimingState 3 "NotAvailableNotInstalled" 2 "UnblTDtrmnIfSffcentlyLubricated" 1 "SufficientlyLubricated" 0 "NotSufficientlyLubricated" ;
VAL_ 3221225472 EngOilPrimingPumpSwitch 3 "NotAvailableNotInstalled" 2 "Error" 1 "On" 0 "Off" ;
VAL_ 3221225472 EngOilPreHeatedState 3 "NotAvailableNotInstalled" 2 "UnblTDtrmnIfEngOlIsPrhtdSffcntl" 1 "SufficientlyPreheated" 0 "NotSufficientlyPreheated" ;
VAL_ 3221225472 EngCoolantPreheatedState 3 "NotAvailableNotInstalled" 2 "UnblTDtrmnEngClntPrhtdSffcently" 1 "SufficientlyPreheated" 0 "NotSufficientlyPreheated" ;
VAL_ 3221225472 TurningGearEngaged 1 "TurningGearIsEngaged" 0 "TurningGearIsNotEngaged" ;
VAL_ 3221225472 SafetyWireStatus 3 "NotAvailable" 2 "Error" 1 "SafetyWireHasBeenActivated" 0 "SafetyWireHasNotBeenActivated" ;
VAL_ 3221225472 EngVrblGmtryTrbArCtrlShtffValve 3 "NotAvailable" 2 "Reserved" 1 "VGTAirCtrlShutoffValveIsOn" 0 "VGTAirCtrlShutoffValveIsOff" ;
VAL_ 3221225472 EngRotationDirection 3 "NotAvailable" 2 "Reserved" 1 "ClockWise" 0 "CounterClockWise" ;
VAL_ 3221225472 RearAxleGroupEngagementStatus 3 "notAvailable" 2 "error" 1 "rearAxleGroupEngaged" 0 "rearAxleGroupDisengaged" ;
VAL_ 3221225472 FrontAxleGroupEngagementStatus 3 "notAvailable" 2 "error" 1 "frontAxleGroupEngaged" 0 "frontAxleGroupDisengaged" ;
VAL_ 3221225472 DiffLockStateCentralRear 3 "NotAvailable" 2 "Error" 1 "DiffLockEngaged" 0 "DiffLockDisengaged" ;
VAL_ 3221225472 DiffLockStateCentralFront 3 "NotAvailable" 2 "Error" 1 "DiffLockEngaged" 0 "DiffLockDisengaged" ;
VAL_ 3221225472 DiffLockStateCentral 3 "NotAvailable" 2 "Error" 1 "DiffLockEngaged" 0 "DiffLockDisengaged" ;
VAL_ 3221225472 DiffLockStateRearAxle2 3 "NotAvailable" 2 "Error" 1 "DiffLockEngaged" 0 "DiffLockDisengaged" ;
VAL_ 3221225472 DiffLockStateRearAxle1 3 "NotAvailable" 2 "Error" 1 "DiffLockEngaged" 0 "DiffLockDisengaged" ;
VAL_ 3221225472 DiffLockStateFrontAxle2 3 "NotAvailable" 2 "Error" 1 "DiffLockEngaged" 0 "DiffLockDisengaged" ;
VAL_ 3221225472 DiffLockStateFrontAxle1 3 "NotAvailable" 2 "Error" 1 "DiffLockEngaged" 0 "DiffLockDisengaged" ;
VAL_ 3221225472 EngStartEnableDevice2Config 15 "NotAvailable" 5 "1110Reserved" 4 "ElectricInletAirHeaterInstalled" 3 "EtherInjectionInstalled" 2 "FuelledStartInstalled" 1 "GlowPlugsInstalled" 0 "NoStartEnableDevice2Installed" ;
